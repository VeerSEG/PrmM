AUTOSAR XML (schema 00049)
standard types defined: uint8, uint16, uint32, sint16, sint32, Std_ReturnType, boolean
package /System_Template/Pkg_Units
  10 x unit, all with factor-si-to-unit=1, offset-si-to-unit=0:
    deg_C: display-name=°C
    A: display-name=A
    Nm: display-name=Nm
    V: display-name=V
    rpm: display-name=rpm
    kilometerPerHour: display-name=km/h
    min: display-name=min
    perc: display-name=%
    Ohm: display-name=Ohm
    W: display-name=W
package /System_Template/COMPUMETHODS
  compu method CompuMethod_Edrv_nrChksAct: phys=raw for raw 0..255
  compu method CompuMethod_Edrv_nrAlvCntrAct: phys=raw for raw 0..15
  compu method CompuMethod_Edrv_stRunAct: 0=Pre-Run (PRE_RUN), 1=Standby (STANDBY), 2=Run (RUN), 3=Post-Run (POST_RUN), 4=Shut-Down (SHUT_DOWN), 5=Shut-Down-Finished (SHUT_DOWN_FINISHED), 6=Free (FREE), 7=Error (ERROR)
  compu method CompuMethod_Edrv_stOperModAct: 0=Idle (IDLE), 1=Torque (TORQUE), 2=Voltage (VOLTAGE), 3=Voltage without battery (VOLTAGE_WITHOUT_BATTERY), 4=Free_4 (FREE), 5=Free_5 (FREE), 6=Free_6 (FREE), 7=Free_7 (FREE), 8=Free_8 (FREE), 9=Free_9 (FREE), 10=Free_10 (FREE), 11=Free_11 (FREE), 12=Free_12 (FREE), 13=Free_13 (FREE), 14=Inactive (INACTIVE), 15=Error (ERROR)
  compu method CompuMethod_Edrv_tqAct: phys=raw*0.1-100 for raw 0..2046; unit Nm
  compu method CompuMethod_Edrv_nAct: phys=raw*6-24000 for raw 0..8190; unit rpm
  compu method CompuMethod_Edrv_uAct: phys=raw*0.0625 for raw 0..1022; unit V
  compu method CompuMethod_Edrv_iAct: phys=raw-500 for raw 0..1022; unit A
  compu method CompuMethod_Edrv_nrChksDern: phys=raw for raw 0..255
  compu method CompuMethod_Edrv_nrAlvCntrDern: phys=raw for raw 0..15
  compu method CompuMethod_Edrv_tqMinAvl: phys=raw*0.1-90 for raw 0..1022; unit Nm
  compu method CompuMethod_Edrv_tqMaxAvl: phys=raw*0.1-12.3 for raw 1..1023; unit Nm
  compu method CompuMethod_Edrv_stActDern: 0=No limitation (NO_LIMITATION), 1=DC voltage limitation (DC_VOLTAGE_LIMITATION), 2=DC current limitation (DC_CURRENT_LIMITATION), 3=Torque limitation (TORQUE_LIMITATION), 4=Free_4 (FREE), 5=Inverter temperature limitation (INVERTER_TEMPERATURE_LIMITATION), 6=Motor temperature limitation (MOTOR_TEMPERATURE_LIMITATION), 7=Power limitation (POWER_LIMITATION), 8=Free_8 (FREE), 9=Free_9 (FREE), 10=Free_10 (FREE), 11=Free_11 (FREE), 12=Free_12 (FREE), 13=Free_13 (FREE), 14=Free_14 (FREE), 15=SNA
  compu method CompuMethod_Edrv_ratTCritIvtr: phys=raw for raw 0..126; unit %
  compu method CompuMethod_Edrv_ratTCritMac: phys=raw for raw 0..126; unit %
  compu method CompuMethod_Edrv_stFltId: phys=raw for raw 0..511
  compu method CompuMethod_Eem_nrChksLim: phys=raw for raw 0..255
  compu method CompuMethod_Eem_nrAlvCntrLim: phys=raw for raw 0..15
  compu method CompuMethod_Eem_iMinEdrv: phys=raw*2-510 for raw 1..255; unit A
  compu method CompuMethod_Eem_iMaxEdrv: phys=raw*2 for raw 0..254; unit A
  compu method CompuMethod_Eem_uMinEdrv: phys=raw*0.2+10 for raw 0..254; unit V
  compu method CompuMethod_Eem_uMaxEdrv: phys=raw*0.2+10 for raw 0..254; unit V
  compu method CompuMethod_Eem_rMvbEdrv: phys=raw*0.005+0.005 for raw 0..254; unit Ohm
  compu method CompuMethod_Eem_uDesEdrv: phys=raw*0.1+30 for raw 0..255; unit V
  compu method CompuMethod_Pt_nrChksDes: phys=raw for raw 0..255
  compu method CompuMethod_Pt_nrAlvCntrDes: phys=raw for raw 0..15
  compu method CompuMethod_Pt_stOperModDesEdrv: 0=Idle (IDLE), 1=Torque (TORQUE), 2=Voltage (VOLTAGE), 3=Voltage Without Battery (VOLTAGE_WITHOUT_BATTERY), 4=Free_4 (FREE), 5=Free_5 (FREE), 6=Free_6 (FREE), 7=Free_7 (FREE), 8=Free_8 (FREE), 9=Free_9 (FREE), 10=Free_10 (FREE), 11=Free_11 (FREE), 12=Free_12 (FREE), 13=Free_13 (FREE), 14=Free_14 (FREE), 15=Free_15 (FREE)
  compu method CompuMethod_Pt_tqDesEdrv: phys=raw*0.1-200 for raw 0..4095; unit Nm
  compu method CompuMethod_Pt_tqMinEdrv: phys=raw*0.1-204.7 for raw 0..2047; unit Nm
  compu method CompuMethod_Pt_tqMaxEdrv: phys=raw*0.1 for raw 0..2047; unit Nm
  compu method CompuMethod_Pt_stIgnSwt: 0=IGN_LOCK, 1=IGN_OFF, 2=IGN_ACC, 3=FREE, 4=IGN_ON, 5=IGN_START
  compu method CompuMethod_Pt_nrChksVeh1: phys=raw for raw 0..255
  compu method CompuMethod_Pt_nrAlvCntrVeh1: phys=raw for raw 0..15
  compu method CompuMethod_Pt_tAmbEdrv: phys=raw-40 for raw 0..254; unit °C
  compu method CompuMethod_Pt_dAirPresEdrv: phys=raw*5+300 for raw 0..254; unit hPa
  compu method CompuMethod_Pt_dstOdo: phys=raw*0.1 for raw 0..16777215; unit km
  compu method CompuMethod_Pt_nrChksVeh2: phys=raw for raw 0..255
  compu method CompuMethod_Pt_nrAlvCntrVeh2: phys=raw for raw 0..15
  compu method CompuMethod_Pt_tiAbs: phys=raw for raw 0..4294967294; unit sec
  compu method CM_Edrv_nrChksAct: phys=raw for raw 0..255
  compu method CM_Edrv_nrAlvCntrAct: phys=raw for raw 0..15
  compu method CM_Edrv_stRunAct: 0=Pre_Run (PRE_RUN), 1=Standby (STANDBY), 2=Run (RUN), 3=Post_Run (POST_RUN), 4=Shut_Down (SHUT_DOWN), 5=Shut_Down_Finished (SHUT_DOWN_FINISHED), 6=Free (FREE), 7=Error (ERROR)
  compu method CM_Edrv_stOperModAct: 0=Idle (IDLE), 1=Torque (TORQUE), 2=Voltage (VOLTAGE), 3=LimphomeComLoss (LIMPHOME_COM_LOSS), 4=LimphomeBattLoss (LIMPHOME_BATT_LOSS), 5=Free_5 (FREE), 6=Free_6 (FREE), 7=Free_7 (FREE), 8=Free_8 (FREE), 9=Free_9 (FREE), 10=Free_10 (FREE), 11=Free_11 (FREE), 12=Free_12 (FREE), 13=Free_13 (FREE), 14=Inactive (INACTIVE), 15=Error (ERROR)
  compu method CM_Edrv_tqAct: phys=raw*0.0625-2048 for raw 24768..40768; unit Nm
  compu method CM_Edrv_nAct: phys=raw-32768 for raw 7768..57768; unit rpm
  compu method CM_Edrv_uAct: phys=raw*0.0625-2048 for raw 31168..64768; unit V
  compu method CM_Edrv_iAct: phys=raw*0.0625-2048 for raw 16768..48768; unit A
  compu method CM_Edrv_nrChksDern: phys=raw for raw 0..255
  compu method CM_Edrv_nrAlvCntrDern: phys=raw for raw 0..15
  compu method CM_Edrv_tqMinAvl: phys=raw*0.0625-2048 for raw 24768..40768; unit Nm
  compu method CM_Edrv_tqMaxAvl: phys=raw*0.0625-2048 for raw 24768..40768; unit Nm
  compu method CM_Edrv_stActDern: 0=No_limitation (NO_LIMITATION), 1=DC_voltage_limitation (DC_VOLTAGE_LIMITATION), 2=DC_current_limitation (DC_CURRENT_LIMITATION), 3=Torque_limitation (TORQUE_LIMITATION), 4=Free_4 (FREE), 5=Inverter_temperature_limitation (INVERTER_TEMPERATURE_LIMITATION), 6=Motor_temperature_limitation (MOTOR_TEMPERATURE_LIMITATION), 7=Power_limitation (POWER_LIMITATION), 8=Free_8 (FREE), 9=Free_9 (FREE), 10=Free_10 (FREE), 11=Free_11 (FREE), 12=Free_12 (FREE), 13=Free_13 (FREE), 14=Free_14 (FREE), 15=SNA
  compu method CM_Edrv_ratTCritIvtr: phys=raw for raw 0..126; unit %
  compu method CM_Edrv_ratTCritMac: phys=raw for raw 0..126; unit %
  compu method CM_Edrv_stFltId: phys=raw for raw 0..1023
  compu method CM_Eem_nrChksLim: phys=raw for raw 0..255
  compu method CM_Eem_nrAlvCntrLim: phys=raw for raw 0..15
  compu method CM_Eem_iMinEdrv: phys=raw*0.0625-1000 for raw 0..16000; unit A
  compu method CM_Eem_iMaxEdrv: phys=raw*0.0625 for raw 0..16000; unit A
  compu method CM_Eem_uMinEdrv: phys=raw*0.0625-2048 for raw 32768..48768; unit V
  compu method CM_Eem_uMaxEdrv: phys=raw*0.0625-2048 for raw 32768..48768; unit V
  compu method CM_Eem_rMvbEdrv: phys=raw*0.005+0.005 for raw 0..254; unit Ohm
  compu method CM_Eem_uDesEdrv: phys=raw*0.1+30 for raw 0..255; unit V
  compu method CM_Pt_nrChksDes: phys=raw for raw 0..255
  compu method CM_Pt_nrAlvCntrDes: phys=raw for raw 0..15
  compu method CM_Pt_stOperModDesEdrv: 0=Idle (IDLE), 1=Torque (TORQUE), 2=Voltage (VOLTAGE), 3=Free_3 (FREE), 4=LimphomeBattLoss (LIMPHOME_BATT_LOSS), 5=Free_5 (FREE), 6=Free_6 (FREE), 7=Free_7 (FREE), 8=Free_8 (FREE), 9=Free_9 (FREE), 10=Free_10 (FREE), 11=Free_11 (FREE), 12=Free_12 (FREE), 13=Free_13 (FREE), 14=Free_14 (FREE), 15=Free_15 (FREE)
  compu method CM_Pt_tqDesEdrv: phys=raw*0.0625-2048 for raw 24768..40768; unit Nm
  compu method CM_Pt_tqMinEdrv: phys=raw*0.0625-2048 for raw 24768..32768; unit Nm
  compu method CM_Pt_tqMaxEdrv: phys=raw*0.0625-2048 for raw 32768..40768; unit Nm
  compu method CM_Pt_stIgnSwt: 0=IGN_LOCK, 1=IGN_OFF, 2=IGN_ACC, 3=FREE_1 (FREE), 4=IGN_ON, 5=IGN_START, 6=FREE_2 (FREE), 7=SNA
  compu method CM_Pt_nrChksVeh1: phys=raw for raw 0..255
  compu method CM_Pt_nrAlvCntrVeh1: phys=raw for raw 0..15
  compu method CM_Pt_tAmbEdrv: phys=raw-40 for raw 0..254; unit °C
  compu method CM_Pt_dAirPresEdrv: phys=raw*5+300 for raw 0..254; unit hPa
  compu method CM_Pt_dstOdo: phys=raw*0.1 for raw 0..16777214; unit km
  compu method CM_Pt_nrChksVeh2: phys=raw for raw 0..255
  compu method CM_Pt_nrAlvCntrVeh2: phys=raw for raw 0..15
  compu method CM_Pt_tiAbs: phys=raw for raw 0..4294967294; unit sec
  compu method CM_Edrv_pMeclAct: phys=raw*0.0625-2048 for raw 26368..39168; unit kW
  compu method CM_Edrv_sOperModAct: 0=Inactive (INACTIVE), 1=Idle (IDLE), 2=Torque (TORQUE), 3=Speed (SPEED), 4=Free_0 (FREE), 5=Free_1 (FREE), 6=Free_2 (FREE), 7=Free_3 (FREE), 8=RotPCal_With_Rotation (ROTPCAL_WITH_ROTATION), 9=RotPCal_Without_Rotation (ROTPCAL_WITHOUT_ROTATION), 10=Resettable_Error (RESETTABLE_ERROR), 11=Non_Resettable_Error (NON_RESETTABLE_ERROR)
  compu method CM_Edrv_sDiscnctHvReq: 0=Inactive (INACTIVE), 1=Free_1 (FREE), 2=Free_2 (FREE), 3=Active (ACTIVE)
  compu method CM_Edrv_sEmgyShdwn: 0=Inactive (INACTIVE), 1=Free_1 (FREE), 2=Free_2 (FREE), 3=Active (ACTIVE)
  compu method CM_Edrv_sActvDcha: 0=Dschrg_Inactive (DSCHRG_INACTIVE), 1=Dschrg_Active (DSCHRG_ACTIVE), 2=Dschrg_Error (DSCHRG_ERROR), 3=Dschrg_Finished (DSCHRG_FINISHED)
  compu method CM_Edrv_sErrIso: 0=Normal (NORMAL), 1=Free_1 (FREE), 2=Free_2 (FREE), 3=Error (ERROR)
  compu method CM_Edrv_sErrHvIntlck: 0=Normal (NORMAL), 1=Free_1 (FREE), 2=Free_2 (FREE), 3=Error (ERROR)
  compu method CM_Edrv_sErrPrec: 0=Active (ACTIVE), 1=Completed (COMPLETED), 2=Free_1 (FREE), 3=Error (ERROR)
  compu method CM_Edrv_sRunAct: 0=PreRun_LV (PRERUN_LV), 1=Standby_LV (STANDBY_LV), 2=PreRun_HV (PRERUN_HV), 3=Standby_HV (STANDBY_HV), 4=Run (RUN), 5=Discharge (DISCHARGE), 6=PostRun_LV (POSTRUN_LV), 7=Shut_Down (SHUT_DOWN), 8=FREE, 9=Error (ERROR)
  compu method CM_Edrv_sFltPwrModl: 0=Inactive (INACTIVE), 1=Active_FW (ACTIVE_FW), 2=Free_1 (FREE), 3=Active_ASC (ACTIVE_ASC)
  compu method CM_Edrv_sFltActvDcha: 0=Normal (NORMAL), 1=Fault (FAULT)
  compu method CM_Edrv_nrFlt: phys=raw for raw 0..255
  compu method CM_Edrv_sActDern: 0=No_Limit (NO_LIMIT), 1=DC_Volt_Limit (DC_VOLT_LIMIT), 2=DC_Curr_Limit (DC_CURR_LIMIT), 3=Torque_Limit (TORQUE_LIMIT), 4=Free_1 (FREE), 5=Inverter_Temp_Limit (INVERTER_LIMIT), 6=Motor_Temp_Limit (MOTOR_LIMIT), 7=Power_Limit (POWER_LIMIT), 8=Motor_Speed_Limit (MOTOT_SPEED_LIMIT), 9=Free_3 (FREE), 10=Free_4 (FREE), 11=Free_5 (FREE), 12=Free_6 (FREE), 13=Free_7 (FREE), 14=Free_8 (FREE), 15=Free_9 (FREE)
  compu method CM_Edrv_yVersHwMnr: phys=raw for raw 0..255
  compu method CM_Edrv_yVersHwMjr: phys=raw for raw 0..255
  compu method CM_Edrv_yVersSwMnr: phys=raw for raw 0..524287
  compu method CM_Edrv_yVersSwMjr: phys=raw for raw 0..65535
  compu method CM_Edrv_sOperModDesEop: 0=Shut_Down (SHUT_DOWN), 1=Free_1 (FREE), 2=Free_2 (FREE), 3=Speed_Control (SPEED_CONTROL)
  compu method CM_Edrv_nDesEop: phys=raw for raw 0..9000; unit rpm
  compu method CM_Edrv_sSnsrLrnEop: 0=Disable_Learn (DISABLE_LEARN), 1=Free_1 (FREE), 2=Free_2 (FREE), 3=Enable_Learn (ENABLE_LEARN)
  compu method CM_Eop_nAct: phys=raw for raw 0..9000; unit rpm
  compu method CM_Eop_uAct: phys=raw*0.1 for raw 0..255; unit V
  compu method CM_Eop_iAct: phys=raw*0.1 for raw 0..255; unit A
  compu method CM_Eop_iIq: phys=raw*0.1 for raw 0..1023; unit A
  compu method CM_Eop_iIqRef: phys=raw*0.1 for raw 0..1023; unit A
  compu method CM_Eop_iIqLim: phys=raw*0.1 for raw 0..1023; unit A
  compu method CM_Eop_cPcb: phys=raw-50 for raw 0..255; unit °C
  compu method CM_Eop_cOil: phys=raw-50 for raw 0..255; unit °C
  compu method CM_Eop_sErr: 0=Inactive (INACTIVE), 1=Free_1 (FREE), 2=Free_2 (FREE), 3=Active (ACTIVE)
  compu method CM_Pt_sActvDchaReq: 0=Dschrg_Inactive (DSCHRG_INACTIVE), 1=Free_0 (FREE), 2=Free_1 (FREE), 3=Dschrg_Active (DSCHRG_ACTIVE)
  compu method CM_Pt_sIgnSwt: 0=Ig_Off (IG_OFF), 1=Free_1 (FREE), 2=Free_2 (FREE), 3=Ig_On (IG_ON)
  compu method CM_Pt_nMaxEdrv: phys=raw-32768 for raw 32768..57768; unit rpm
  compu method CM_Pt_nMinEdrv: phys=raw-32768 for raw 7768..32768; unit rpm
  compu method CM_Pt_sCrash: 0=No_Crash (NO_CRASH), 1=Crash (CRASH)
  compu method CM_Pt_sCrashVldy: 0=Invalid (INVALID), 1=Valid (VALID)
  compu method CM_Eem_TB_uSensor: phys=raw*0.0625-2048 for raw 32768..64768; unit V
  compu method CM_Eem_TB_iSensor: phys=raw*0.0625-2048 for raw 16768..48768; unit A
  compu method CM_Eem_sFltIso: 0=No_Fault (NO_FAULT), 1=Fault (FAULT)
  compu method CM_Eem_TB_tqSensor: phys=raw*0.0625-2048 for raw 24768..40768; unit Nm
  compu method CM_Eem_uDesPrec: phys=raw*0.0625-2048 for raw 32768..64768; unit V
  compu method CM_Pt_nDesEdrv: phys=raw-32768 for raw 7768..57768; unit rpm
  compu method CM_Pt_sOperModDesEdrv: 0=Idle (IDLE), 1=Torque (TORQUE), 2=Speed (SPEED), 3=Free_0 (FREE), 4=Free_1 (FREE), 5=Free_2 (FREE), 6=Free_3 (FREE), 7=RotPCal_With_Rotaion (ROTPCAL_WITH_ROTATION), 8=RotPCal_Without_Rotaion (ROTPCAL_WITHOUT_ROTATION)
  compu method CM_Pt_sEmgyShdwnReq: 0=No_EmgcShutDwn (NO_EMGCSHUTDWN), 1=Free_1 (FREE), 2=Free_2 (FREE), 3=EmgcShutDwn (EMGCSHUTDWN)
  compu method CM_Edrv_sFltLvl: 0=No_Fault (NO_FAULT), 1=FaultLevel_1 (FAULTLEVEL_1), 2=FaultLevel_2 (FAULTLEVEL_2), 3=FaultLevel_3 (FAULTLEVEL_3)
  compu method CM_Edrv_sActvDchaRstr: 0=DschrgRstr_Inactive (DSCHRGRSTR_INACTIVE), 1=DschrgRstr_Active (DSCHRGRSTR_ACTIVE), 2=DschrgRstr_Error (DSCHRGRSTR_ERROR), 3=DschrgRstr_Finished (DSCHRGRSTR_FINISHED)
  compu method CM_Edrv_sActvDchaWndg: 0=DschrgWndg_Inactive (DSCHRGWNDG_INACTIVE), 1=DschrgWndg_Active (DSCHRGWNDG_ACTIVE), 2=DschrgWndg_Error (DSCHRGWNDG_ERROR), 3=DschrgWndg_Finished (DSCHRGWNDG_FINISHED)
  compu method CM_Eem_pMinEdrv: phys=raw*0.0625-2048 for raw 24768..40768; unit kW
  compu method CM_Edrv_uKl30: phys=raw*0.0625 for raw 0..800; unit V
  compu method CM_Edrv_id: phys=raw*0.0625-2048 for raw 16768..48768; unit A
  compu method CM_Edrv_iq: phys=raw*0.0625-2048 for raw 16768..48768; unit A
  compu method CM_Edrv_ud: phys=raw*0.0625-2048 for raw 768..64768; unit V
  compu method CM_Edrv_uq: phys=raw*0.0625-2048 for raw 768..64768; unit V
  compu method CM_Edrv_TStatorNTC1: phys=raw*0.0625-2048 for raw 31168..40768; unit °C
  compu method CM_Edrv_TStatorNTC2: phys=raw*0.0625-2048 for raw 31168..40768; unit °C
  compu method CM_Edrv_TRotorEst: phys=raw*0.0625-2048 for raw 31168..40768; unit °C
  compu method CM_Edrv_TInvUBridge: phys=raw*0.0625-2048 for raw 31168..40768; unit °C
  compu method CM_Edrv_TInvVBridge: phys=raw*0.0625-2048 for raw 31168..40768; unit °C
  compu method CM_Edrv_TInvWBridge: phys=raw*0.0625-2048 for raw 31168..40768; unit °C
  compu method CM_Edrv_TjEst: phys=raw*0.0625-2048 for raw 31168..40768; unit °C
  compu method CM_Edrv_TInvPU: phys=raw*0.0625-2048 for raw 31168..40768; unit °C
  compu method CM_Edrv_TInvCU: phys=raw*0.0625-2048 for raw 31168..40768; unit °C
  compu method CM_Edrv_ActSpdEOP: phys=raw for raw 0..10000; unit rpm
  compu method CM_Edrv_FaultStEOP: 0=No_Fault (NO_FAULT), 1=FREE, 2=FREE, 3=Fault (FAULT)
  compu method CM_Edrv_uEOP: phys=raw*0.0625 for raw 0..3200; unit V
  compu method CM_Edrv_iEOP: phys=raw*0.0625 for raw 0..3200; unit A
  compu method CM_Edrv_TEop: phys=raw*0.0625-2048 for raw 31168..40768; unit °C
  compu method CM_Pt_sHVBat: 0=HvBttry_Off (HVBTTRY_OFF), 1=HvBttry_PreChrg (HVBTTRY_PRECHRG), 2=HvBttry_PreChrg_Error (HVBTTRY_PRECHRG_ERROR), 3=HvBttry_On (HVBTTRY_ON)
  compu method CM_Eem_pMaxEdrv: phys=raw*0.0625-2048 for raw 24768..40768; unit kW
package /System_Template/UNIT
  12 x unit, all with factor-si-to-unit=1, offset-si-to-unit=0:
    rpm: display-name=rpm
    Nm: display-name=Nm
    V: display-name=V
    A: display-name=A
    perc: display-name=%
    Ohm: display-name=Ohm
    degC: display-name=°C
    hPa: display-name=hPa
    km: display-name=km
    sec: display-name=sec
    kW: display-name=kW
    Percent: display-name=%
package /DataTypes/DataConstrs
  range DC_Boolean: raw 0..1
package /Predefined_DEV/ImplementationDataTypes
  impl type NvM_RequestResultType: compu {0=NVM_REQ_OK, 1=NVM_REQ_NOT_OK, 2=NVM_REQ_PENDING, 3=NVM_REQ_INTEGRITY_FAILED, 4=NVM_REQ_BLOCK_SKIPPED, 5=NVM_REQ_NV_INVALIDATED, 6=NVM_REQ_CANCELED, 7=NVM_REQ_REDUNDANCY_FAILED, 8=NVM_REQ_RESTORED_FROM_ROM}, implementation-data-type=uint8
  impl type NvM_ServiceIdType: compu {6=NVM_READ_BLOCK, 7=NVM_WRITE_BLOCK, 8=NVM_RESTORE_BLOCK_DEFAULTS, 9=NVM_ERASE_BLOCK, 11=NVM_INVALIDATE_NV_BLOCK, 12=NVM_READ_ALL}, implementation-data-type=uint8
  impl type Dem_UdsStatusByteType: compu {mask 1: 1=DEM_UDS_STATUS_TF, mask 2: 2=DEM_UDS_STATUS_TFTOC, mask 4: 4=DEM_UDS_STATUS_PDTC, mask 8: 8=DEM_UDS_STATUS_CDTC, mask 16: 16=DEM_UDS_STATUS_TNCSLC, mask 32: 32=DEM_UDS_STATUS_TFSLC, mask 64: 64=DEM_UDS_STATUS_TNCTOC, mask 128: 128=DEM_UDS_STATUS_WIR}, range raw 0..255, implementation-data-type=uint8
package /EcuM_ArItf
  data type mapping set DTS_EcuM: mode-request-type-map{implementation-data-type=uint8, mode-group=EcuM_Mode}
package /AUTOSAR_Std/CompuMethods
  compu method Std_Active_Idle: 0=STD_IDLE (no error occurred), 1=STD_ACTIVE (generic indication that an error occurred)
  compu method Std_High_Low: 0=STD_LOW (no error occurred), 1=STD_HIGH (generic indication that an error occurred)
  compu method Std_On_Off: 0=STD_OFF (no error occurred), 1=STD_ON (generic indication that an error occurred)
package /AUTOSAR_Std/ImplementationDataTypes
  impl type Std_VersionInfoType: category=STRUCTURE, type-emitter=HEADER_FILE
    5 x element, all with category=TYPE_REFERENCE:
      vendorID: implementation-data-type=uint16
      moduleID: implementation-data-type=uint16
      sw_major_version: implementation-data-type=uint8
      sw_minor_version: implementation-data-type=uint8
      sw_patch_version: implementation-data-type=uint8
  impl type CS_StdT_tSENSORSTATE_E: compu {0=CS_StdT_tSENSORSTATE_Valid, 1=CS_StdT_tSENSORSTATE_Invalid}, implementation-data-type=uint8
package /BaseType
  302 x base type, all with category=FIXED_LENGTH, base-type-size=1, base-type-encoding=NONE, byte-order=little-endian:
    BT_AB_Abschaltanf_SIH_BF
    BT_AB_Anzeige_Fussg
    BT_AB_Belegung_VB
    BT_AB_Belegung_VF
    BT_AB_Belegung_VF_ext
    BT_AB_Belegung_VF_ext_aktiv
    BT_AB_Crash_Int
    BT_AB_Deaktivierung_HV
    BT_AB_Erh_Auf_VB
    BT_AB_Front_Crash
    BT_AB_Gurtschloss_BF
    BT_AB_Gurtschloss_FA
    BT_AB_Gurtschloss_FA_ext
    BT_AB_Gurtschloss_FA_ext_aktiv
    BT_AB_Gurtschloss_Reihe2_BF
    BT_AB_Gurtschloss_Reihe2_FA
    BT_AB_Gurtschloss_Reihe2_MI
    BT_AB_Gurtschloss_Reihe3_BF
    BT_AB_Gurtschloss_Reihe3_FA
    BT_AB_Gurtschloss_Reihe3_MI
    BT_AB_Gurtschloss_Reihe4_BF
    BT_AB_Gurtschloss_Reihe4_FA
    BT_AB_Gurtschloss_Reihe4_MI
    BT_AB_Gurtwarn_Reihe2_BF
    BT_AB_Gurtwarn_Reihe2_FA
    BT_AB_Gurtwarn_Reihe2_MI
    BT_AB_Gurtwarn_Reihe3_BF
    BT_AB_Gurtwarn_Reihe3_FA
    BT_AB_Gurtwarn_Reihe3_MI
    BT_AB_Gurtwarn_VB
    BT_AB_Gurtwarn_VF
    BT_AB_Heck_Crash
    BT_AB_Lampe
    BT_AB_MKB_Anforderung
    BT_AB_Rollover_Crash
    BT_AB_SB_Crash
    BT_AB_SF_Crash
    BT_AB_Sitzpos_Sens_BF
    BT_AB_Sitzpos_Sens_FA
    BT_AB_Stellgliedtest
    BT_AB_Systemfehler
    BT_AB_Versorgungsspannung
    BT_Airbag_10_BZ
    BT_Airbag_10_CRC
    BT_ClampControl_01_BZ
    BT_ClampControl_01_CRC
    BT_DGN_Verlernzaehler
    BT_DPM_01_BZ
    BT_DPM_01_CRC
    BT_DPM_FlgStrtNeutHldPha
    BT_DPM_StDispDrvPosn
    BT_DPM_StLghtDrvPosn
    BT_DPM_StTarDrvPosn
    BT_DS_RSG_ConfDTCChanged
    BT_DS_RSG_DiagAdr
    BT_DS_RSG_IdentValid
    BT_DS_RSG_MemSel10Changed
    BT_DS_RSG_MemSelChanged
    BT_DS_RSG_StMemChanged
    BT_DS_RSG_TestFailedChanged
    BT_DS_RSG_WIRChanged
    BT_EKK_HVK_EoHVL_Status
    BT_EKK_HVK_Fehler_intern
    BT_EKK_HVK_Status_Spgfreiheit
    BT_ELM5_01_BZ
    BT_ELM5_01_CRC
    BT_ELM5_HVK_Fehler_AE
    BT_ELM5_IAct
    BT_ELM5_IMaxAbs
    BT_ELM5_PrctPrfPwrMax
    BT_ELM5_PrctPrfTElm
    BT_ELM5_PrctPrfTInv
    BT_ELM5_PrctPrfTqMax
    BT_ELM5_PwrContGen
    BT_ELM5_PwrContMot
    BT_ELM5_PwrMecBasGen
    BT_ELM5_PwrMecBasMot
    BT_ELM5_PwrMecNom
    BT_ELM5_SpdAct
    BT_ELM5_SpdMaxDes
    BT_ELM5_StCpbDrv
    BT_ELM5_StIntvSpd
    BT_ELM5_StOpm
    BT_ELM5_StReqElmCal
    BT_ELM5_TOil
    BT_ELM5_TqAct
    BT_ELM5_TqBasMax
    BT_ELM5_TqBasMin
    BT_ELM5_TqGnr
    BT_ELM5_TqIntnlActLimSp
    BT_ELM5_TqLimMax
    BT_ELM5_TqLimMin
    BT_ELM5_TqMax
    BT_ELM5_TqMin
    BT_ELM5_TqNomMax
    BT_ELM5_TqPeakMax
    BT_ELM5_TqPeakMin
    BT_ELM5_TqSpdCtl
    BT_ELM5_TqTotMax
    BT_ELM5_TqTotMin
    BT_ELM5_UAct
    BT_ELM5_VfOilElmDes
    BT_ETMT_FlgReqExtdRng
    BT_ETMTElm1_03_BZ
    BT_ETMTElm1_03_CRC
    BT_ETMTElm1_PwrGnrAux
    BT_ETMTElm1_ULimMax
    BT_ETMTElm1_ULimMin
    BT_ETMTElm1_UMinChrg
    BT_ETMTElm1_UMinDschrg
    BT_ETMTElm5_01_BZ
    BT_ETMTElm5_01_CRC
    BT_ETMTElm5_ILimMax
    BT_ETMTElm5_ILimMin
    BT_ETMTElm5_Kp_SpdCtl
    BT_ETMTElm5_PwrGen
    BT_ETMTElm5_PwrGnrAux
    BT_ETMTElm5_PwrMot
    BT_ETMTElm5_PwrTotGen
    BT_ETMTElm5_PwrTotMot
    BT_ETMTElm5_SpdDes
    BT_ETMTElm5_SpdMax
    BT_ETMTElm5_SpdMin
    BT_ETMTElm5_StDcLnk
    BT_ETMTElm5_StOpmDes
    BT_ETMTElm5_TqDes
    BT_ETMTElm5_TqLimMaxSpdCtl
    BT_ETMTElm5_TqLimMinSpdCtl
    BT_ETMTElm5_UDcLnk
    BT_ETMTElm5_ULimMax
    BT_ETMTElm5_ULimMin
    BT_ETMTElm5_UMinChrg
    BT_ETMTElm5_UMinDschrg
    BT_ETMTElm5_VfOilElm
    BT_GW_KD_Fehler
    BT_HV_Bordnetz_aktiv
    BT_HV_Bordnetz_Fehler
    BT_HV_Heizer_Status
    BT_HVHL_HVK_EoHVL_Status
    BT_HVHL_HVK_Fehler_intern
    BT_HVHL_HVK_Status_Spgfreiheit
    BT_HVK_01_BZ
    BT_HVK_01_CRC
    BT_HVK_ADC_Sollmodus
    BT_HVK_AIAD_Sollmodus
    BT_HVK_AktiveEntladung_Anf
    BT_HVK_BMC_Sollmodus
    BT_HVK_BMC_Spannung_Anf
    BT_HVK_DCDC_EKK_Sollmodus
    BT_HVK_DCDC_Sollmodus
    BT_HVK_EKK_Sollmodus
    BT_HVK_ETM_Freigabe
    BT_HVK_Gesamtst_Spgfreiheit
    BT_HVK_HV_Netz_Warnungen
    BT_HVK_HV_Netz_Zustand
    BT_HVK_HVHL_Sollmodus
    BT_HVK_HVHW_Sollmodus
    BT_HVK_HVLM_Sollmodus
    BT_HVK_HVPTC_Sollmodus
    BT_HVK_Iso_Messung_Start
    BT_HVK_Istmodus_Anf
    BT_HVK_Notabschaltung_Anf
    BT_HVK_PPulsFreigabe
    BT_HVK_Vorladung_aktiv
    BT_KL_Verdampfertemperatur
    BT_KL_ZZ_Betriebsmodus
    BT_KL_ZZ_Minute
    BT_KL_ZZ_Monat
    BT_KL_ZZ_Status_Timer
    BT_KL_ZZ_Stunde
    BT_KL_ZZ_Tag
    BT_KN_RSG_BusKnockOut
    BT_KN_RSG_BusKnockOutTimer
    BT_KN_RSG_DiagPfad
    BT_KN_RSG_ECUKnockOut
    BT_KN_RSG_ECUKnockOutTimer
    BT_Kompressor_Status
    BT_KST_Anf_Klemmenfreigabe_ELV
    BT_KST_Ausparken_Betrieb
    BT_KST_aut_Abschaltung_Zuendung
    BT_KST_Fahrerhinweis_{1..6}
    BT_KST_KL_15
    BT_KST_Kl_50_Startanforderung
    BT_KST_Kl_S
    BT_KST_Remotestart_KL15_Anf
    BT_KST_StPtAcvReq
    BT_KST_StPtDeacReq
    BT_KST_Txt_Komfortabschaltung
    BT_KST_Txt_P_Gang
    BT_KST_Txt_Panikabschaltung
    BT_KST_Unterdr_Zuendungsmeldung
    BT_KST_Warn_P1_ZST_def
    BT_KST_Warn_P2_ZST_def
    BT_KST_ZAT_betaetigt
    BT_MVK_01_BZ
    BT_MVK_01_CRC
    BT_MVK_BMS_Sollmodus
    BT_MVK_DCDC_Sollmodus_02
    BT_MVK_ETM_Freigabe
    BT_MVK_Istmodus_Anf
    BT_MVK_MV_Netz_Zustand
    BT_NM_HCP_1_CBV_AWB
    BT_NM_HCP_1_CBV_CRI
    BT_NM_HCP_1_FCAB
    BT_NM_HCP_1_NM_aktiv_CABaktiv
    BT_NM_HCP_1_NM_aktiv_Diag
    BT_NM_HCP_1_NM_aktiv_KL15
    BT_NM_HCP_1_NM_aktiv_Tmin
    BT_NM_HCP_1_NM_State
    BT_NM_HCP_1_SNI_10
    BT_NM_HCP_1_UDS_CC
    BT_NM_HCP_1_Wakeup
    BT_NM_RSG_CBV_AWB
    BT_NM_RSG_CBV_CRI
    BT_NM_RSG_FCAB
    BT_NM_RSG_FCIB
    BT_NM_RSG_NM_aktiv_Diag
    BT_NM_RSG_NM_aktiv_KL15
    BT_NM_RSG_NM_aktiv_Kuehlung
    BT_NM_RSG_NM_aktiv_Tmin
    BT_NM_RSG_NM_State
    BT_NM_RSG_SNI_10
    BT_NM_RSG_UDS_CC
    BT_NM_RSG_Wakeup
    BT_PreCrash_Tueren_Verriegeln
    BT_Relais_VoKo_angesteuert
    BT_RSG_KD_Fehler
    BT_RSG_SNI_10
    BT_RSt_Anforderung_HMS
    BT_RSt_Fahrerhinweise
    BT_SI_Diagnose_Aktiv
    BT_SI_NWDF
    BT_SI_NWDF_30
    BT_SI_NWDF_gueltig
    BT_SI_P_Mode
    BT_SI_P_Mode_gueltig
    BT_SI_QRS_Mode
    BT_SI_Sammel_SG_Fehler
    BT_SI_Sammelfehler
    BT_SI_T_Mode
    BT_SI_T_Schutz
    BT_Thermo_Verbrauch_BTL
    BT_Thermo_Verbrauch_BTL_Ueberlauf
    BT_Thermo_Verbrauch_Innen
    BT_Thermo_Verbrauch_Innen_Ueberlauf
    BT_TME_EKK_Istmodus
    BT_TME_ELM{1..3}_IstVolumenstrom
    BT_TME_HV_IstLeistung
    BT_TME_HVEM_HV_Anf
    BT_TME_HVEM_Minleistung
    BT_TME_HVEM_Wunschleistung
    BT_TME_HVHL_Istmodus
    BT_TME_HVHL_verfuegbar
    BT_TME_HVHW_Ansteuerung_Soll
    BT_TME_HVHW_SollModus
    BT_TME_IPB_Status_Kuehlung
    BT_TME_IstSpannung_EKK_HV
    BT_TME_Klimaanforderung
    BT_TME_NT_Kreis_Status
    BT_TME_OBD_Lampe_Anf
    BT_TME_Temp_KM_vor_LE
    BT_TME_Temp_nach_Heizung_Front
    BT_TME_Temp_nach_HVH_Heizk1_1
    BT_TME_Temp_nach_HVH_Heizk1_2
    BT_TME_Temp_nach_HVH_Heizk2_1
    BT_TME_Temp_nach_HVH_Heizk2_2
    BT_TME_Temp_nach_HVH_Heizk3_1
    BT_TME_Temp_nach_HVH_Heizk3_2
    BT_TME_Temp_nach_HVH_Heizk4_1
    BT_TME_Temp_nach_HVH_Heizk4_2
    BT_TME_Temp_nach_Verdampfer_Front
    BT_TME_Verbrauch_gesamt
    BT_TME_Verbrauch_gesamt_Ueberlauf
    BT_UH_Jahr
    BT_UH_Minute
    BT_UH_Monat
    BT_UH_Sekunde
    BT_UH_Stunde
    BT_UH_Tag
    BT_VDSO_02_BZ
    BT_VDSO_02_CRC
    BT_VDSO_ALgtOfsCmp
    BT_VDSO_VWhlSpdFrLe
    BT_VDSO_VWhlSpdFrRi
    BT_VDSO_VWhlSpdReLe
    BT_VDSO_VWhlSpdReRi
    BT_VDSO_Vx3d
    BT_VDSO_Vx3dKmph
    BT_Vehicle_Driving_Cycle
    BT_Waermepumpe_Status
    BT_ZM_Fahrzeugabstellzeit
    BT_ZM_Fahrzeugabstellzeit_Status
    BT_ZM_HV_Auszeit
    BT_ZM_HV_Auszeit_Status
    BT_ZM_Standzeit
package /Constraints
  range DC_AB_Abschaltanf_SIH_BF: raw 0..1
  range DC_AB_Anzeige_Fussg: raw 0..2
  range DC_AB_Belegung_VB: raw 0..3
  range DC_AB_Belegung_VF: raw 0..3
  range DC_AB_Belegung_VF_ext: raw 0..7
  range DC_AB_Belegung_VF_ext_aktiv: raw 0..1
  range DC_AB_Crash_Int: raw 0..7
  range DC_AB_Deaktivierung_HV: raw 0..7
  range DC_AB_Erh_Auf_VB: raw 0..3
  range DC_AB_Front_Crash: raw 0..1
  range DC_AB_Gurtschloss_BF: raw 0..3
  range DC_AB_Gurtschloss_FA: raw 0..3
  range DC_AB_Gurtschloss_FA_ext: raw 0..7
  range DC_AB_Gurtschloss_FA_ext_aktiv: raw 0..1
  range DC_AB_Gurtschloss_Reihe2_BF: raw 0..3
  range DC_AB_Gurtschloss_Reihe2_FA: raw 0..3
  range DC_AB_Gurtschloss_Reihe2_MI: raw 0..3
  range DC_AB_Gurtschloss_Reihe3_BF: raw 0..3
  range DC_AB_Gurtschloss_Reihe3_FA: raw 0..3
  range DC_AB_Gurtschloss_Reihe3_MI: raw 0..3
  range DC_AB_Gurtschloss_Reihe4_BF: raw 0..3
  range DC_AB_Gurtschloss_Reihe4_FA: raw 0..3
  range DC_AB_Gurtschloss_Reihe4_MI: raw 0..3
  range DC_AB_Gurtwarn_Reihe2_BF: raw 0..3
  range DC_AB_Gurtwarn_Reihe2_FA: raw 0..3
  range DC_AB_Gurtwarn_Reihe2_MI: raw 0..3
  range DC_AB_Gurtwarn_Reihe3_BF: raw 0..3
  range DC_AB_Gurtwarn_Reihe3_FA: raw 0..3
  range DC_AB_Gurtwarn_Reihe3_MI: raw 0..3
  range DC_AB_Gurtwarn_VB: raw 0..1
  range DC_AB_Gurtwarn_VF: raw 0..1
  range DC_AB_Heck_Crash: raw 0..1
  range DC_AB_Lampe: raw 0..1
  range DC_AB_MKB_Anforderung: raw 0..1
  range DC_AB_Rollover_Crash: raw 0..1
  range DC_AB_SB_Crash: raw 0..1
  range DC_AB_SF_Crash: raw 0..1
  range DC_AB_Sitzpos_Sens_BF: raw 0..3
  range DC_AB_Sitzpos_Sens_FA: raw 0..3
  range DC_AB_Stellgliedtest: raw 0..1
  range DC_AB_Systemfehler: raw 0..1
  range DC_AB_Versorgungsspannung: raw 0..1
  range DC_Airbag_10_BZ: phys 0..15, raw 0..15
  range DC_Airbag_10_CRC: phys 0..255, raw 0..255
  range DC_ClampControl_01_BZ: phys 0..15, raw 0..15
  range DC_ClampControl_01_CRC: phys 0..255, raw 0..255
  range DC_DGN_Verlernzaehler: phys 0..254, raw 0..255
  range DC_DPM_01_BZ: phys 0..15, raw 0..15
  range DC_DPM_01_CRC: phys 0..255, raw 0..255
  range DC_DPM_FlgStrtNeutHldPha: raw 0..1
  range DC_DPM_StDispDrvPosn: raw 0..7
  range DC_DPM_StLghtDrvPosn: raw 0..15
  range DC_DPM_StTarDrvPosn: raw 0..4
  range DC_DS_RSG_ConfDTCChanged: raw 0..1
  range DC_DS_RSG_DiagAdr: phys 0..65535, raw 0..65535
  range DC_DS_RSG_IdentValid: raw 0..1
  range DC_DS_RSG_MemSel10Changed: raw 0..1
  range DC_DS_RSG_MemSelChanged: raw 0..1
  range DC_DS_RSG_StMemChanged: raw 0..1
  range DC_DS_RSG_TestFailedChanged: raw 0..1
  range DC_DS_RSG_WIRChanged: raw 0..1
  range DC_EKK_HVK_EoHVL_Status: raw 0..3
  range DC_EKK_HVK_Fehler_intern: raw 0..1
  range DC_EKK_HVK_Status_Spgfreiheit: raw 0..3
  range DC_ELM5_HVK_Fehler_AE: raw 0..1
  range DC_ELM5_IAct: phys -1023..1023.5, raw 0..4095
  range DC_ELM5_IMaxAbs: phys 0..2044, raw 0..1023
  range DC_ELM5_PrctPrfPwrMax: phys 0..203.2, raw 0..255
  range DC_ELM5_PrctPrfTElm: phys 0..203.2, raw 0..255
  range DC_ELM5_PrctPrfTInv: phys 0..203.2, raw 0..255
  range DC_ELM5_PrctPrfTqMax: phys 0..203.2, raw 0..255
  range DC_ELM5_PwrContGen: phys 0..819000, raw 0..8191
  range DC_ELM5_PwrContMot: phys 0..819000, raw 0..8191
  range DC_ELM5_PwrMecBasGen: phys 0..819000, raw 0..8191
  range DC_ELM5_PwrMecBasMot: phys 0..819000, raw 0..8191
  range DC_ELM5_PwrMecNom: phys 0..819000, raw 0..8191
  range DC_ELM5_SpdAct: phys -10000..55533, raw 0..65535
  range DC_ELM5_SpdMaxDes: phys -10000..71880, raw 0..4095
  range DC_ELM5_StCpbDrv: raw 0..5
  range DC_ELM5_StIntvSpd: raw 0..3
  range DC_ELM5_StOpm: raw 0..15
  range DC_ELM5_StReqElmCal: raw 0..2
  range DC_ELM5_TOil: phys -40..276.25, raw 0..255
  range DC_ELM5_TqAct: phys -1023.5..1023, raw 0..4095
  range DC_ELM5_TqBasMax: phys -1023.5..1023.5, raw 0..4095
  range DC_ELM5_TqBasMin: phys -1023.5..1023.5, raw 0..4095
  range DC_ELM5_TqGnr: phys 0..255, raw 0..511
  range DC_ELM5_TqIntnlActLimSp: phys -1023.5..1023.5, raw 0..4095
  range DC_ELM5_TqLimMax: phys -1023.5..1023.5, raw 0..4095
  range DC_ELM5_TqLimMin: phys -1023.5..1023.5, raw 0..4095
  range DC_ELM5_TqMax: phys -1023.5..1023.5, raw 0..4095
  range DC_ELM5_TqMin: phys -1023.5..1023.5, raw 0..4095
  range DC_ELM5_TqNomMax: phys 0..1023, raw 0..2047
  range DC_ELM5_TqPeakMax: phys -1023.5..1023.5, raw 0..4095
  range DC_ELM5_TqPeakMin: phys -1023.5..1023.5, raw 0..4095
  range DC_ELM5_TqSpdCtl: phys -1023.5..1023.5, raw 0..4095
  range DC_ELM5_TqTotMax: phys -1023.5..1023.5, raw 0..4095
  range DC_ELM5_TqTotMin: phys -1023.5..1023.5, raw 0..4095
  range DC_ELM5_UAct: phys 0..2046.5, raw 0..4095
  range DC_ELM5_VfOilElmDes: phys 0..25.2, raw 0..127
  range DC_ETMT_FlgReqExtdRng: raw 0..1
  range DC_ETMTElm1_03_BZ: phys 0..15, raw 0..15
  range DC_ETMTElm1_03_CRC: phys 0..255, raw 0..255
  range DC_ETMTElm1_PwrGnrAux: phys 0..25400, raw 0..255
  range DC_ETMTElm1_ULimMax: phys 0..2047, raw 0..4095
  range DC_ETMTElm1_ULimMin: phys 0..2047, raw 0..4095
  range DC_ETMTElm1_UMinChrg: phys 0..2047, raw 0..4095
  range DC_ETMTElm1_UMinDschrg: phys 0..2047, raw 0..4095
  range DC_ETMTElm5_ILimMax: phys -1023..1024, raw 0..4095
  range DC_ETMTElm5_ILimMin: phys -1023..1024, raw 0..4095
  range DC_ETMTElm5_Kp_SpdCtl: phys -4..3.984375, raw 0..1023
  range DC_ETMTElm5_PwrGen: phys -819000..819200, raw 0..16383
  range DC_ETMTElm5_PwrGnrAux: phys 0..25400, raw 0..255
  range DC_ETMTElm5_PwrMot: phys -819000..819200, raw 0..16383
  range DC_ETMTElm5_PwrTotGen: phys -819000..819200, raw 0..16383
  range DC_ETMTElm5_PwrTotMot: phys -819000..819200, raw 0..16383
  range DC_ETMTElm5_SpdDes: phys -10000..55534, raw 0..65535
  range DC_ETMTElm5_SpdMax: phys -10000..55534, raw 0..65535
  range DC_ETMTElm5_SpdMin: phys -10000..55534, raw 0..65535
  range DC_ETMTElm5_StDcLnk: raw 1..7
  range DC_ETMTElm5_StOpmDes: raw 0..15
  range DC_ETMTElm5_TqDes: phys -1023.5..1023.5, raw 0..4095
  range DC_ETMTElm5_TqLimMaxSpdCtl: phys -1023.5..1023.5, raw 0..4095
  range DC_ETMTElm5_TqLimMinSpdCtl: phys -1023.5..1023.5, raw 0..4095
  range DC_ETMTElm5_UDcLnk: phys 0..2046, raw 0..4095
  range DC_ETMTElm5_ULimMax: phys 0..2047, raw 0..4095
  range DC_ETMTElm5_ULimMin: phys 0..2047, raw 0..4095
  range DC_ETMTElm5_UMinChrg: phys 0..2047, raw 0..4095
  range DC_ETMTElm5_UMinDschrg: phys 0..2047, raw 0..4095
  range DC_ETMTElm5_VfOilElm: phys 0..25, raw 0..127
  range DC_GW_KD_Fehler: raw 0..1
  range DC_HV_Bordnetz_aktiv: raw 0..1
  range DC_HV_Bordnetz_Fehler: raw 0..1
  range DC_HV_Heizer_Status: raw 0..3
  range DC_HVHL_HVK_EoHVL_Status: raw 0..3
  range DC_HVHL_HVK_Fehler_intern: raw 0..1
  range DC_HVHL_HVK_Status_Spgfreiheit: raw 0..3
  range DC_HVK_01_BZ: phys 0..15, raw 0..15
  range DC_HVK_01_CRC: phys 0..255, raw 0..255
  range DC_HVK_ADC_Sollmodus: raw 0..3
  range DC_HVK_AIAD_Sollmodus: raw 0..3
  range DC_HVK_AktiveEntladung_Anf: raw 0..1
  range DC_HVK_BMC_Sollmodus: raw 0..7
  range DC_HVK_BMC_Spannung_Anf: raw 0..3
  range DC_HVK_DCDC_EKK_Sollmodus: raw 0..3
  range DC_HVK_DCDC_Sollmodus: raw 0..7
  range DC_HVK_EKK_Sollmodus: raw 0..7
  range DC_HVK_ETM_Freigabe: raw 0..3
  range DC_HVK_Gesamtst_Spgfreiheit: raw 0..3
  range DC_HVK_HV_Netz_Warnungen: raw 0..3
  range DC_HVK_HV_Netz_Zustand: raw 0..15
  range DC_HVK_HVHL_Sollmodus: raw 0..3
  range DC_HVK_HVHW_Sollmodus: raw 0..3
  range DC_HVK_HVLM_Sollmodus: raw 0..7
  range DC_HVK_HVPTC_Sollmodus: raw 0..7
  range DC_HVK_Iso_Messung_Start: raw 0..4
  range DC_HVK_Istmodus_Anf: raw 0..1
  range DC_HVK_Notabschaltung_Anf: raw 0..3
  range DC_HVK_PPulsFreigabe: raw 0..3
  range DC_HVK_Vorladung_aktiv: raw 0..1
  range DC_KL_Verdampfertemperatur: phys -20..70, raw 0..1023
  range DC_KL_ZZ_Betriebsmodus: raw 0..4
  range DC_KL_ZZ_Minute: phys 0..59, raw 0..59
  range DC_KL_ZZ_Monat: phys 1..12, raw 0..12
  range DC_KL_ZZ_Status_Timer: raw 0..1
  range DC_KL_ZZ_Stunde: phys 0..23, raw 0..23
  range DC_KL_ZZ_Tag: phys 1..31, raw 0..31
  range DC_KN_RSG_BusKnockOut: raw 0..3
  range DC_KN_RSG_BusKnockOutTimer: phys 0..254, raw 0..255
  range DC_KN_RSG_DiagPfad: raw 0..1
  range DC_KN_RSG_ECUKnockOut: raw 0..3
  range DC_KN_RSG_ECUKnockOutTimer: phys 0..62, raw 0..63
  range DC_Kompressor_Status: raw 0..3
  range DC_KST_Anf_Klemmenfreigabe_ELV: raw 0..1
  range DC_KST_Ausparken_Betrieb: raw 0..1
  range DC_KST_aut_Abschaltung_Zuendung: raw 0..1
  range DC_KST_Fahrerhinweis_{1..6}: raw 0..1
  range DC_KST_KL_15: raw 0..1
  range DC_KST_Kl_50_Startanforderung: raw 0..1
  range DC_KST_Kl_S: raw 0..1
  range DC_KST_Remotestart_KL15_Anf: raw 0..1
  range DC_KST_StPtAcvReq: raw 0..2
  range DC_KST_StPtDeacReq: raw 0..1
  range DC_KST_Txt_Komfortabschaltung: raw 0..1
  range DC_KST_Txt_P_Gang: raw 0..1
  range DC_KST_Txt_Panikabschaltung: raw 0..1
  range DC_KST_Unterdr_Zuendungsmeldung: raw 0..1
  range DC_KST_Warn_P1_ZST_def: raw 0..1
  range DC_KST_Warn_P2_ZST_def: raw 0..1
  range DC_KST_ZAT_betaetigt: raw 0
  range DC_MVK_01_BZ: phys 0..15, raw 0..15
  range DC_MVK_01_CRC: phys 0..255, raw 0..255
  range DC_MVK_BMS_Sollmodus: raw 0..7
  range DC_MVK_DCDC_Sollmodus_02: raw 0..11
  range DC_MVK_ETM_Freigabe: raw 0..3
  range DC_MVK_Istmodus_Anf: raw 0..1
  range DC_MVK_MV_Netz_Zustand: raw 0..15
  range DC_NM_HCP_1_CBV_AWB: raw 0..1
  range DC_NM_HCP_1_CBV_CRI: raw 0..1
  range DC_NM_HCP_1_FCAB: raw 0..2147483648
  range DC_NM_HCP_1_NM_aktiv_CABaktiv: raw 0..1
  range DC_NM_HCP_1_NM_aktiv_Diag: raw 0..1
  range DC_NM_HCP_1_NM_aktiv_KL15: raw 0..1
  range DC_NM_HCP_1_NM_aktiv_Tmin: raw 0..1
  range DC_NM_HCP_1_NM_State: raw 0..32
  range DC_NM_HCP_1_SNI_10: raw 271
  range DC_NM_HCP_1_UDS_CC: raw 0..1
  range DC_NM_HCP_1_Wakeup: raw 0..2
  range DC_NM_RSG_CBV_AWB: raw 0..1
  range DC_NM_RSG_CBV_CRI: raw 0..1
  range DC_NM_RSG_FCAB: raw 0..36028797018963968
  range DC_NM_RSG_FCIB: raw 0..36028797018963968
  range DC_NM_RSG_NM_aktiv_Diag: raw 0..1
  range DC_NM_RSG_NM_aktiv_KL15: raw 0..1
  range DC_NM_RSG_NM_aktiv_Kuehlung: raw 0..1
  range DC_NM_RSG_NM_aktiv_Tmin: raw 0..1
  range DC_NM_RSG_NM_State: raw 0..32
  range DC_NM_RSG_SNI_10: raw 133
  range DC_NM_RSG_UDS_CC: raw 0..1
  range DC_NM_RSG_Wakeup: raw 0..2
  range DC_PreCrash_Tueren_Verriegeln: raw 0..1
  range DC_Relais_VoKo_angesteuert: raw 0..1
  range DC_RSG_KD_Fehler: raw 0..1
  range DC_RSG_SNI_10: raw 133
  range DC_RSt_Anforderung_HMS: raw 0..6
  range DC_RSt_Fahrerhinweise: raw 0..15
  range DC_SI_Diagnose_Aktiv: raw 0..1
  range DC_SI_NWDF: raw 0..1
  range DC_SI_NWDF_30: raw 0..1
  range DC_SI_NWDF_gueltig: raw 0..1
  range DC_SI_P_Mode: raw 0..1
  range DC_SI_P_Mode_gueltig: raw 0..1
  range DC_SI_QRS_Mode: raw 0..1
  range DC_SI_Sammel_SG_Fehler: phys 0..60, raw 0..63
  range DC_SI_Sammelfehler: raw 0..1
  range DC_SI_T_Mode: raw 0..1
  range DC_SI_T_Schutz: raw 0..1
  range DC_Thermo_Verbrauch_BTL: phys 0..8191, raw 0..8191
  range DC_Thermo_Verbrauch_BTL_Ueberlauf: raw 0..1
  range DC_Thermo_Verbrauch_Innen: phys 0..8191, raw 0..8191
  range DC_Thermo_Verbrauch_Innen_Ueberlauf: raw 0..1
  range DC_TME_EKK_Istmodus: raw 0..7
  range DC_TME_ELM{1..3}_IstVolumenstrom: phys 0..14.5, raw 0..31
  range DC_TME_HV_IstLeistung: phys 0..25450, raw 0..511
  range DC_TME_HVEM_HV_Anf: raw 0..3
  range DC_TME_HVEM_Minleistung: phys 0..25450, raw 0..511
  range DC_TME_HVEM_Wunschleistung: phys 0..25450, raw 0..511
  range DC_TME_HVHL_Istmodus: raw 0..7
  range DC_TME_HVHL_verfuegbar: raw 0..1
  range DC_TME_HVHW_Ansteuerung_Soll: phys 0..100, raw 0..255
  range DC_TME_HVHW_SollModus: raw 0..3
  range DC_TME_IPB_Status_Kuehlung: raw 0..1
  range DC_TME_IstSpannung_EKK_HV: phys 0..508, raw 0..255
  range DC_TME_Klimaanforderung: raw 0..3
  range DC_TME_NT_Kreis_Status: raw 0..1
  range DC_TME_OBD_Lampe_Anf: raw 0..1
  range DC_TME_Temp_KM_vor_LE: phys -48..141.75, raw 0..255
  range DC_TME_Temp_nach_Heizung_Front: phys -20..82.1, raw 0..1023
  range DC_TME_Temp_nach_HVH_Heizk1_1: phys -20..82.1, raw 0..1023
  range DC_TME_Temp_nach_HVH_Heizk1_2: phys -20..82.1, raw 0..1023
  range DC_TME_Temp_nach_HVH_Heizk2_1: phys -20..82.1, raw 0..1023
  range DC_TME_Temp_nach_HVH_Heizk2_2: phys -20..82.1, raw 0..1023
  range DC_TME_Temp_nach_HVH_Heizk3_1: phys -20..82.1, raw 0..1023
  range DC_TME_Temp_nach_HVH_Heizk3_2: phys -20..82.1, raw 0..1023
  range DC_TME_Temp_nach_HVH_Heizk4_1: phys -20..82.1, raw 0..1023
  range DC_TME_Temp_nach_HVH_Heizk4_2: phys -20..82.1, raw 0..1023
  range DC_TME_Temp_nach_Verdampfer_Front: phys -20..70, raw 0..1023
  range DC_TME_Verbrauch_gesamt: phys 0..4095, raw 0..4095
  range DC_TME_Verbrauch_gesamt_Ueberlauf: raw 0..1
  range DC_UH_Jahr: phys 2000..2127, raw 0..127
  range DC_UH_Minute: phys 0..59, raw 0..59
  range DC_UH_Monat: phys 1..12, raw 0..15
  range DC_UH_Sekunde: phys 0..59, raw 0..59
  range DC_UH_Stunde: phys 0..23, raw 0..23
  range DC_UH_Tag: phys 1..31, raw 0..31
  range DC_VDSO_02_BZ: phys 0..15, raw 0..15
  range DC_VDSO_02_CRC: phys 0..255, raw 0..255
  range DC_VDSO_ALgtOfsCmp: phys -163.84..163.825, raw 0..65535
  range DC_VDSO_VWhlSpdFrLe: phys -127.7874..127.7913, raw 0..65535
  range DC_VDSO_VWhlSpdFrRi: phys -127.7874..127.7913, raw 0..65535
  range DC_VDSO_VWhlSpdReLe: phys -127.7874..127.7913, raw 0..65535
  range DC_VDSO_VWhlSpdReRi: phys -127.7874..127.7913, raw 0..65535
  range DC_VDSO_Vx3d: phys -127.7874..127.7913, raw 0..65535
  range DC_VDSO_Vx3dKmph: phys -458.724..458.738, raw 0..65535
  range DC_Vehicle_Driving_Cycle: raw 0..1
  range DC_Waermepumpe_Status: raw 0..3
  range DC_ZM_Fahrzeugabstellzeit: phys 0..16372, raw 0..4095
  range DC_ZM_Fahrzeugabstellzeit_Status: raw 0..3
  range DC_ZM_HV_Auszeit: phys 0..16372, raw 0..4095
  range DC_ZM_HV_Auszeit_Status: raw 0..3
  range DC_ZM_Standzeit: phys 0..131068, raw 0..131071
package /Unit
  19 x unit:
    Unit_Unit_Volt: display-name=Unit_Volt, factor-si-to-unit=1, offset-si-to-unit=0
    Unit_Unit_None: display-name=Unit_None, factor-si-to-unit=1, offset-si-to-unit=0
    Unit_Unit_Hours: display-name=Unit_Hours, factor-si-to-unit=0.0002778, offset-si-to-unit=0
    Unit_Unit_PerCent: display-name=Unit_PerCent, factor-si-to-unit=1, offset-si-to-unit=0
    Unit_Unit_DegreCelsi: display-name=Unit_DegreCelsi, factor-si-to-unit=1, offset-si-to-unit=-273.2
    Unit_Unit_MeterPerSeconSquar: display-name=Unit_MeterPerSeconSquar, factor-si-to-unit=1, offset-si-to-unit=0
    Unit_Unit_Secon: display-name=Unit_Secon, factor-si-to-unit=1, offset-si-to-unit=0
    Unit_Unit_Watt: display-name=Unit_Watt, factor-si-to-unit=1, offset-si-to-unit=0
    Unit_Unit_Amper: display-name=Unit_Amper, factor-si-to-unit=1, offset-si-to-unit=0
    Unit_Unit_MinutInver: display-name=Unit_MinutInver, factor-si-to-unit=60, offset-si-to-unit=0
    Unit_Unit_NewtoMeter: display-name=Unit_NewtoMeter, factor-si-to-unit=1, offset-si-to-unit=0
    Unit_Unit_LiterPerMinut: display-name=Unit_LiterPerMinut, factor-si-to-unit=60000, offset-si-to-unit=0
    Unit_Unit_Day: display-name=Unit_Day, factor-si-to-unit=1.157E-05, offset-si-to-unit=0
    Unit_Unit_Minut: display-name=Unit_Minut, factor-si-to-unit=60, offset-si-to-unit=0
    Unit_Unit_Month: display-name=Unit_Month, factor-si-to-unit=3.805E-07, offset-si-to-unit=0
    Unit_Unit_Year: display-name=Unit_Year, factor-si-to-unit=3.16887646E-08, offset-si-to-unit=0
    Unit_Unit_WattSecond: display-name=Unit_WattSecond, factor-si-to-unit=1, offset-si-to-unit=0
    Unit_Unit_KiloMeterPerHour: display-name=Unit_KiloMeterPerHour, factor-si-to-unit=3.6, offset-si-to-unit=0
    Unit_Unit_MeterPerSecon: display-name=Unit_MeterPerSecon, factor-si-to-unit=1, offset-si-to-unit=0
package /Semantics
  compu method CM_AB_Abschaltanf_SIH_BF: 1=Cx1_Abschaltung_angefordert, 0=Cx0_Normalbetrieb
  compu method CM_AB_Anzeige_Fussg: 0=Cx0_keine_FSG_Aktion_ausgeloest, 1=Cx1_Motorhaube_offen, 2=Cx2_Systemfehler
  compu method CM_AB_Belegung_VB: 1=Cx1_Fehler, 0=Cx0_nicht_verfuegbar, 2=Cx2_nicht_belegt, 3=Cx3_belegt
  compu method CM_AB_Belegung_VF: 1=Cx1_Fehler, 0=Cx0_nicht_verfuegbar, 2=Cx2_nicht_belegt, 3=Cx3_belegt
  compu method CM_AB_Belegung_VF_ext: 7=Cx7_Fehler, 3=Cx3_belegt, 4=Cx4_dauerhaft_nicht_belegt, 0=Cx0_nicht_verbaut, 2=Cx2_nicht_belegt, 1=Cx1_reserviert, 6=Cx6_Init, 5=Cx5_dauerhaft_belegt
  compu method CM_AB_Belegung_VF_ext_aktiv: 0=Cx0_inaktiv, 1=Cx1_aktiv
  compu method CM_AB_Crash_Int: 3=Cx3_Crash_Intensitaet_2_nur_D4_C7_Colorado_NF_PAG_Crash_im_MLB_B8 (Crash_Intensitaet_2_(nur_D4_C7_Colorado_NF_PAG__Crash_im_MLB_B8)), 1=Cx1_Crash_Intensitaet_1, 5=Cx5_Crash_Intensitaet_3_alt_PAG (Crash_Intensitaet_3_(alt_PAG)), 7=Cx7_Crash_Intensitaet_3, 0=Cx0_kein_Crash, 2=Cx2_Crash_Intensitaet_2_nur_Stellgliedtest_MLB_B8 (Crash_Intensitaet_2_(nur_Stellgliedtest_MLB_B8)), 4=Cx4_Crash_Intensitaet_3_alt_VW_AUDI_Stellgliedtest_MLB_B8 (Crash_Intensitaet_3_(alt_VW/AUDI__Stellgliedtest_MLB_B8))
  compu method CM_AB_Deaktivierung_HV: 7=Cx7_Fehler, 0=Cx0_keine_Deaktivierung, 1=Cx1_Deaktivierung_1, 2=Cx2_Deaktivierung_2, 3=Cx3_Deaktivierung_3, 4=Cx4_Deaktivierung_4, 5=Cx5_Deaktivierung_5, 6=Cx6_Deaktivierung_6
  compu method CM_AB_Erh_Auf_VB: 2=Cx2_Beifahrerairbag_aktiviert, 1=Cx1_Beifahrerairbag_deaktiviert, 3=Cx3_nicht_definiert, 0=Cx0_keine_Anzeige
  compu method CM_AB_Front_Crash: 1=Cx1_Front_Crash, 0=Cx0_kein_Front_Crash
  compu method CM_AB_Gurtschloss_BF: 3=Cx3_gesteckt, 2=Cx2_nicht_gesteckt, 0=Cx0_nicht_verbaut, 1=Cx1_nicht_verfuegbar_Fehler_oder_Init (nicht_verfügbar (Fehler oder Init))
  compu method CM_AB_Gurtschloss_FA: 3=Cx3_gesteckt, 2=Cx2_nicht_gesteckt, 0=Cx0_nicht_verbaut, 1=Cx1_nicht_verfuegbar_Fehler_oder_Init (nicht_verfügbar (Fehler oder Init))
  compu method CM_AB_Gurtschloss_FA_ext: 7=Cx7_Fehler, 2=Cx2_nicht_gesteckt, 6=Cx6_Init, 1=Cx1_reserviert, 3=Cx3_gesteckt, 4=Cx4_dauerhaft_nicht_gesteckt, 0=Cx0_nicht_verbaut, 5=Cx5_dauerhaft_gesteckt
  compu method CM_AB_Gurtschloss_FA_ext_aktiv: 1=Cx1_aktiv, 0=Cx0_inaktiv
  compu method CM_AB_Gurtschloss_Reihe2_BF: 3=Cx3_gesteckt, 2=Cx2_nicht_gesteckt, 0=Cx0_nicht_verbaut, 1=Cx1_nicht_verfuegbar_Fehler_oder_Init (nicht_verfügbar (Fehler oder Init))
  compu method CM_AB_Gurtschloss_Reihe2_FA: 3=Cx3_gesteckt, 2=Cx2_nicht_gesteckt, 0=Cx0_nicht_verbaut, 1=Cx1_nicht_verfuegbar_Fehler_oder_Init (nicht_verfügbar (Fehler oder Init))
  compu method CM_AB_Gurtschloss_Reihe2_MI: 3=Cx3_gesteckt, 2=Cx2_nicht_gesteckt, 0=Cx0_nicht_verbaut, 1=Cx1_nicht_verfuegbar_Fehler_oder_Init (nicht_verfügbar (Fehler oder Init))
  compu method CM_AB_Gurtschloss_Reihe3_BF: 3=Cx3_gesteckt, 2=Cx2_nicht_gesteckt, 0=Cx0_nicht_verbaut, 1=Cx1_nicht_verfuegbar_Fehler_oder_Init (nicht_verfügbar (Fehler oder Init))
  compu method CM_AB_Gurtschloss_Reihe3_FA: 3=Cx3_gesteckt, 2=Cx2_nicht_gesteckt, 0=Cx0_nicht_verbaut, 1=Cx1_nicht_verfuegbar_Fehler_oder_Init (nicht_verfügbar (Fehler oder Init))
  compu method CM_AB_Gurtschloss_Reihe3_MI: 3=Cx3_gesteckt, 2=Cx2_nicht_gesteckt, 0=Cx0_nicht_verbaut, 1=Cx1_nicht_verfuegbar_Fehler_oder_Init (nicht_verfügbar (Fehler oder Init))
  compu method CM_AB_Gurtschloss_Reihe4_BF: 3=Cx3_gesteckt, 2=Cx2_nicht_gesteckt, 0=Cx0_nicht_verbaut, 1=Cx1_nicht_verfuegbar_Fehler_oder_Init (nicht_verfügbar (Fehler oder Init))
  compu method CM_AB_Gurtschloss_Reihe4_FA: 3=Cx3_gesteckt, 2=Cx2_nicht_gesteckt, 0=Cx0_nicht_verbaut, 1=Cx1_nicht_verfuegbar_Fehler_oder_Init (nicht_verfügbar (Fehler oder Init))
  compu method CM_AB_Gurtschloss_Reihe4_MI: 3=Cx3_gesteckt, 2=Cx2_nicht_gesteckt, 0=Cx0_nicht_verbaut, 1=Cx1_nicht_verfuegbar_Fehler_oder_Init (nicht_verfügbar (Fehler oder Init))
  compu method CM_AB_Gurtwarn_Reihe2_BF: 2=Cx2_keine_Gurtwarnung_Sitz_belegt, 3=Cx3_Gurtwarnung_Sitz_belegt, 1=Cx1_keine_Gurtwarnung_Sitz_leer, 0=Cx0_nicht_verbaut
  compu method CM_AB_Gurtwarn_Reihe2_FA: 1=Cx1_keine_Gurtwarnung_Sitz_leer, 0=Cx0_nicht_verbaut, 2=Cx2_keine_Gurtwarnung_Sitz_belegt, 3=Cx3_Gurtwarnung_Sitz_belegt
  compu method CM_AB_Gurtwarn_Reihe2_MI: 2=Cx2_keine_Gurtwarnung_Sitz_belegt, 1=Cx1_keine_Gurtwarnung_Sitz_leer, 3=Cx3_Gurtwarnung_Sitz_belegt, 0=Cx0_nicht_verbaut
  compu method CM_AB_Gurtwarn_Reihe3_BF: 3=Cx3_Gurtwarnung_Sitz_belegt, 1=Cx1_keine_Gurtwarnung_Sitz_leer, 2=Cx2_keine_Gurtwarnung_Sitz_belegt, 0=Cx0_nicht_verbaut
  compu method CM_AB_Gurtwarn_Reihe3_FA: 3=Cx3_Gurtwarnung_Sitz_belegt, 1=Cx1_keine_Gurtwarnung_Sitz_leer, 2=Cx2_keine_Gurtwarnung_Sitz_belegt, 0=Cx0_nicht_verbaut
  compu method CM_AB_Gurtwarn_Reihe3_MI: 3=Cx3_Gurtwarnung_Sitz_belegt, 1=Cx1_keine_Gurtwarnung_Sitz_leer, 0=Cx0_nicht_verbaut, 2=Cx2_keine_Gurtwarnung_Sitz_belegt
  compu method CM_AB_Gurtwarn_VB: 1=Cx1_Gurtwarnung_ausloesen, 0=Cx0_keine_Warnung
  compu method CM_AB_Gurtwarn_VF: 1=Cx1_Gurtwarnung_ausloesen, 0=Cx0_keine_Warnung
  compu method CM_AB_Heck_Crash: 1=Cx1_Heck_Crash, 0=Cx0_kein_Heck_Crash
  compu method CM_AB_Lampe: 0=Cx0_Aus, 1=Cx1_Ein
  compu method CM_AB_MKB_Anforderung: 0=Cx0_Multikollisionsbremsung_nicht_angefordert, 1=Cx1_Multikollisionsbremsung_angefordert
  compu method CM_AB_Rollover_Crash: 0=Cx0_kein_Rollover, 1=Cx1_Rollover
  compu method CM_AB_SB_Crash: 0=Cx0_kein_Seiten_Crash_Beifahrer, 1=Cx1_Seiten_Crash_Beifahrer
  compu method CM_AB_SF_Crash: 0=Cx0_kein_Seiten_Crash_Fahrer, 1=Cx1_Seiten_Crash_Fahrer
  compu method CM_AB_Sitzpos_Sens_BF: 1=Cx1_Fehler, 3=Cx3_Sitz_vorne (Sitz vorne), 2=Cx2_Sitz_nicht_vorne (Sitz nicht vorne), 0=Cx0_nicht_verfuegbar (nicht verfügbar)
  compu method CM_AB_Sitzpos_Sens_FA: 1=Cx1_Fehler, 3=Cx3_Sitz_vorne (Sitz vorne), 2=Cx2_Sitz_nicht_vorne (Sitz nicht vorne), 0=Cx0_nicht_verfuegbar (nicht verfügbar)
  compu method CM_AB_Stellgliedtest: 0=Cx0_nicht_im_Stellgliedtest, 1=Cx1_Airbag_im_Stellgliedtest
  compu method CM_AB_Systemfehler: 0=Cx0_kein_Fehler, 1=Cx1_Airbag_Systemfehler
  compu method CM_AB_Versorgungsspannung: 0=Cx0_plausibel, 1=Cx1_unplausibel
  compu method CM_Airbag_10_CRC: phys=raw for raw 0..255; unit Unit_None
  compu method CM_ClampControl_01_BZ: phys=raw for raw 0..15; unit Unit_None
  compu method CM_DPM_01_BZ: phys=raw for raw 0..15; unit Unit_None
  compu method CM_DPM_01_CRC: phys=raw for raw 0..255; unit Unit_None
  compu method CM_DPM_FlgStrtNeutHldPha: 1=Cx1_StartNeutralHoldPhase, 0=Cx0_NoRequest
  compu method CM_DPM_StDispDrvPosn: 1=Cx1_Park, 3=Cx3_Neutral, 0=Cx0_Init, 2=Cx2_Reverse, 7=Cx7_Error, 4=Cx4_Forward
  compu method CM_DPM_StLghtDrvPosn: 15=Cxf_Fehler, 6=Cx6_N, 8=Cx8_P, 0=Cx0_Init, 12=Cxc_S, 5=Cx5_D, 7=Cx7_R
  compu method CM_DPM_StTarDrvPosn: 3=Cx3_N, 0=Cx0_Init, 4=Cx4_D, 1=Cx1_P, 2=Cx2_R
  compu method CM_DS_RSG_ConfDTCChanged: 0=Cx0_inaktiv, 1=Cx1_aktiv
  compu method CM_DS_RSG_IdentValid: 0=Cx0_inaktiv, 1=Cx1_aktiv
  compu method CM_DS_RSG_MemSel10Changed: 1=Cx1_aktiv, 0=Cx0_inaktiv
  compu method CM_DS_RSG_MemSelChanged: 1=Cx1_aktiv, 0=Cx0_inaktiv
  compu method CM_DS_RSG_StMemChanged: 0=Cx0_inaktiv, 1=Cx1_aktiv
  compu method CM_DS_RSG_TestFailedChanged: 1=Cx1_aktiv, 0=Cx0_inaktiv
  compu method CM_DS_RSG_WIRChanged: 1=Cx1_aktiv, 0=Cx0_inaktiv
  compu method CM_EKK_HVK_EoHVL_Status: 3=Cx3_Fehler, 2=Cx2_Uzwkr_UEoHVL_Schwell (Uzwkr>= UEoHVL_Schwell), 0=Cx0_Init, 1=Cx1_Uzwkr_UEoHVL_Schwell (Uzwkr< UEoHVL_Schwell)
  compu method CM_EKK_HVK_Fehler_intern: 0=Cx0_kein_Fehler (kein Fehler), 1=Cx1_Fehler_aktiv
  compu method CM_EKK_HVK_Status_Spgfreiheit: 3=Cx3_Fehler, 1=Cx1_HV_Komponente_spannungsfrei, 2=Cx2_HV_Komp_nicht_spannungsfrei, 0=Cx0_Init
  compu method CM_ELM5_HVK_Fehler_AE: 0=Cx0_Aktive_Entladung_iO, 1=Cx1_Aktive_Entladung_defekt
  compu method CM_ELM5_IAct: phys=raw*0.5-1023 for raw 0..4093, 4095=Cxfff_Fehler, 4094=Cxffe_Init; unit Unit_Amper
  compu method CM_ELM5_IMaxAbs: phys=raw*2 for raw 0..1022, 1023=Cx3ff_Init; unit Unit_Amper
  compu method CM_ELM5_PrctPrfPwrMax: phys=raw*0.8 for raw 0..254, 255=Cxff_Init; unit Unit_PerCent
  compu method CM_ELM5_PrctPrfTElm: phys=raw*0.8 for raw 0..254, 255=Cxff_Init; unit Unit_PerCent
  compu method CM_ELM5_PrctPrfTInv: phys=raw*0.8 for raw 0..254, 255=Cxff_Init; unit Unit_PerCent
  compu method CM_ELM5_PrctPrfTqMax: phys=raw*0.8 for raw 0..254, 255=Cxff_Init; unit Unit_PerCent
  compu method CM_ELM5_PwrContGen: phys=raw*100 for raw 0..8190, 8191=Cx1fff_Init; unit Unit_Watt
  compu method CM_ELM5_PwrContMot: phys=raw*100 for raw 0..8190, 8191=Cx1fff_Init; unit Unit_Watt
  compu method CM_ELM5_PwrMecBasGen: phys=raw*100 for raw 0..8190, 8191=Cx1fff_Init; unit Unit_Watt
  compu method CM_ELM5_PwrMecBasMot: phys=raw*100 for raw 0..8190, 8191=Cx1fff_Init; unit Unit_Watt
  compu method CM_ELM5_PwrMecNom: phys=raw*100 for raw 0..8190, 8191=Cx1fff_Init; unit Unit_Watt
  compu method CM_ELM5_SpdAct: phys=raw-10000 for raw 0..65533, 65535=Cxffff_Fehler, 65534=Cxfffe_Init; unit Unit_MinutInver
  compu method CM_ELM5_SpdMaxDes: phys=raw*20-10000 for raw 0..4094, 4095=Cxfff_Init; unit Unit_MinutInver
  compu method CM_ELM5_StCpbDrv: 0=Cx0_Init, 1=Cx1_erw_Performance_verfuegbar, 3=Cx3_Leistungsreduzierung_aktiv, 4=Cx4_Warnung_Leistungseinschraenkung, 2=Cx2_norm_Performance_verfuegbar, 5=Cx5_Fehler_Leistungseinschraenkung
  compu method CM_ELM5_StIntvSpd: 3=Cx3_Fehler, 1=Cx1_Eingriff_MaxDrehzahlregler, 2=Cx2_Eingriff_MinDrehzahlregler, 0=Cx0_kein_Eingriff_aktiv
  compu method CM_ELM5_StOpm: 15=Cxf_Fehler, 0=Cx0_Sicherer_Zustand_AKS, 3=Cx3_Spannungsregelung, 6=Cx6_Kalibrieren, 8=Cx8_Sicherer_Zustand_Freilauf, 4=Cx4_Kombinierter_Regelmodus, 2=Cx2_Drehzahlregelung, 14=Cxe_Init
  compu method CM_ELM5_StReqElmCal: 0=Cx0_keine_Anforderung, 2=Cx2_Anf_Randbedingung_erfuellt, 1=Cx1_Anf_Randbedingung_nicht_erfuellt
  compu method CM_ELM5_TOil: phys=raw*1.25-40 for raw 0..253, 255=Cxff_Fehler, 254=Cxfe_Init; unit Unit_DegreCelsi
  compu method CM_ELM5_TqAct: phys=raw*0.5-1023.5 for raw 0..4093, 4095=Cxfff_Fehler, 4094=Cxffe_Init; unit Unit_NewtoMeter
  compu method CM_ELM5_TqBasMax: phys=raw*0.5-1023.5 for raw 0..4094, 4095=Cxfff_Init; unit Unit_NewtoMeter
  compu method CM_ELM5_TqBasMin: phys=raw*0.5-1023.5 for raw 0..4094, 4095=Cxfff_Init; unit Unit_NewtoMeter
  compu method CM_ELM5_TqGnr: phys=raw*0.5 for raw 0..510, 511=Cx1ff_Init; unit Unit_NewtoMeter
  compu method CM_ELM5_TqIntnlActLimSp: phys=raw*0.5-1023.5 for raw 0..4094, 4095=Cxfff_Init; unit Unit_NewtoMeter
  compu method CM_ELM5_TqLimMax: phys=raw*0.5-1023.5 for raw 0..4094, 4095=Cxfff_Init; unit Unit_NewtoMeter
  compu method CM_ELM5_TqLimMin: phys=raw*0.5-1023.5 for raw 0..4094, 4095=Cxfff_Init; unit Unit_NewtoMeter
  compu method CM_ELM5_TqMax: phys=raw*0.5-1023.5 for raw 0..4094, 4095=Cxfff_Init; unit Unit_NewtoMeter
  compu method CM_ELM5_TqMin: phys=raw*0.5-1023.5 for raw 0..4094, 4095=Cxfff_Init; unit Unit_NewtoMeter
  compu method CM_ELM5_TqNomMax: phys=raw*0.5 for raw 0..2046, 2047=Cx7ff_Init; unit Unit_NewtoMeter
  compu method CM_ELM5_TqPeakMax: phys=raw*0.5-1023.5 for raw 0..4094, 4095=Cxfff_Init; unit Unit_NewtoMeter
  compu method CM_ELM5_TqPeakMin: phys=raw*0.5-1023.5 for raw 0..4094, 4095=Cxfff_Init; unit Unit_NewtoMeter
  compu method CM_ELM5_TqSpdCtl: phys=raw*0.5-1023.5 for raw 0..4094, 4095=Cxfff_Init; unit Unit_NewtoMeter
  compu method CM_ELM5_TqTotMax: phys=raw*0.5-1023.5 for raw 0..4094, 4095=Cxfff_Init; unit Unit_NewtoMeter
  compu method CM_ELM5_TqTotMin: phys=raw*0.5-1023.5 for raw 0..4094, 4095=Cxfff_Init; unit Unit_NewtoMeter
  compu method CM_ELM5_UAct: phys=raw*0.5 for raw 0..4093, 4095=Cxfff_Fehler, 4094=Cxffe_Init; unit Unit_Volt
  compu method CM_ELM5_VfOilElmDes: phys=raw*0.2 for raw 0..126, 127=Cx7f_Init; unit Unit_LiterPerMinut
  compu method CM_ETMT_FlgReqExtdRng: 1=Cx1_Anforderung_der_erweiterten_Grenzen_aktiv, 0=Cx0_Inaktiv
  compu method CM_ETMTElm1_03_BZ: phys=raw for raw 0..15; unit Unit_None
  compu method CM_ETMTElm1_03_CRC: phys=raw for raw 0..255; unit Unit_None
  compu method CM_ETMTElm1_PwrGnrAux: phys=raw*100 for raw 0..254, 255=Cxff_Init; unit Unit_Watt
  compu method CM_ETMTElm1_ULimMax: phys=raw*0.5 for raw 0..4094, 4095=Cxfff_Init; unit Unit_Volt
  compu method CM_ETMTElm1_ULimMin: phys=raw*0.5 for raw 0..4094, 4095=Cxfff_Init; unit Unit_Volt
  compu method CM_ETMTElm1_UMinChrg: phys=raw*0.5 for raw 0..4094, 4095=Cxfff_Init; unit Unit_Volt
  compu method CM_ETMTElm1_UMinDschrg: phys=raw*0.5 for raw 0..4094, 4095=Cxfff_Init; unit Unit_Volt
  compu method CM_ETMTElm5_ILimMax: phys=raw*0.5-1023 for raw 0..4094, 4095=Cxfff_Init; unit Unit_Amper
  compu method CM_ETMTElm5_ILimMin: phys=raw*0.5-1023 for raw 0..4094, 4095=Cxfff_Init; unit Unit_Amper
  compu method CM_ETMTElm5_Kp_SpdCtl: phys=raw/128-4 for raw 0..1022, 1023=Cx3ff_Init; unit Unit_None
  compu method CM_ETMTElm5_PwrGen: phys=raw*100-819000 for raw 0..16382, 16383=Cx3fff_Init; unit Unit_Watt
  compu method CM_ETMTElm5_PwrGnrAux: phys=raw*100 for raw 0..254, 255=Cxff_Init; unit Unit_Watt
  compu method CM_ETMTElm5_PwrMot: phys=raw*100-819000 for raw 0..16382, 16383=Cx3fff_Init; unit Unit_Watt
  compu method CM_ETMTElm5_PwrTotGen: phys=raw*100-819000 for raw 0..16382, 16383=Cx3fff_Init; unit Unit_Watt
  compu method CM_ETMTElm5_PwrTotMot: phys=raw*100-819000 for raw 0..16382, 16383=Cx3fff_Init; unit Unit_Watt
  compu method CM_ETMTElm5_SpdDes: phys=raw-10000 for raw 0..65534, 65535=Cxffff_Init; unit Unit_MinutInver
  compu method CM_ETMTElm5_SpdMax: phys=raw-10000 for raw 0..65534, 65535=Cxffff_Init; unit Unit_MinutInver
  compu method CM_ETMTElm5_SpdMin: phys=raw-10000 for raw 0..65534, 65535=Cxffff_Init; unit Unit_MinutInver
  compu method CM_ETMTElm5_StDcLnk: 7=Cx7_Fehler, 6=Cx6_Init, 2=Cx2_aktiviert_Fahrbetrieb, 3=Cx3_aktiviert_Laden, 1=Cx1_deaktiviert
  compu method CM_ETMTElm5_StOpmDes: 3=Cx3_Spannungsregelung, 14=Cxe_Init, 6=Cx6_Kalibrieren, 8=Cx8_Freilauf_Segeln, 4=Cx4_Kombinierter_Regelmodus, 0=Cx0_Sicherer_Zustand_Komponente, 15=Cxf_nicht_verwendet, 2=Cx2_Drehzahlregelung
  compu method CM_ETMTElm5_TqDes: phys=raw*0.5-1023.5 for raw 0..4094, 4095=Cxfff_Init; unit Unit_NewtoMeter
  compu method CM_ETMTElm5_TqLimMaxSpdCtl: phys=raw*0.5-1023.5 for raw 0..4094, 4095=Cxfff_Init; unit Unit_NewtoMeter
  compu method CM_ETMTElm5_TqLimMinSpdCtl: phys=raw*0.5-1023.5 for raw 0..4094, 4095=Cxfff_Init; unit Unit_NewtoMeter
  compu method CM_ETMTElm5_UDcLnk: phys=raw*0.5 for raw 0..4092, 4095=Cxfff_Fehler, 4093=Cxffd_nicht_messbar, 4094=Cxffe_Init; unit Unit_Volt
  compu method CM_ETMTElm5_ULimMax: phys=raw*0.5 for raw 0..4094, 4095=Cxfff_Init; unit Unit_Volt
  compu method CM_ETMTElm5_ULimMin: phys=raw*0.5 for raw 0..4094, 4095=Cxfff_Init; unit Unit_Volt
  compu method CM_ETMTElm5_UMinChrg: phys=raw*0.5 for raw 0..4094, 4095=Cxfff_Init; unit Unit_Volt
  compu method CM_ETMTElm5_UMinDschrg: phys=raw*0.5 for raw 0..4094, 4095=Cxfff_Init; unit Unit_Volt
  compu method CM_ETMTElm5_VfOilElm: phys=raw*0.2 for raw 0..125, 127=Cx7f_Fehler, 126=Cx7e_Init; unit Unit_LiterPerMinut
  compu method CM_GW_KD_Fehler: 1=Cx1_KD_Fehler, 0=Cx0_kein_KD_Fehler
  compu method CM_HV_Bordnetz_aktiv: 0=Cx0_inaktiv, 1=Cx1_aktiv
  compu method CM_HV_Bordnetz_Fehler: 1=Cx1_Fehler, 0=Cx0_kein_Fehler
  compu method CM_HV_Heizer_Status: 3=Cx3_nicht_verfuegbar, 1=Cx1_aktiv, 0=Cx0_nicht_aktiv
  compu method CM_HVHL_HVK_EoHVL_Status: 3=Cx3_Fehler, 0=Cx0_Init, 2=Cx2_Uzwkr_UEoHVL_Schwell (Uzwkr>= UEoHVL_Schwell), 1=Cx1_Uzwkr_UEoHVL_Schwell (Uzwkr< UEoHVL_Schwell)
  compu method CM_HVHL_HVK_Fehler_intern: 0=Cx0_kein_Fehler (kein Fehler), 1=Cx1_Fehler_aktiv
  compu method CM_HVHL_HVK_Status_Spgfreiheit: 3=Cx3_Fehler, 0=Cx0_Init, 1=Cx1_HV_Komponente_spannungsfrei, 2=Cx2_HV_Komp_nicht_spannungsfrei
  compu method CM_HVK_ADC_Sollmodus: 3=Cx3_Init, 0=Cx0_Keine_Freigabe, 1=Cx1_Freigabe, 2=Cx2_Freigabe_ausgesetzt
  compu method CM_HVK_AIAD_Sollmodus: 2=Cx2_Fehler, 0=Cx0_Keine_Freigabe, 1=Cx1_Freigabe, 3=Cx3_Init
  compu method CM_HVK_AktiveEntladung_Anf: 0=Cx0_nicht_angefordert, 1=Cx1_angefordert
  compu method CM_HVK_BMC_Sollmodus: 1=Cx1_HV_On, 0=Cx0_HV_Off, 6=Cx6_DC_Laden, 7=Cx7_Init, 3=Cx3_AC_Laden_erw, 4=Cx4_AC_Laden
  compu method CM_HVK_BMC_Spannung_Anf: 2=Cx2_800V_Spg_Anforderung, 0=Cx0_keine_Spg_Anforderung, 1=Cx1_400V_Spg_Anforderung, 3=Cx3_Init
  compu method CM_HVK_DCDC_EKK_Sollmodus: 2=Cx2_reserviert, 1=Cx1_ein, 0=Cx0_aus, 3=Cx3_Init
  compu method CM_HVK_DCDC_Sollmodus: 0=Cx0_Standby, 3=Cx3_Hochsetzen, 2=Cx2_Tiefsetzen, 1=Cx1_HV_On_Vorladen, 4=Cx4_Pruefpuls_12V, 7=Cx7_Initialisierung
  compu method CM_HVK_EKK_Sollmodus: 0=Cx0_Keine_Freigabe, 7=Cx7_Init, 2=Cx2_Freigabe_ausgesetzt, 1=Cx1_Freigabe
  compu method CM_HVK_ETM_Freigabe: 3=Cx3_Init, 2=Cx2_Freigabe_Sonderbetrieb, 0=Cx0_keine_Freigabe, 1=Cx1_Freigabe
  compu method CM_HVK_Gesamtst_Spgfreiheit: 3=Cx3_Fehler, 2=Cx2_HV_System_nicht_spannungsfrei, 0=Cx0_Funktion_Init_ohne_Funktion (Funktion_Init__ohne_Funktion), 1=Cx1_HV_System_spannungsfrei
  compu method CM_HVK_HV_Netz_Warnungen: 1=Cx1_Warntext_HV_Netz_Anf, 2=Cx2_Fehlertext_HV_Netz_Anf, 0=Cx0_Keine_Warnung, 3=Cx3_Warnung_Kein_Wiederstart_moeglich
  compu method CM_HVK_HV_Netz_Zustand: 14=Cxe_HV_Netz_Entladung (HV-Netz Entladung), 13=Cxd_HV_Netz_Notabschaltung (HV-Netz Notabschaltung), 1=Cx1_HV_Netz_Aktivierung (HV-Netz Aktivierung), 11=Cxb_HV_Netz_Aus_aus_Fehlerfall (HV-Netz Aus aus Fehlerfall), 7=Cx7_HV_Netz_ohne_HV_Speicher (HV-Netz ohne HV-Speicher), 15=CxF_Init, 10=Cxa_keine_Verwendung (keine Verwendung), 2=Cx2_HV_Netz_Diagnose (HV-Netz Diagnose), 9=Cx9_keine_Verwendung (keine Verwendung), 6=Cx6_HV_Netz_DC_Ladebetrieb (HV-Netz DC-Ladebetrieb), 8=Cx8_keine_Verwendung (keine Verwendung), 12=Cxc_HV_Netz_lastfreie_Abschaltung (HV-Netz lastfreie Abschaltung), 0=Cx0_HV_Netz_Aus (HV-Netz Aus), 5=Cx5_HV_Netz_AC_Ladebetrieb (HV-Netz AC-Ladebetrieb), 3=Cx3_HV_Netz_Aktiv (HV-Netz Aktiv), 4=Cx4_HV_Netz_Fahrbetrieb (HV-Netz Fahrbetrieb)
  compu method CM_HVK_HVHL_Sollmodus: 3=Cx3_Init, 2=Cx2_Freigabe_ausgesetzt, 0=Cx0_Keine_Freigabe, 1=Cx1_Freigabe
  compu method CM_HVK_HVHW_Sollmodus: 1=Cx1_Freigabe, 2=Cx2_Freigabe_ausgesetzt, 0=Cx0_Keine_Freigabe, 3=Cx3_Init
  compu method CM_HVK_HVLM_Sollmodus: 0=Cx0_keine_Freigabe, 1=Cx1_Freigabe_Lademanager, 7=Cx7_Init
  compu method CM_HVK_HVPTC_Sollmodus: 7=Cx7_Init, 2=Cx2_Freigabe_ausgesetzt, 1=Cx1_Freigabe, 0=Cx0_Keine_Freigabe
  compu method CM_HVK_Iso_Messung_Start: 2=Cx2_Messung_HV_Netz_2, 1=Cx1_Messung_HV_Netz_1, 0=Cx0_keine_Messung, 4=Cx4_deaktiviert
  compu method CM_HVK_Istmodus_Anf: 1=Cx1_angefordert, 0=Cx0_nicht_angefordert
  compu method CM_HVK_Notabschaltung_Anf: 0=Cx0_keine_Anforderung_Notabschaltung, 3=Cx3_Init, 1=Cx1_Anforderung_Notabschaltung, 2=Cx2_Reserve
  compu method CM_HVK_PPulsFreigabe: 3=Cx3_Init, 1=Cx1_Freigabe, 2=Cx2_Reserve, 0=Cx0_keine_Freigabe
  compu method CM_HVK_Vorladung_aktiv: 1=Cx1_Vorladung_aktiv, 0=Cx0_Vorladung_nicht_aktiv
  compu method CM_KL_Verdampfertemperatur: phys=raw*0.1-20 for raw 0..900, 1023=Cx3ff_Fehler, 1022=Cx3fe_Init; unit Unit_DegreCelsi
  compu method CM_KL_ZZ_Betriebsmodus: 0=Cx0_Do_not_Care, 1=Cx1_ECO, 2=Cx2_Standard, 3=Cx3_Standard_plus, 4=Cx4_Comfort
  compu method CM_KL_ZZ_Minute: phys=raw for raw 0..59; unit Unit_Minut
  compu method CM_KL_ZZ_Monat: phys=raw for raw 1..12, 0=Cx0_Init; unit Unit_Month
  compu method CM_KL_ZZ_Status_Timer: 0=Cx0_Timer_n_aktiv_bzw_loeschen, 1=Cx1_Timer_aktiv_bzw_aktivieren
  compu method CM_KL_ZZ_Stunde: phys=raw for raw 0..23; unit Unit_Hours
  compu method CM_KL_ZZ_Tag: phys=raw for raw 1..31, 0=Cx0_Init; unit Unit_Day
  compu method CM_KN_RSG_BusKnockOut: 2=Cx2_Funktion_ausgeloest, 3=Cx3_Funktion_deaktiviert, 1=Cx1_Veto_aktiv, 0=Cx0_Funktion_nicht_ausgeloest
  compu method CM_KN_RSG_BusKnockOutTimer: phys=raw for raw 0..254, 255=Cxff_BusKnockOut_deaktiviert; unit Unit_None
  compu method CM_KN_RSG_DiagPfad: 1=Cx1_inaktiv, 0=Cx0_aktiv
  compu method CM_KN_RSG_ECUKnockOut: 2=Cx2_Funktion_ausgeloest, 1=Cx1_Veto_war_aktiv, 3=Cx3_Funktion_deaktiviert, 0=Cx0_Funktion_nicht_ausgeloest
  compu method CM_KN_RSG_ECUKnockOutTimer: phys=raw for raw 0..62, 63=Cx3f_ECUKnockOut_deaktiviert; unit Unit_None
  compu method CM_Kompressor_Status: 0=Cx0_nicht_aktiv, 3=Cx3_nicht_verfuegbar, 1=Cx1_aktiv
  compu method CM_KST_Anf_Klemmenfreigabe_ELV: 0=Cx0_nicht_angefordert, 1=Cx1_angefordert
  compu method CM_KST_Ausparken_Betrieb: 0=Cx0_kein_Betrieb, 1=Cx1_Ausparkvorgang_aktiv
  compu method CM_KST_aut_Abschaltung_Zuendung: 1=Cx1_Zuendung_wird_bei_Verl_deaktiviert, 0=Cx0_Zuendung_wird_bei_Verl_nicht_deaktiviert
  compu method CM_KST_Fahrerhinweis_{1..6}: 0=Cx0_inaktiv, 1=Cx1_aktiv
  compu method CM_KST_KL_15: 0=Cx0_aus, 1=Cx1_ein
  compu method CM_KST_Kl_50_Startanforderung: 1=Cx1_KL50_ein_Startwunsch_Fahrer, 0=Cx0_aus
  compu method CM_KST_Kl_S: 1=Cx1_S_Kontakt_ein, 0=Cx0_aus
  compu method CM_KST_Remotestart_KL15_Anf: 0=Cx0_inaktiv, 1=Cx1_aktiv
  compu method CM_KST_StPtAcvReq: 0=Cx0_NoActivationRequest, 2=Cx2_CurrentActivationRequest, 1=Cx1_StoredActivationRequest
  compu method CM_KST_StPtDeacReq: 0=Cx0_NoRequest, 1=Cx1_RequestDeactivatePowertrain
  compu method CM_KST_Txt_Komfortabschaltung: 0=Cx0_inaktiv, 1=Cx1_aktiv
  compu method CM_KST_Txt_P_Gang: 0=Cx0_Aus, 1=Cx1_Ein
  compu method CM_KST_Txt_Panikabschaltung: 0=Cx0_Aus, 1=Cx1_Ein
  compu method CM_KST_Unterdr_Zuendungsmeldung: 0=Cx0_keine_Unterdr_der_Zuendungsmeldung, 1=Cx1_Unterdr_der_Zuendungsmeldung_aktiv
  compu method CM_KST_Warn_P1_ZST_def: 1=Cx1_defekt, 0=Cx0_nicht_defekt
  compu method CM_KST_Warn_P2_ZST_def: 1=Cx1_defekt, 0=Cx0_nicht_defekt
  compu method CM_KST_ZAT_betaetigt: 0=Cx0_Init
  compu method CM_MVK_01_CRC: phys=raw for raw 0..255; unit Unit_None
  compu method CM_MVK_BMS_Sollmodus: 1=Cx1_MV_On, 7=Cx7_Init, 0=Cx0_MV_Off
  compu method CM_MVK_DCDC_Sollmodus_02: 0=Cx0_Standby, 10=Cxa_Tiefsetzen_Notbetrieb, 9=Cx9_MV_On_Notbetrieb, 4=Cx4_Startunterstuetzung_48V, 7=Cx7_Init, 1=Cx1_MV_On, 11=Cxb_Pruefpuls_12V, 3=Cx3_Hochsetzen, 2=Cx2_Tiefsetzen, 6=Cx6_Startunterstuetzung_12V
  compu method CM_MVK_ETM_Freigabe: 3=Cx3_Init, 0=Cx0_keine_Freigabe, 2=Cx2_Freigabe_Sonderbetrieb, 1=Cx1_Freigabe
  compu method CM_MVK_Istmodus_Anf: 0=Cx0_nicht_angefordert, 1=Cx1_angefordert
  compu method CM_MVK_MV_Netz_Zustand: 12=Cxc_lastfreie_Abschaltung, 11=Cxb_Aus_aus_Fehlerfall, 2=Cx2_Diagnose, 15=CxF_Init, 1=Cx1_Aktivierung, 3=Cx3_Aktiv, 4=Cx4_Fahrtbetrieb, 7=Cx7_ohne_MVSpeicher, 0=Cx0_Aus, 13=Cxd_Notabschaltung
  compu method CM_NM_HCP_1_CBV_AWB: 0=Cx0_Passiver_WakeUp, 1=Cx1_Aktiver_WakeUp
  compu method CM_NM_HCP_1_CBV_CRI: 1=Cx1_NM_mit_Clusteranforderungen, 0=Cx0_NM_ohne_Clusteranforderungen
  compu method CM_NM_HCP_1_FCAB: 8388608=Cx800000_Laden, 32=Cx20_Basisfunktion_Querschnitt, 262144=Cx40000_Warnlampen, 134217728=Cx8000000_Onboard_Tester_OBDC, 1=Cx1_CarWakeUp, 524288=Cx80000_Beleuchtung, 4096=Cx1000_Fahrerassistenz, 2097152=Cx200000_Thermomaagement, 16=Cx10_Basisfunktion_KomfortKlimaLicht, 268435456=Cx10000000_Multifunktionslankrad, 131072=Cx20000_Komfort2, 16777216=Cx1000000_HV_Aktivierung, 16384=Cx4000_Sound, 8=Cx8_Basisfunktion_Infotainment, 2147483648=Cx80000000_reserviert, 32768=Cx8000_Nahbereichszugang, 1073741824=Cx40000000_reserviert, 67108864=Cx4000000_Timermaster_Timer, 64=Cx40_Basisfunktion_Konnektivitaet, 33554432=Cx2000000_MV_Aktivierung, 65536=Cx10000_Komfort1, 4194304=Cx400000_VirtuelleAussenspiegel, 2=Cx2_Basisfunktion_AntriebFahrwerk, 256=Cx100_Antrieb, 8192=Cx2000_Displays, 2048=Cx800_Airbag, 1048576=Cx100000_Innenklimatisierung, 128=Cx80_reserviert, 0=Cx0_Init, 536870912=Cx20000000_reserviert, 512=Cx200_Fahrwerk, 4=Cx4_Basisfunktion_Fahrerassistenz, 1024=Cx400_Waehlhebel
  compu method CM_NM_HCP_1_NM_aktiv_CABaktiv: 1=Cx1_Cluster_Min_Req_TimeOfVNSM, 0=Cx0_Inaktiv
  compu method CM_NM_HCP_1_NM_aktiv_Diag: 1=Cx1_Diagnose_aktiv, 0=Cx0_Inaktiv
  compu method CM_NM_HCP_1_NM_aktiv_KL15: 0=Cx0_Inaktiv, 1=Cx1_KL15_EIN
  compu method CM_NM_HCP_1_NM_aktiv_Tmin: 1=Cx1_Mindestaktivzeit, 0=Cx0_Inaktiv
  compu method CM_NM_HCP_1_NM_State: 32=Cx20_reserved, 0=Cx0_Init, 16=Cx10_reserved, 2=Cx2_NM_RM_aus_PBSM, 1=Cx1_NM_RM_aus_BSM, 8=Cx8_NM_NO_aus_RS, 4=Cx4_NM_NO_aus_RM
  compu method CM_NM_HCP_1_SNI_10: 271=Cx10f_HCP_1_SNI
  compu method CM_NM_HCP_1_UDS_CC: 1=Cx1_CC_aktiv, 0=Cx0_Inaktiv
  compu method CM_NM_HCP_1_Wakeup: 1=Cx1_Bus_Wakeup, 2=Cx2_KL15_HW, 0=Cx0_Peripherie_Wakeup_Ursache_nicht_bekannt
  compu method CM_NM_RSG_CBV_AWB: 1=Cx1_Aktiver_WakeUp, 0=Cx0_Passiver_WakeUp
  compu method CM_NM_RSG_CBV_CRI: 1=Cx1_TNB_Layout, 0=Cx0_Standard_Layout
  compu method CM_NM_RSG_FCAB: 1024=Cx400_11_Chassis, 32768=Cx8000_16_Display, 512=Cx200_10_Powertrain, 8388608=Cx800000_24_ThermoManagement, 0=Cx0_Init, 8=Cx8_04_Basefunction_DrivingAssistance, 1048576=Cx100000_21_AirSuspension, 18014398509481984=Cx40000000000000_55_Dimming, 4294967296=Cx100000000_33_ExternalWirelessCommunication, 16=Cx10_05_Basefunction_Infotainment, 2147483648=Cx80000000_32_OnlineAccess, 256=Cx100_09_reserved, 128=Cx80_08_Basefunction_Connectivity, 536870912=Cx20000000_30_EnergyManagement, 2=Cx2_02_Basefunction_Powertrain, 2097152=Cx200000_22_ExteriorLights, 1=Cx1_01_CarWakeUp, 8192=Cx2000_14_InfotainmentExtensions, 32=Cx20_06_Basefunction_ComfortClimateLight, 2048=Cx800_12_GearSelector, 33554432=Cx2000000_26_HighVoltage_Charging, 4=Cx4_03_Basefunction_Chassis, 16777216=Cx1000000_25_AccessSystemSensors, 67108864=Cx4000000_27_Timemaster_Timer, 4096=Cx1000_13_Airbag, 17179869184=Cx400000000_53_Lock_Unlock, 4194304=Cx400000_23_Climate_PreHeater, 1073741824=Cx40000000_31_MultifunctionalSteeringWheel, 131072=Cx20000_18_VirtualSideMirrors, 8589934592=Cx200000000_34_GPS_Localization, 16384=Cx4000_15_InstrumentclusterDisplay, 65536=Cx10000_17_Audio, 36028797018963968=Cx80000000000000_56_ChargingStatus, 64=Cx40_07_Basefunction_CrossSection, 524288=Cx80000_20_OptionalComfort, 262144=Cx40000_19_Doors_Hatches, 134217728=Cx8000000_28_OnboardTester_DataCollector
  compu method CM_NM_RSG_FCIB: 2=Cx2_02_Basefunction_Powertrain, 8388608=Cx800000_24_ThermoManagement, 65536=Cx10000_17_Audio, 32768=Cx8000_16_Display, 1=Cx1_01_CarWakeUp, 16384=Cx4000_15_InstrumentclusterDisplay, 512=Cx200_10_Powertrain, 262144=Cx40000_19_Doors_Hatches, 64=Cx40_07_Basefunction_CrossSection, 1048576=Cx100000_21_AirSuspension, 33554432=Cx2000000_26_HighVoltage_Charging, 36028797018963968=Cx80000000000000_56_ChargingStatus, 2097152=Cx200000_22_ExteriorLights, 134217728=Cx8000000_28_OnboardTester_DataCollector, 8=Cx8_04_Basefunction_DrivingAssistance, 4294967296=Cx100000000_33_ExternalWirelessCommunication, 131072=Cx20000_18_VirtualSideMirrors, 2147483648=Cx80000000_32_OnlineAccess, 18014398509481984=Cx40000000000000_55_Dimming, 8589934592=Cx200000000_34_GPS_Localization, 8192=Cx2000_14_InfotainmentExtensions, 16=Cx10_05_Basefunction_Infotainment, 4194304=Cx400000_23_Climate_PreHeater, 256=Cx100_09_reserved, 536870912=Cx20000000_30_EnergyManagement, 2048=Cx800_12_GearSelector, 4096=Cx1000_13_Airbag, 1073741824=Cx40000000_31_MultifunctionalSteeringWheel, 0=Cx0_Init, 67108864=Cx4000000_27_Timemaster_Timer, 128=Cx80_08_Basefunction_Connectivity, 16777216=Cx1000000_25_AccessSystemSensors, 32=Cx20_06_Basefunction_ComfortClimateLight, 524288=Cx80000_20_OptionalComfort, 17179869184=Cx400000000_53_Lock_Unlock, 1024=Cx400_11_Chassis, 4=Cx4_03_Basefunction_Chassis
  compu method CM_NM_RSG_NM_aktiv_Diag: 1=Cx1_Diagnose_aktiv, 0=Cx0_Inaktiv
  compu method CM_NM_RSG_NM_aktiv_KL15: 1=Cx1_KL15_EIN, 0=Cx0_Inaktiv
  compu method CM_NM_RSG_NM_aktiv_Kuehlung: 1=Cx1_RSG_Kuehlung_aktiv, 0=Cx0_Inaktiv
  compu method CM_NM_RSG_NM_aktiv_Tmin: 1=Cx1_Mindestaktivzeit, 0=Cx0_Inaktiv
  compu method CM_NM_RSG_NM_State: 2=Cx2_NM_RM_aus_PBSM, 0=Cx0_Init, 32=Cx20_NM_RM_aus_NO, 8=Cx8_NM_NO_aus_RS, 16=Cx10_NM_RM_aus_RS, 4=Cx4_NM_NO_aus_RM, 1=Cx1_NM_RM_aus_BSM
  compu method CM_NM_RSG_SNI_10: 133=Cx85_RSG_SNI
  compu method CM_NM_RSG_UDS_CC: 1=Cx1_CC_aktiv, 0=Cx0_Init
  compu method CM_NM_RSG_Wakeup: 2=Cx2_KL15_HW, 1=Cx1_Bus_Wakeup, 0=Cx0_Peripherie_Wakeup_Ursache_nicht_bekannt (Peripherie_Wakeup__Ursache_nicht_bekannt)
  compu method CM_PreCrash_Tueren_Verriegeln: 0=Cx0_keine_Anforderung, 1=Cx1_Tueren_Verriegeln
  compu method CM_Relais_VoKo_angesteuert: 1=Cx1_angesteuert, 0=Cx0_nicht_angesteuert
  compu method CM_RSG_KD_Fehler: 1=Cx1_KD_Fehler, 0=Cx0_kein_KD_Fehler
  compu method CM_RSG_SNI_10: 133=Cx85_RSG_SNI
  compu method CM_RSt_Anforderung_HMS: 1=Cx1_halten, 3=Cx3_halten_Standby, 6=Cx6_Parken_mit_P, 5=Cx5_Loesen_ueber_Rampe, 2=Cx2_parken, 4=Cx4_anfahren, 0=Cx0_keine_Anforderung
  compu method CM_RSt_Fahrerhinweise: 6=Cx6_Fahreruebernahme_Hinweis_ZAS_Automat_mit_Gong, 0=Cx0_Init, 5=Cx5_Fahreruebernahme_Hinweis_ZAS_Automat_ohne_Gong, 15=Cxf_void, 10=Cxa_RemoteStart_aktiv_mit_Gong, 1=Cx1_Fahreruebernahme_Hinweis_ZAT_Automat_ohne_Gong, 2=Cx2_Fahreruebernahme_Hinweis_ZAT_Automat_mit_Gong, 9=Cx9_RemoteStart_aktiv_ohne_Gong, 4=Cx4_Fahreruebernahme_Hinweis_ZAT_Handschalter_mit_Gong, 12=Cxc_void, 11=Cxb_void, 14=Cxe_void, 3=Cx3_Fahreruebernahme_Hinweis_ZAT_Handschalter_ohne_Gong, 13=Cxd_void, 7=Cx7_Fahreruebernahme_Hinweis_ZAS_Handschalter_ohne_Gong, 8=Cx8_Fahreruebernahme_Hinweis_ZAS_Handschalter_mit_Gong
  compu method CM_SI_Diagnose_Aktiv: 0=Cx0_inaktiv, 1=Cx1_aktiv
  compu method CM_SI_NWDF: 1=Cx1_Ueberwachung_freigegeben, 0=Cx0_Ueberwachung_nicht_freigegeben
  compu method CM_SI_NWDF_30: 0=Cx0_Ueberwachung_nicht_freigegeben, 1=Cx1_Ueberwachung_freigegeben
  compu method CM_SI_NWDF_gueltig: 0=Cx0_NWDF_wird_nicht_unterstuetzt, 1=Cx1_NWDF_wird_unterstuetzt
  compu method CM_SI_P_Mode: 0=Cx0_inaktiv, 1=Cx1_aktiv
  compu method CM_SI_P_Mode_gueltig: 1=Cx1_zentraler_Produktionsmode, 0=Cx0_dezentraler_Produktionsmode
  compu method CM_SI_QRS_Mode: 0=Cx0_QRS_Messmodus_nicht_aktiv, 1=Cx1_QRS_Messmodus_aktiv
  compu method CM_SI_Sammelfehler: 0=Cx0_kein_Sammelfehler, 1=Cx1_Sammelfehler
  compu method CM_SI_T_Mode: 0=Cx0_Transportmodus_nicht_aktiv, 1=Cx1_Transportmodus_aktiv
  compu method CM_SI_T_Schutz: 0=Cx0_Transportschutz_nicht_aktiv, 1=Cx1_Transportschutz_aktiv
  compu method CM_Thermo_Verbrauch_BTL: phys=raw for raw 0..8191; unit Unit_WattSecond
  compu method CM_Thermo_Verbrauch_BTL_Ueberlauf: 0=Cx0_kein_Ueberlauf, 1=Cx1_Ueberlauf
  compu method CM_Thermo_Verbrauch_Innen: phys=raw for raw 0..8191; unit Unit_WattSecond
  compu method CM_Thermo_Verbrauch_Innen_Ueberlauf: 0=Cx0_kein_Ueberlauf, 1=Cx1_Ueberlauf
  compu method CM_TME_EKK_Istmodus: 5=Cx5_Fehler, 0=Cx0_Standby, 2=Cx2_Freigabe_ausgesetzt, 1=Cx1_Regelung_aktiv, 7=Cx7_Init
  compu method CM_TME_ELM{1..3}_IstVolumenstrom: phys=raw*0.5 for raw 0..29, 31=Cx1f_Fehler, 30=Cx1e_Init; unit Unit_LiterPerMinut
  compu method CM_TME_HV_IstLeistung: phys=raw*50 for raw 0..509, 511=Cx1ff_Fehler, 510=Cx1fe_Init; unit Unit_Watt
  compu method CM_TME_HVEM_HV_Anf: 3=Cx3_Fehler, 0=Cx0_INIT, 1=Cx1_HV_Netz_nicht_angefordert, 2=Cx2_HV_Netz_angefordert
  compu method CM_TME_HVEM_Minleistung: phys=raw*50 for raw 0..509, 511=Cx1ff_Fehler, 510=Cx1fe_Init; unit Unit_Watt
  compu method CM_TME_HVEM_Wunschleistung: phys=raw*50 for raw 0..509, 511=Cx1ff_Fehler, 510=Cx1fe_Init; unit Unit_Watt
  compu method CM_TME_HVHL_Istmodus: 5=Cx5_Fehler, 1=Cx1_Regelung_aktiv, 0=Cx0_Standby, 2=Cx2_Freigabe_ausgesetzt, 7=Cx7_Init
  compu method CM_TME_HVHL_verfuegbar: 0=Cx0_nicht_verfuegbar, 1=Cx1_verfuegbar
  compu method CM_TME_HVHW_Ansteuerung_Soll: phys=raw for raw 0..100, 255=Cxff_Fehler, 254=Cxfe_Init; unit Unit_PerCent
  compu method CM_TME_HVHW_SollModus: 3=Cx3_Init, 1=Cx1_Freigabe, 2=Cx2_Freigabe_ausgesetzt, 0=Cx0_Keine_Freigabe
  compu method CM_TME_IPB_Status_Kuehlung: 1=Cx1_Fehler, 0=Cx0_kein_Fehler
  compu method CM_TME_IstSpannung_EKK_HV: phys=raw*2 for raw 0..254, 255=Cxff_Init_Not_Avail (Init/ Not Avail); unit Unit_Volt
  compu method CM_TME_Klimaanforderung: 0=Cx0_keine_Anforderung_durch_TME, 1=Cx1_Klimaleistungspraediktion_aktiv, 3=Cx3_Vorkonditionierung_aktiv, 2=Cx2_berechnung_Vorkonditionierung_aktiv
  compu method CM_TME_NT_Kreis_Status: 1=Cx1_Fehler, 0=Cx0_kein_Fehler
  compu method CM_TME_OBD_Lampe_Anf: 0=Cx0_kein_MIL_Request, 1=Cx1_MIL_Request
  compu method CM_TME_Temp_KM_vor_LE: phys=raw*0.75-48 for raw 0..253, 255=Cxff_Fehler, 254=Cxfe_Init; unit Unit_DegreCelsi
  compu method CM_TME_Temp_nach_Heizung_Front: phys=raw*0.1-20 for raw 0..1021, 1023=Cx3ff_Fehler, 1022=Cx3fe_Init; unit Unit_DegreCelsi
  compu method CM_TME_Temp_nach_HVH_Heizk1_1: phys=raw*0.1-20 for raw 0..1021, 1023=Cx3ff_Fehler, 1022=Cx3fe_Init; unit Unit_DegreCelsi
  compu method CM_TME_Temp_nach_HVH_Heizk1_2: phys=raw*0.1-20 for raw 0..1021, 1023=Cx3ff_Fehler, 1022=Cx3fe_Init; unit Unit_DegreCelsi
  compu method CM_TME_Temp_nach_HVH_Heizk2_1: phys=raw*0.1-20 for raw 0..1021, 1023=Cx3ff_Fehler, 1022=Cx3fe_Init; unit Unit_DegreCelsi
  compu method CM_TME_Temp_nach_HVH_Heizk2_2: phys=raw*0.1-20 for raw 0..1021, 1023=Cx3ff_Fehler, 1022=Cx3fe_Init; unit Unit_DegreCelsi
  compu method CM_TME_Temp_nach_HVH_Heizk3_1: phys=raw*0.1-20 for raw 0..1021, 1023=Cx3ff_Fehler, 1022=Cx3fe_Init; unit Unit_DegreCelsi
  compu method CM_TME_Temp_nach_HVH_Heizk3_2: phys=raw*0.1-20 for raw 0..1021, 1023=Cx3ff_Fehler, 1022=Cx3fe_Init; unit Unit_DegreCelsi
  compu method CM_TME_Temp_nach_HVH_Heizk4_1: phys=raw*0.1-20 for raw 0..1021, 1023=Cx3ff_Fehler, 1022=Cx3fe_Init; unit Unit_DegreCelsi
  compu method CM_TME_Temp_nach_HVH_Heizk4_2: phys=raw*0.1-20 for raw 0..1021, 1023=Cx3ff_Fehler, 1022=Cx3fe_Init; unit Unit_DegreCelsi
  compu method CM_TME_Temp_nach_Verdampfer_Front: phys=raw*0.1-20 for raw 0..900, 1023=Cx3ff_Fehler, 1022=Cx3fe_Init; unit Unit_DegreCelsi
  compu method CM_TME_Verbrauch_gesamt: phys=raw for raw 0..4095; unit Unit_WattSecond
  compu method CM_TME_Verbrauch_gesamt_Ueberlauf: 0=Cx0_kein_Ueberlauf, 1=Cx1_Ueberlauf
  compu method CM_UH_Jahr: phys=raw+2000 for raw 0..127; unit Unit_Year
  compu method CM_UH_Minute: phys=raw for raw 0..59; unit Unit_Minut
  compu method CM_UH_Monat: phys=raw for raw 1..12, 15=Cxf_Fehler, 14=Cxe_Relatives_Datum, 0=Cx0_Init; unit Unit_Month
  compu method CM_UH_Sekunde: phys=raw for raw 0..59; unit Unit_Secon
  compu method CM_UH_Stunde: phys=raw for raw 0..23; unit Unit_Hours
  compu method CM_UH_Tag: phys=raw for raw 1..31, 0=Cx0_Init; unit Unit_Day
  compu method CM_VDSO_02_CRC: phys=raw for raw 0..255; unit Unit_None
  compu method CM_VDSO_ALgtOfsCmp: phys=raw*0.005-163.84 for raw 0..65533, 65535=Cxffff_Fehler, 65534=Cxfffe_Init; unit Unit_MeterPerSeconSquar
  compu method CM_VDSO_VWhlSpdFrLe: phys=raw*0.0039-127.7874 for raw 0..65533, 65535=Cxffff_Fehler, 65534=Cxfffe_Init; unit Unit_MeterPerSecon
  compu method CM_VDSO_VWhlSpdFrRi: phys=raw*0.0039-127.7874 for raw 0..65533, 65535=Cxffff_Fehler, 65534=Cxfffe_Init; unit Unit_MeterPerSecon
  compu method CM_VDSO_VWhlSpdReLe: phys=raw*0.0039-127.7874 for raw 0..65533, 65535=Cxffff_Fehler, 65534=Cxfffe_Init; unit Unit_MeterPerSecon
  compu method CM_VDSO_VWhlSpdReRi: phys=raw*0.0039-127.7874 for raw 0..65533, 65535=Cxffff_Fehler, 65534=Cxfffe_Init; unit Unit_MeterPerSecon
  compu method CM_VDSO_Vx3d: phys=raw*0.0039-127.7874 for raw 0..65533, 65535=Cxffff_Fehler, 65534=Cxfffe_init; unit Unit_MeterPerSecon
  compu method CM_VDSO_Vx3dKmph: phys=raw*0.014-458.724 for raw 0..65533, 65535=Cxffff_Fehler, 65534=Cxfffe_init; unit Unit_KiloMeterPerHour
  compu method CM_Vehicle_Driving_Cycle: 1=Cx1_Driving_Cycle_erkannt, 0=Cx0_kein_Driving_Cycle_erkannt
  compu method CM_Waermepumpe_Status: 3=Cx3_nicht_verfuegbar, 1=Cx1_aktiv, 0=Cx0_nicht_aktiv
  compu method CM_ZM_Fahrzeugabstellzeit: phys=raw*4 for raw 0..4093, 4095=Cxfff_Fehler, 4094=Cxffe_Init; unit Unit_Minut
  compu method CM_ZM_Fahrzeugabstellzeit_Status: 2=Cx2_Abstellzeit_Minimalwert, 3=Cx3_Abstellzeit_ungueltig, 1=Cx1_Abstellzeit_berechnet, 0=Cx0_Abstellzeit_nicht_berechnet
  compu method CM_ZM_HV_Auszeit: phys=raw*4 for raw 0..4093, 4095=Cxfff_Fehler, 4094=Cxffe_Init; unit Unit_Minut
  compu method CM_ZM_HV_Auszeit_Status: 1=Cx1_berechnet, 3=Cx3_ungueltig, 0=Cx0_nicht_berechnet, 2=Cx2_Minimalwert
  compu method CM_ZM_Standzeit: phys=raw for raw 0..131068, 131071=Cx1ffff_Fehler, 131069=Cx1fffd_nicht_verfuegbar, 131070=Cx1fffe_Init; unit Unit_Secon
package /DataType/Unit
  24 x unit, all with factor-si-to-unit=1, offset-si-to-unit=0:
    U_A: display-name=A
    U_C: display-name=C
    U_rpm: display-name=rpm
    U_V: display-name=V
    Unit_Minut: display-name=Unit_Minut
    Unit_MinutInver: display-name=Unit_MinutInver
    Unit_Month: display-name=Unit_Month
    Unit_NewtoMeter: display-name=Unit_NewtoMeter
    Unit_NewtoMeterPerSecon: display-name=Unit_NewtoMeterPerSecon
    Unit_None: display-name=Unit_None
    Unit_PerCent: display-name=Unit_PerCent
    Unit_Secon: display-name=Unit_Secon
    Unit_Volt: display-name=Unit_Volt
    Unit_Watt: display-name=Unit_Watt
    Unit_WattHour: display-name=Unit_WattHour
    Unit_Year: display-name=Unit_Year
    Unit_Amper: display-name=Unit_Amper
    Unit_Day: display-name=Unit_Day
    Unit_DegreCelsi: display-name=Unit_DegreCelsi
    Unit_Hours: display-name=Unit_Hours
    Unit_KiloMeter: display-name=Unit_KiloMeter
    Unit_KiloMeterPerHour: display-name=Unit_KiloMeterPerHour
    Unit_KiloWatt: display-name=Unit_KiloWatt
    Unit_Liter: display-name=Unit_Liter
package /DataType/Semantics
  compu method CM_EOP_Actual_Speed: phys=raw*25.5 for raw 0..255; unit rpm
  compu method CM_EOP_Current: phys=raw*0.2 for raw 0..255; unit A
  compu method CM_EOP_RsErr_Fault: 0=Cx0_No_Error, 1=Cx1_Error_Occured
  compu method CM_EOP_Force_Restart: 0=Cx0_DISABLE, 1=Cx1_ENABLE
  compu method CM_EOP_Self_Check_Fault: 0=Cx0_No_Error, 1=Cx1_Error_Occured
  compu method CM_EOP_IQ_Peak: phys=raw*0.3 for raw 0..255; unit A
  compu method CM_EOP_State: 0=Cx0_STOP, 1=Cx1_RUNNING, 2=Cx2_DERATED, 3=Cx3_FAULTY
  compu method CM_EOP_MOS_Temp: phys=raw-40 for raw 0..255; unit C
  compu method CM_EOP_Stuck_Fault: 0=Cx0_No_Error, 1=Cx1_Error_Occured
  compu method CM_EOP_Oil_Temp: phys=raw-40 for raw 0..255; unit C
  compu method CM_EOP_Target_Speed: phys=raw*25.5 for raw 0..255; unit rpm
  compu method CM_EOP_Over_Current_Fault: 0=Cx0_No_Error_, 1=Cx1_Error_Occured
  compu method CM_EOP_Under_Voltage_Fault: 0=Cx0_No_Error, 1=Cx1_Error_Occured
  compu method CM_EOP_Over_Load_Fault: 0=Cx0_No_Derating_, 1=Cx1_Derating_Occured
  compu method CM_EOP_Over_Speed_Fault: 0=Cx0_No_Error, 1=Cx1_Error_Occured
  compu method CM_EOP_Version: identical
  compu method CM_EOP_Over_Temp_Derating: 0=Cx0_No_Derating, 1=Cx1_Derating_Occured
  compu method CM_EOP_Voltage: phys=raw*0.2 for raw 0..255; unit V
  compu method CM_EOP_Over_Temp_Fault: 0=Cx0_No_Error, 1=Cx1_Error_Occured
  compu method CM_EOP_Over_Voltage_Fault: 0=Cx0_No_Error, 1=Cx1_Error_Occured
  compu method CM_EOP_PreShut_Fault: 0=Cx0_No_Error, 1=Cx1_StuckFlt, 2=Cx2_OverSpdFlt, 3=Cx3_OverCurFlt, 4=Cx4_SlfCkFlt, 5=Cx5_RevesFlt
  compu method CM_EOP_Revs_Fault: 0=Cx0_No_Error, 1=Cx1_Error_Occured
  compu method CM_FDR_Allrad_Anteil_max_sek: 510=Cx1FE_Init, 511=Cx1FF_Fehler, phys=raw*0.2 for raw 0..500; unit Unit_PerCent  # Source signal range: [0,500]
  compu method CM_AB_RGS_Anst: 4=Cx4_aktiv_Niveau_1, 5=Cx5_aktiv_Niveau_2, 6=Cx6_aktiv_Niveau_3, 7=Cx7_aktiv_Niveau_4, 8=Cx8_deaktiviert
  compu method CM_FDR_Allrad_Anteil_min_sek: 510=Cx1FE_Init, 511=Cx1FF_Fehler, phys=raw*0.2 for raw 0..500; unit Unit_PerCent  # Source signal range: [0,500]
  compu method CM_FDR_MomRad_Eingriff: 8190=Cx1FFE_Init, 8191=Cx1FFF_Fehler, phys=raw*3-12279 for raw 0..8186; unit Unit_NewtoMeter  # Source signal range: [0,8186]
  compu method CM_FDR_MomRad_Eingriff_sek: 8190=Cx1FFE_Init, 8191=Cx1FFF_Fehler, phys=raw*3-12279 for raw 0..8186; unit Unit_NewtoMeter  # Source signal range: [0,8186]
  compu method CM_FDR_Status_Eingriff: 0=Cx0_kein_Eingriff, 1=Cx1_Eingriff
  compu method CM_AB_Rollover_Crash: 0=Cx0_kein_Rollover, 1=Cx1_Rollover
  compu method CM_FDR_Status_Eingriff_sek: 0=Cx0_kein_Eingriff, 1=Cx1_Eingriff
  compu method CM_FDR_Zwangszusch_ESP: 0=Cx0_keine_ESP_ASR_Beeinflussung, 1=Cx1_ESP_ASR_Beeinflussung
  compu method CM_AB_SB_Crash: 0=Cx0_kein_Seiten_Crash_Beifahrer, 1=Cx1_Seiten_Crash_Beifahrer
  compu method CM_FoD_DTC_TSK_ACC: 0=Cx0_Kein_DTC, 1=Cx1_DTC_vorhanden_oder_in_Quali
  compu method CM_AB_SF_Crash: 0=Cx0_kein_Seiten_Crash_Fahrer, 1=Cx1_Seiten_Crash_Fahrer
  compu method CM_FoD_DTC_TSK_GRA: 0=Cx0_Kein_DTC, 1=Cx1_DTC_vorhanden_oder_in_Quali
  compu method CM_AB_Stellgliedtest: 0=Cx0_nicht_im_Stellgliedtest, 1=Cx1_Airbag_im_Stellgliedtest
  compu method CM_ISA_Regelung_aktiv: 0=Cx0_ISA_Regelung_nicht_aktiv, 1=Cx1_ISA_Regelung_aktiv
  compu method CM_AB_Systemfehler: 0=Cx0_kein_Fehler, 1=Cx1_Airbag_Systemfehler
  compu method CM_ISA_Status: 0=Cx0_ISA_nicht_aktiv, 1=Cx1_Init, 2=Cx2_ISA_degradiert, 3=Cx3_ISA_aktiv, 4=Cx4_reserviert, 5=Cx5_reserviert, 6=Cx6_reserviert, 7=Cx7_reserviert
  compu method CM_AB_Texte_AKS: 0=Cx0_keine_AKS_Ausloesung, 1=Cx1_AKS_ausgeloest, 2=Cx2_AKS_Systemfehler
  compu method CM_ISA_Tempolimitwarnung: 0=Cx0_ISA_keine_Warnung, 1=Cx1_ISA_Warnung_aktiv
  compu method CM_KBI_Kilometerstand: 1048574=CxFFFFE_Init, 1048575=CxFFFFF_Fehler; unit Unit_KiloMeter  # Source signal range: [0,1048573]
  compu method CM_AB_VB_deaktiviert: 0=Cx0_Beifahrerairbag_aktiv, 1=Cx1_Beifahrerairbag_deaktiviert
  compu method CM_Klemmen_Status_01_BZ: identical
  compu method CM_AB_Versorgungsspannung: 0=Cx0_plausibel, 1=Cx1_unplausibel
  compu method CM_Klemmen_Status_01_CRC: identical
  compu method CM_ABS_Bremsung: 0=Cx0_keine_ABS_Regelung, 1=Cx1_ABS_Regelung_aktiv
  compu method CM_KN_RSG_BusKnockOut: 0=Cx0_Funktion_nicht_ausgeloest, 1=Cx1_Veto_aktiv, 2=Cx2_Funktion_ausgeloest, 3=Cx3_Funktion_deaktiviert
  compu method CM_KN_RSG_BusKnockOutTimer: 255=CxFF_BusKnockOut_deaktiviert  # Source signal range: [0,254]
  compu method CM_Airbag_01_BZ: identical
  compu method CM_KN_RSG_DiagPfad: 0=Cx0_aktiv, 1=Cx1_inaktiv
  compu method CM_Airbag_01_CRC: identical
  compu method CM_KN_RSG_ECUKnockOut: 0=Cx0_Funktion_nicht_ausgeloest, 1=Cx1_Veto_war_aktiv, 2=Cx2_Funktion_ausgeloest, 3=Cx3_Funktion_deaktiviert
  compu method CM_ASM_Masterzeit_02: 255=CxFF_Init, phys=raw*0.04 for raw 0..254; unit Unit_Secon  # Source signal range: [0,254]
  compu method CM_KN_RSG_ECUKnockOutTimer: 63=Cx3F_ECUKnockOut_deaktiviert  # Source signal range: [0,62]
  compu method CM_ASR_Anf: 0=Cx0_keine_Anforderung, 1=Cx1_ASR_Anforderung
  compu method CM_KST_Fahrerhinweis_1: 0=Cx0_inaktiv, 1=Cx1_aktiv
  compu method CM_KST_Fahrerhinweis_2: 0=Cx0_inaktiv, 1=Cx1_aktiv
  compu method CM_ASR_Schalteingriff: 0=Cx0_keine_Anforderung, 1=Cx1_ASR_Schaltkennfeld, 2=Cx2_Rueckschaltung, 3=Cx3_Schaltverbot
  compu method CM_KST_Fahrerhinweis_4: 0=Cx0_inaktiv, 1=Cx1_aktiv
  compu method CM_KST_Fahrerhinweis_5: 0=Cx0_inaktiv, 1=Cx1_aktiv
  compu method CM_ASR_Tastung_passiv: 0=Cx0_ASR_aktiviert, 1=Cx1_ASR_passiv_getastet_oder_Schwellen_geaendert
  compu method CM_KST_Fahrerhinweis_6: 0=Cx0_inaktiv, 1=Cx1_aktiv
  compu method CM_BCM_Ausparken_Betrieb: 0=Cx0_kein_Betrieb, 1=Cx1_Ausparkvorgang_aktiv
  compu method CM_KST_Warn_P1_ZST_def: 0=Cx0_nicht_defekt, 1=Cx1_defekt
  compu method CM_BCM_Remotestart_Betrieb: 0=Cx0_kein_RS_Betrieb, 1=Cx1_RS_Betrieb
  compu method CM_KST_Warn_P2_ZST_def: 0=Cx0_nicht_defekt, 1=Cx1_defekt
  compu method CM_BCM_Remotestart_KL15_Anf: 0=Cx0_inaktiv, 1=Cx1_aktiv
  compu method CM_MO_Abstellzeit: 254=CxFE_Init, 255=CxFF_reserviert, phys=raw*8 for raw 0..253; unit Unit_Minut  # Source signal range: [0,253]
  compu method CM_MO_Anzeige_StSt_gueltig: 0=Cx0_MO_Text_Motorstart_gueltig, 1=Cx1_Signale_MO_Anzeige_StSt_gueltig
  compu method CM_MO_Abstellzeit_Status: 0=Cx0_Abstellzeit_nicht_berechnet, 1=Cx1_Abstellzeit_berechnet, 2=Cx2_Abstellzeit_Minimalwert, 3=Cx3_Abstellzeit_ungueltig
  compu method CM_BCM_Remotestart_MO_Start: 0=Cx0_nicht_angefordert, 1=Cx1_angefordert
  compu method CM_MO_Anforderung_HMS: 0=Cx0_keine_Anforderung, 1=Cx1_halten, 2=Cx2_parken, 3=Cx3_halten_Standby, 4=Cx4_anfahren, 5=Cx5_Loesen_ueber_Rampe, 7=Cx7_HMS_uebernehmen
  compu method CM_MO_Aussp_Anlass: 0=Cx0_Anlasser_darf_angesteuert_werden, 1=Cx1_Anlasser_ausspuren_Ansteuerung_nicht_moeglich (Anlasser_ausspuren__Ansteuerung_nicht_moeglich)
  compu method CM_BR_Eingriffsmoment: 1022=Cx3FE_Init, 1023=Cx3FF_Fehler, phys=raw-509 for raw 0..1018  # Source signal range: [0,1018]
  compu method CM_MO_Ansaugsystem: 0=Cx0_Turbo, 1=Cx1_Sauger
  compu method CM_CE_FlgLnchCtlPreCnd: 0=Cx0_not_fulfilled, 1=Cx1_fulfilled
  compu method CM_MO_BKV_Unterdruckwarnung: 0=Cx0_Unterdruckhaushalt_iO, 1=Cx1_Unterdruckhaushalt_niO
  compu method CM_MO_Anzahl_Zyl: 0=Cx0_kein_Zylinder, 1=Cx1_1_Zylinder, 2=Cx2_2_Zylinder, 3=Cx3_3_Zylinder, 4=Cx4_4_Zylinder, 5=Cx5_5_Zylinder, 6=Cx6_6_Zylinder, 7=Cx7_7_Zylinder, 8=Cx8_8_Zylinder, 9=Cx9_9_Zylinder, 10=CxA_10_Zylinder, 11=CxB_11_Zylinder, 12=CxC_12_Zylinder, 13=CxD_15_Zylinder, 14=CxE_16_Zylinder, 15=CxF_18_Zylinder
  compu method CM_DGN_Verlernzaehler: 255=CxFF_ungueltiger_Zaehlerstand_oder_kein_gueltiger_Fahrzyklus (ungültiger Zählerstand oder kein gültiger Fahrzyklus)  # Source signal range: [0,254]
  compu method CM_MO_BLS: 0=Cx0_kein_Bremsen, 1=Cx1_Bremse_betaetigt
  compu method CM_MO_Fehler_NTKreis: 0=Cx0_kein_Fehler, 1=Cx1_Fehler
  compu method CM_MO_BMS_NV_Anf_stuetzen: 0=Cx0_nicht_notwendig, 1=Cx1_notwendig
  compu method CM_EBV_Eingriff: 0=Cx0_kein_EBV_Eingriff, 1=Cx1_EBV_Eingriff
  compu method CM_MO_FMAus_aktiv: 0=Cx0_inaktiv, 1=Cx1_Segeln_mit_Motor_aus_aktiv
  compu method CM_MO_FMAus_Startvariante: 0=Cx0_kein_Motorstart, 1=Cx1_Motorstart_elektrischer_Starter, 2=Cx2_GetriebeAnschleppstart, 3=Cx3_GetriebeNotAnschleppstart
  compu method CM_EDS_Eingriff: 0=Cx0_kein_EDS_Eingriff, 1=Cx1_EDS_Eingriff
  compu method CM_MO_Code: identical
  compu method CM_MO_Freig_Anlass: 0=Cx0_Start_nicht_zulaessig, 1=Cx1_Startfreigabe
  compu method CM_MO_DPF_verbaut: 0=Cx0_kein_DPF_verbaut, 1=Cx1_DPF_verbaut
  compu method CM_EMG_Diagnose_Anf: 0=Cx0_keine_Anforderung, 1=Cx1_Diagnose_bei_Kl15_An, 2=Cx2_Diagnose_nach_Kl15_Aus, 3=Cx3_Init
  compu method CM_MO_Freig_Reku: 0=Cx0_Rekuperations_Modus_aus (Rekuperations-Modus aus), 1=Cx1_Empfehlung_Spannungsanhebung (Empfehlung Spannungsanhebung), 2=Cx2_Empfehlung_Spannungsabsenkung (Empfehlung Spannungsabsenkung), 3=Cx3_Rekuperationsmodus_aktiv_Spannungsvariation_nicht_notwendig (Rekuperationsmodus aktiv, Spannungsvariation nicht notwendig)
  compu method CM_MO_Drehzahl_VM: phys=raw*0.25 for raw 0..65532; unit Unit_MinutInver
  compu method CM_EMG_Fehler_Drehzahlreduktion: 0=Cx0_Keine_Anforderung, 1=Cx1_Anforderung
  compu method CM_MO_Freigabe_Segeln: 0=Cx0_Segelbetrieb_nicht_freigegeben, 1=Cx1_Segelbetrieb_freigegeben
  compu method CM_MO_Freilauf_Info: 0=Cx0_Freilauf_freigegeben, 1=Cx1_Weiches_Veto_uebertippbar, 2=Cx2_Hartes_Veto_Abbruch, 3=Cx3_Freilauf_Anforderung
  compu method CM_MO_EBoost_verf_praed: 0=Cx0_Init_oder_nicht_verfuegbar, 1=Cx1_EBoost_kurzzeit_verfuegbar, 2=Cx2_EBoost_langzeit_verfuegbar
  compu method CM_EMG_Fehler_Leistungsred: 0=Cx0_keine_Leistungseinschraenkung, 1=Cx1_Leistungseinschraenkung
  compu method CM_MO_Freilauf_Status: 0=Cx0_Freilauf_inaktiv_aber_moeglich, 1=Cx1_Freilauf_aktiv, 2=Cx2_Freilauf_nicht_moegl_1Verhinderer, 3=Cx3_Freilauf_nicht_moegl_gr_1Verhinderer, 7=Cx7_Fehler
  compu method CM_EMG_Generator_Moment: 4094=CxFFE_Init, 4095=CxFFF_Fehler, phys=raw*0.1-204.6 for raw 0..4093; unit Unit_NewtoMeter  # Source signal range: [0,4093]
  compu method CM_MO_eDriveZone_Texte: 0=Cx0_Init_keine_Anzeige, 1=Cx1_Einfahrt_EU7G_Zone, 2=Cx2_Ausfahrt_EU7G_Zone, 3=Cx3_Einfahrt_Umweltzone, 4=Cx4_Ausfahrt_Umweltzone, 5=Cx5_Hinweis_Restreichweite_1, 6=Cx6_Hinweis_Restreichweite_2, 7=Cx7_Hinweis_Restreichweite_3, 8=Cx8_Hinweis_HV_Batt_laden, 9=Cx9_Hinweis_Aufstarten_Stilllegung, 10=CxA_Hinweis_Standortfehler
  compu method CM_EMG_Istmodus: 0=Cx0_Standby, 1=Cx1_Momentenreg, 2=Cx2_Int_Drehzahlreg, 3=Cx3_Spannungsreg, 4=Cx4_Spannungsreg_Batt_Ab, 5=Cx5_Inverter_Fehler, 6=Cx6_Kalibrierung, 8=Cx8_Freilauf, 9=Cx9_Momentenregelung_Komfortfunktionen, 10=CxA_Asynchrones_Bremsen, 11=CxB_Positionierung, 12=CxC_Int_Diagnose, 15=CxF_Init
  compu method CM_MO_Gangposition: 0=Cx0_Gang_N, 1=Cx1_Gang_1, 2=Cx2_Gang_2, 3=Cx3_Gang_3, 4=Cx4_Gang_4, 5=Cx5_Gang_5, 6=Cx6_Gang_6, 7=Cx7_Gang_7, 8=Cx8_Gang_8, 9=Cx9_Automat_P, 10=CxA_Automat_Vorwaerts_S, 11=CxB_Automat_Vorwaerts_D_E (Automat_Vorwaerts_D/E), 12=CxC_Zwischenstellung, 13=CxD_Gang_R, 14=CxE_Istgang_nicht_definiert, 15=CxF_Fehler
  compu method CM_MO_EKlKomLeiRed: 0=Cx0_keine_Leistungsbegr, 1=Cx1_Leistungsbegr_75, 2=Cx2_Leistungsbegr_50, 3=Cx3_Leistungsbegr_25
  compu method CM_EMG_HYB_05_BZ: identical
  compu method CM_MO_Getriebe_Code: 0=Cx00_Init, 2=Cx02_DL501, 3=Cx03_DL800, 4=Cx04_VL381, 5=Cx05_DL382_Front, 6=Cx06_DL382_Allrad, 7=Cx07_DL702, 8=Cx08_AL552_Allrad, 9=Cx09_AL552_Front, 10=Cx0A_AL651, 11=Cx0B_AL551_AL951_AL1000_8A (AL551__AL951__AL1000_8A), 12=Cx0C_PDK_PAG, 13=Cx0D_AL551_Hybrid, 15=Cx0F_Handschalter_konventionell, 16=Cx10_AQ250_160, 17=Cx11_AQ450, 18=Cx12_DQ200, 19=Cx13_DQ250, 20=Cx14_DQ500, 21=Cx15_SQ100, 22=Cx16_SQ200, 23=Cx17_DQ400E, 24=Cx18_DQ381, 25=Cx19_AL550, 26=Cx1A_AQ300, 31=Cx1F_DL800E, 32=Cx20_Single_Gear_ohne_GSG_WH_am_MSG (Single_Gear__ohne_GSG_WH_am_MSG), 33=Cx21_EQ550_2P
  compu method CM_MO_Handshake_STH: 0=Cx0_keine_EKP_Ansteuerung_durch_STH_Anforderung (keine EKP-Ansteuerung durch STH-Anforderung), 1=Cx1_EKP_Ansteuerung_durch_STH_Anforderung (EKP-Ansteuerung durch STH-Anforderung)
  compu method CM_MO_eLaunch_verf: 0=Cx0_Init, 1=Cx1_nicht_verfuegbar, 2=Cx2_verfuegbar
  compu method CM_EMG_HYB_05_CRC: identical
  compu method CM_MO_Heckspoiler_Anf: 0=Cx0_nicht_angefordert, 1=Cx1_angefordert
  compu method CM_EMG_IstDrehzahl: 32766=Cx7FFE_Init, 32767=Cx7FFF_Fehler, phys=raw-10000 for raw 0..32765; unit Unit_MinutInver  # Source signal range: [0,32765]
  compu method CM_MO_EMG_Generator_Leistung: 2046=Cx7FE_Init, 2047=Cx7FF_Fehler, phys=raw*20-20440 for raw 0..2045; unit Unit_Watt  # Source signal range: [0,2045]
  compu method CM_EMG_IstMoment: 4094=CxFFE_Init, 4095=CxFFF_Fehler, phys=raw*0.5-1023 for raw 0..4093; unit Unit_NewtoMeter  # Source signal range: [0,4093]
  compu method CM_MO_Hubraum: phys=raw*0.1 for raw 0..127; unit Unit_Liter
  compu method CM_MO_EMG_Max_Leistung: 2046=Cx7FE_Init, 2047=Cx7FF_Fehler, phys=raw*100-102200 for raw 0..2045; unit Unit_Watt  # Source signal range: [0,2045]
  compu method CM_MO_HYB_Fahrbereitschaft: 0=Cx0_keine_Fahrbereitschaft, 1=Cx1_Fahrbereitschaft
  compu method CM_EMG_IstSpannung: 4094=CxFFE_Init, 4095=CxFFF_Fehler, phys=raw*0.25 for raw 0..4093; unit Unit_Volt  # Source signal range: [0,4093]
  compu method CM_MO_MVEM_Energie_Anf: 0=Cx0_keine_Anforderung, 1=Cx1_Energie_hohe_Prioritaet
  compu method CM_MO_EMG_Max_Momentengradient: 125=Cx7D_keine_Beschraenkung, 126=Cx7E_Init, 127=Cx7F_Reserve; unit Unit_NewtoMeterPerSecon  # Source signal range: [0,124]
  compu method CM_EMG_IstStrom: 2046=Cx7FE_Init, 2047=Cx7FF_Fehler, phys=raw-1023 for raw 0..2045; unit Unit_Amper  # Source signal range: [0,2045]
  compu method CM_MO_HYB_VM_aktiv: 0=Cx0_VM_nicht_aktiv, 1=Cx1_VM_aktiv
  compu method CM_EMG_Max_Moment: 4094=CxFFE_Init, 4095=CxFFF_Fehler, phys=raw*0.1-204.6 for raw 0..4093; unit Unit_NewtoMeter  # Source signal range: [0,4093]
  compu method CM_MO_EMG_Max_Spannung_Lim: 254=CxFE_Init, 255=CxFF_Fehler, phys=raw*0.25 for raw 0..253; unit Unit_Volt  # Source signal range: [0,253]
  compu method CM_MO_MVEM_MaxLeistung_MVVerbrauch: 1022=Cx3FE_Init, 1023=Cx3FF_Fehler, phys=raw*50-10500 for raw 0..1020; unit Unit_Watt  # Source signal range: [0,1020]
  compu method CM_MO_Hybridfahrzeug: 0=Cx0_kein_Hybridfahrzeug, 1=Cx1_Mild_Hybrid, 2=Cx2_Full_Hybrid, 3=Cx3_PlugIn_Hybrid
  compu method CM_EMG_Max_Moment_Lim: 4094=CxFFE_Init, 4095=CxFFF_Fehler, phys=raw*0.1-204.6 for raw 0..4093; unit Unit_NewtoMeter  # Source signal range: [0,4093]
  compu method CM_MO_Interlock: 0=Cx0_Interlockschalter_nicht_betaetigt, 1=Cx1_Interlockschalter_betaetigt
  compu method CM_MO_EMG_Max_Strom_Lim: 2046=Cx7FE_Init, 2047=Cx7FF_Fehler, phys=raw-1023 for raw 0..2045; unit Unit_Amper  # Source signal range: [0,2045]
  compu method CM_MO_MVEM_MinLeistung_MVVerbrauch: 1022=Cx3FE_Init, 1023=Cx3FF_Fehler, phys=raw*50-10500 for raw 0..1020; unit Unit_Watt  # Source signal range: [0,1020]
  compu method CM_MO_Kickdown: 0=Cx0_kein_Kickdown, 1=Cx1_Kickdown
  compu method CM_EMG_Max_Moment_Sockel: 254=CxFE_Init, 255=CxFF_Fehler; unit Unit_NewtoMeter  # Source signal range: [0,253]
  compu method CM_MO_Kl_50: 0=Cx0_aus, 1=Cx1_KL50_ein_Startausfuehrung_Fahrer
  compu method CM_MO_EMG_Min_Leistung: 2046=Cx7FE_Init, 2047=Cx7FF_Fehler, phys=raw*100-102200 for raw 0..2045; unit Unit_Watt  # Source signal range: [0,2045]
  compu method CM_MO_MVEM_Verbau_Motor_Verbraucher: 0=Cx0_keiner, 1=Cx1_eKAT_verbaut, 2=Cx2_eAV_verbaut, 3=Cx3_eAV_und_eKAT_verbaut
  compu method CM_EMG_maxDrehzahl_Freilauf: 32766=Cx7FFE_Init, 32767=Cx7FFF_Fehler, phys=raw-10000 for raw 0..32765; unit Unit_MinutInver  # Source signal range: [0,32765]
  compu method CM_MO_Kl_75: 0=Cx0_Aus, 1=Cx1_Ein
  compu method CM_MO_NGS_Gangpos: 0=Cx0_nicht_bedient, 1=Cx1_1_3_oder_5, 2=Cx2_2_4_6_oder_R, 3=Cx3_R, 4=Cx4_Neutralposition, 5=Cx5_Zwischenposition, 6=Cx6_Sensor_temp_nicht_verfuegbar, 7=Cx7_Fehler
  compu method CM_MO_EMG_Min_Spannung_Lim: 254=CxFE_Init, 255=CxFF_Fehler, phys=raw*0.25 for raw 0..253; unit Unit_Volt  # Source signal range: [0,253]
  compu method CM_EMG_Min_Moment: 4094=CxFFE_Init, 4095=CxFFF_Fehler, phys=raw*0.1-204.6 for raw 0..4093; unit Unit_NewtoMeter  # Source signal range: [0,4093]
  compu method CM_MO_KLE_FStatus: 0=Cx0_kein_Fehler, 2=Cx2_Fehlerentprellung, 3=Cx3_Fehler
  compu method CM_EMG_Min_Moment_Lim: 4094=CxFFE_Init, 4095=CxFFF_Fehler, phys=raw*0.1-204.6 for raw 0..4093; unit Unit_NewtoMeter  # Source signal range: [0,4093]
  compu method CM_MO_OBD_Typ: 0=Cx0_NoOBD_RdW, 1=Cx1_EOBD, 2=Cx2_US_OBD, 3=Cx3_reserviert
  compu method CM_MO_EMG_Min_Strom_Lim: 2046=Cx7FE_Init, 2047=Cx7FF_Fehler, phys=raw-1023 for raw 0..2045; unit Unit_Amper  # Source signal range: [0,2045]
  compu method CM_NM_RSG_CBV_CRI: 0=Cx0_NM_ohne_Clusteranforderungen, 1=Cx1_NM_mit_Clusteranforderungen
  compu method CM_EMG_OBD_Lampe_Anf: 0=Cx0_kein_MIL_Request, 1=Cx1_MIL_Request
  compu method CM_MO_Klima_Eingr: 0=Cx0_kein_Eingriff (kein Eingriff), 1=Cx1_Klimakompressor_ausschalten (Klimakompressor ausschalten), 2=Cx2_Klimakompressor_Leistungsreduzierung (Klimakompressor Leistungsreduzierung), 3=Cx3_Klimakompressor_aufgrund_der_Heissleuchtenvorwarnung_ausschalten (Klimakompressor aufgrund der Heissleuchtenvorwarnung ausschalten)
  compu method CM_MO_EMG_SollDrehzahl: 32767=Cx7FFF_Init, phys=raw-10000 for raw 0..32766; unit Unit_MinutInver  # Source signal range: [0,32766]
  compu method CM_MO_Positionierung_aktiv: 0=Cx0_keine_Positionierung_aktiv, 1=Cx1_Positionierung_aktiv
  compu method CM_EMG_PerfInd_Temperatur: 254=CxFE_Init, 255=CxFF_Fehler, phys=raw*0.8 for raw 0..253; unit Unit_PerCent  # Source signal range: [0,253]
  compu method CM_MO_Klima_Regelmodus: 0=Cx0_Init, 1=Cx1_Regelmodus_1, 2=Cx2_Regelmodus_2, 3=Cx3_Regelmodus_3
  compu method CM_NM_RSG_NM_aktiv_Afterrun: 0=Cx0_inaktiv, 1=Cx1_aktiv
  compu method CM_MO_PTC_Status: 0=Cx0_nicht_unterstuetzt, 1=Cx1_Stufe_0, 2=Cx2_Stufe_1, 3=Cx3_Stufe_2, 4=Cx4_Stufe_3, 7=Cx7_PTC_am_BCM
  compu method CM_EMG_PerfInd_Temperatur_PWR: 254=CxFE_Init, 255=CxFF_Fehler, phys=raw*0.8 for raw 0..253; unit Unit_PerCent  # Source signal range: [0,253]
  compu method CM_MO_EMG_Sollmodus: 0=Cx0_Standby, 1=Cx1_Momentenreg, 2=Cx2_Int_Drehzahlreg, 3=Cx3_Spannungsreg, 4=Cx4_Spannungsreg_Batt_Ab, 6=Cx6_Kalibrierung, 8=Cx8_Freilauf, 9=Cx9_Momentenreg_Komfortfunktionen, 10=CxA_Asynchrones_Bremsen, 11=CxB_Positionieren, 12=CxC_Int_Diagnose, 15=CxF_Init
  compu method CM_MO_Konsistenz_Bremsped: 0=Cx0_Bremspedalinformation_plausibel, 1=Cx1_Bremspedalinformation_unplausibel
  compu method CM_NM_RSG_NM_aktiv_Diagnose: 0=Cx0_Init, 1=Cx1_Diagnose_aktiv
  compu method CM_MO_QBit_Aussen_Temp: 0=Cx0_gueltiger_Wert, 1=Cx1_Ersatz_Init_oder_Fehlerwert
  compu method CM_MO_Kraftstoffart: 0=Cx0_Diesel, 1=Cx1_Benzin_inkl_E25_E85, 2=Cx2_CNG, 3=Cx3_LPG, 4=Cx4_Wasserstoff, 5=Cx5_E100_Ethanol, 15=CxF_kein_Verbrennungskraftstoff
  compu method CM_MO_EMG_SollMoment_02: 65534=CxFFFE_Init, phys=raw*0.01-327.68 for raw 0..65533; unit Unit_NewtoMeter  # Source signal range: [0,65533]
  compu method CM_EMG_Temperatur_PWR: 254=CxFE_Init, 255=CxFF_Fehler, phys=raw-40 for raw 0..253; unit Unit_DegreCelsi  # Source signal range: [0,253]
  compu method CM_NM_RSG_NM_aktiv_Int_Diagnose: 0=Cx0_inaktiv, 1=Cx1_aktiv
  compu method CM_MO_Krit_Heckobjekt: 0=Cx0_Init_kein_relevantes_Objekt, 1=Cx1_Entfernung_grosser_Abstand, 2=Cx2_Annaeherung_grosser_Abstand, 3=Cx3_Entfernung_geringer_Abstand, 4=Cx4_Annaeherung_geringer_Abstand, 7=Cx7_Fehler
  compu method CM_ESC_Reku_Freigabe: 0=Cx0_keine_Freigabe_der_Rekuperation, 1=Cx1_Freigabe_der_Rekuperation
  compu method CM_MO_QBit_Fahrer_bremst: 0=Cx0_gueltiger_Wert, 1=Cx1_Ersatz_Init_oder_Fehlerwert
  compu method CM_NM_RSG_NM_aktiv_KL15: 0=Cx0_Inaktiv, 1=Cx1_KL15_EIN
  compu method CM_MO_EMG_Sollspannung: 254=CxFE_Init, 255=CxFF_Fehler, phys=raw*0.25 for raw 0..253; unit Unit_Volt  # Source signal range: [0,253]
  compu method CM_MO_Kuppl_betaetigt: 0=Cx0_Kupplung_nicht_betaetigt, 1=Cx1_Kupplung_betaetigt
  compu method CM_ESC_v_Signal_Qualifier_High_Low: 0=Cx0_Gueteschwelle_kleiner_1kmh, 1=Cx1_Gueteschwelle_kleiner_3kmh, 2=Cx2_Gueteschwelle_kleiner_5kmh, 3=Cx3_Gueteschwelle_kleiner_10kmh, 4=Cx4_Gueteschwelle_kleiner_20kmh, 5=Cx5_Gueteschwelle_groessergleich_20kmh, 6=Cx6_Init, 7=Cx7_Fehler
  compu method CM_MO_Kuppl_schalter: 0=Cx0_Schalter_sagt_ausgekuppelt, 1=Cx1_Schalter_sagt_eingekuppelt
  compu method CM_MO_QBit_Gangposition: 0=Cx0_gueltiger_Wert, 1=Cx1_Ersatz_Init_oder_Fehlerwert
  compu method CM_NM_RSG_NM_aktiv_Kuehlung: 0=Cx0_Inaktiv, 1=Cx1_RSG_Kuehlung_aktiv
  compu method CM_MO_Ext_E_Fahrt_aktiv: 0=Cx0_Rueckmeldung_E_Taster_aus, 1=Cx1_Rueckmeldung_E_Taster_ein
  compu method CM_ESP_21_BZ: identical
  compu method CM_NM_RSG_NM_aktiv_NvM_Job: 0=Cx0_inaktiv, 1=Cx1_aktiv
  compu method CM_ESP_21_CRC: identical
  compu method CM_MO_QBit_KL_75: 0=Cx0_gueltiger_Wert, 1=Cx1_Ersatz_Init_oder_Fehlerwert
  compu method CM_MO_Fahrbereitschaft: 0=Cx0_Fahrzykl_inaktiv_kein_Antrieb (Fahrzykl_inaktiv__kein_Antrieb), 1=Cx1_Fahrzykl_aktiv_kein_Antrieb (Fahrzykl_aktiv__kein_Antrieb), 2=Cx2_Fahrzykl_aktiv_Antrieb_moeglich (Fahrzykl_aktiv__Antrieb_moeglich)
  compu method CM_MO_LaunchControl: 0=Cx0_nicht_verfuegbar, 1=Cx1_verfuegbar
  compu method CM_ESP_Anhaltevorgang_ACC_aktiv: 0=Cx0_inaktiv, 1=Cx1_aktiv
  compu method CM_MO_Leistung: identical
  compu method CM_MO_Fahrer_bremst: 0=Cx0_kein_Bremsen, 1=Cx1_Bremse_betaetigt
  compu method CM_MO_QBit_Kuppl_betaetigt: 0=Cx0_gueltiger_Wert, 1=Cx1_Ersatz_Init_oder_Fehlerwert
  compu method CM_NM_RSG_NM_aktiv_StallingHelp: 0=Cx0_inaktiv, 1=Cx1_aktiv
  compu method CM_MO_Mom_Begr_Fahr_Pred: 510=Cx1FE_Init  # Source signal range: [0,509]
  compu method CM_ESP_ASP: 0=Cx0_inaktiv, 1=Cx1_aktiv
  compu method CM_MO_Fahrzeugabstellzeit: 254=CxFE_Init, 255=CxFF_Fehler, phys=raw*8 for raw 0..253; unit Unit_Minut  # Source signal range: [0,253]
  compu method CM_MO_Red_El_Fahrleistung: 0=Cx0_keine_Anzeige, 1=Cx1_mehr_als_20Prcnt_Red, 2=Cx2_Reserve_1, 3=Cx3_Reserve_2, 4=Cx4_unter_GBB_Schwelle_Anhaenger, 5=Cx5_unter_GBB_Schwelle, 6=Cx6_unter_minimal_Schwelle, 7=Cx7_kein_Vortrieb
  compu method CM_NM_RSG_NM_aktiv_Tmin: 0=Cx0_Inaktiv, 1=Cx1_Mindestaktivzeit
  compu method CM_MO_Motor_laeuft: 0=Cx0_Motor_laeuft_nicht, 1=Cx1_Motor_laeuft_autark_und_stabil_und_darf_mechanisch_belastet_werden
  compu method CM_ESP_AWV3_Brems_aktiv: 0=Cx0_inaktiv, 1=Cx1_aktiv
  compu method CM_NM_RSG_NM_State: 0=Cx00_Init, 1=Cx01_NM_RM_aus_BSM, 2=Cx02_NM_RM_aus_PBSM, 4=Cx04_NM_NO_aus_RM, 8=Cx08_NM_NO_aus_RS, 16=Cx10_reserved, 32=Cx20_reserved
  compu method CM_MO_Fahrzeugabstellzeit_Status: 0=Cx0_Abstellzeit_nicht_berechnet, 1=Cx1_Abstellzeit_berechnet, 2=Cx2_Abstellzeit_Minimalwert, 3=Cx3_Abstellzeit_ungueltig (Abstellzeit_ungültig)
  compu method CM_MO_Remotestart_Betrieb: 0=Cx0_MSG_nicht_bereit_fuer_RS_Betrieb, 1=Cx1_MSG_bereit_fuer_oder_im_RS_Betrieb
  compu method CM_ESP_Diagnose: 0=Cx0_ESP_nicht_in_Diagnose, 1=Cx1_ESP_in_Diagnose
  compu method CM_NM_RSG_UDS_CC: 0=Cx0_Inaktiv, 1=Cx1_CC_aktiv
  compu method CM_NM_RSG_Wakeup: 0=Cx00_Peripherie_Wakeup_Ursache_nicht_bekannt, 1=Cx01_Bus_Wakeup, 2=Cx02_KL15_HW
  compu method CM_MO_Fahrzeugtyp: 0=Cx0_Verbrenner_Fahrzeug, 1=Cx1_Hybrid, 2=Cx2_E_Fahrzeug, 3=Cx3_E_Fahrzeug_mit_Range_Extender, 4=Cx4_Brennstoffzellenfahrzeug, 5=Cx5_tbd, 6=Cx6_tbd, 7=Cx7_tbd
  compu method CM_MO_Remotestart_moeglich: 0=Cx0_Remotestart_nicht_moeglich, 1=Cx1_Remotestart_moeglich
  compu method CM_ESP_Eingriff: 0=Cx0_kein_ESP_Eingriff, 1=Cx1_ESP_Eingriff_aktiv
  compu method CM_OBD_Abs_Load_Val: phys=raw*0.3921568627 for raw 0..65535; unit Unit_PerCent
  compu method CM_UH_Monat: 0=Cx0_Init, 14=CxE_Relatives_Datum, 15=CxF_Fehler; unit Unit_Month  # Source signal range: [1,12]
  compu method CM_ESP_Haltebestaetigung: 0=Cx0_kein_sicheres_Halten, 1=Cx1_sicheres_Halten
  compu method CM_MO_Faktor_Momente_02: 0=Cx0_nicht_belegt; unit Unit_NewtoMeter  # Source signal range: [1,3]
  compu method CM_MO_Servicemodus: 0=Cx0_nicht_aktiv, 1=Cx1_Service_Mode_1, 2=Cx2_Service_Mode_2, 3=Cx3_Service_Mode_3, 4=Cx4_Service_Mode_4, 5=Cx5_Service_Mode_5, 6=Cx6_Service_Mode_6, 7=Cx7_Service_Mode_7, 8=Cx8_Service_Mode_8, 9=Cx9_Service_Mode_9, 10=CxA_Service_Mode_10, 11=CxB_Service_Mode_11, 12=CxC_Service_Mode_12, 13=CxD_Service_Mode_13, 14=CxE_Service_Mode_14, 15=CxF_Service_Mode_15
  compu method CM_OBD_Abs_Pedal_Pos: phys=raw*0.3921568627 for raw 0..255; unit Unit_PerCent
  compu method CM_UH_Sekunde: identical
  compu method CM_ESP_MKB_Abbruch_Geschw: 0=Cx0_MKB_nicht_beendet_wg_v_Schwelle, 1=Cx1_MKB_beendet_wg_v_Schwelle
  compu method CM_OBD_Abs_Throttle_Pos: phys=raw*0.3921568627 for raw 0..255; unit Unit_PerCent
  compu method CM_MO_Fehler_Notabschaltung_Klima: 0=Cx0_Init, 1=Cx1_HVIL_ist_OK, 2=Cx2_HVIL_Fehler, 3=Cx3_ohne_Funktion
  compu method CM_MO_Signalquelle_Gangposition: 0=Cx0_Sensorsignal, 1=Cx1_Modellsignal
  compu method CM_UH_Stunde: identical
  compu method CM_ESP_PLA_Bremseingriff: 0=Cx0_inaktiv, 1=Cx1_aktiv
  compu method CM_OBD_Aussen_Temp_gef: 254=CxFE_Initwert, 255=CxFF_Fehler, phys=raw-40 for raw 0..253; unit Unit_DegreCelsi  # Source signal range: [0,253]
  compu method CM_MO_StartStopp_Codiert: 0=Cx0_Start_Stopp_nicht_verbaut, 1=Cx1_Start_Stopp_verbaut
  compu method CM_UH_Tag: 0=Cx00_Init; unit Unit_Day  # Source signal range: [1,31]
  compu method CM_ESP_QBit_v_Signal: 0=Cx0_gueltiger_Wert, 1=Cx1_Ersatz_Init_oder_Fehlerwert
  compu method CM_OBD_Calc_Load_Val: phys=raw*0.3921568627 for raw 0..255; unit Unit_PerCent
  compu method CM_VIN_01_MUX: identical
  compu method CM_MO_StartStopp_Fahrerwunsch: 0=Cx0_Init, 1=Cx1_Stoppverbot_durch_Fahrer, 2=Cx2_Stoppfreigabe_durch_Fahrer, 3=Cx3_Stoppanforderung_durch_Fahrer
  compu method CM_ESP_Systemstatus: 0=Cx0_iO, 1=Cx1_Fehler
  compu method CM_OBD_ClearMem_Inhibit: 0=Cx0_FSP_Loeschen_zulaessig, 1=Cx1_FSP_Loeschen_nicht_zulaessig
  compu method CM_VIN_1: identical
  compu method CM_ESP_Tastung_passiv: 0=Cx0_ESP_aktiviert, 1=Cx1_ESP_passiv_getastet_oder_Schwellen_geaendert
  compu method CM_OBD_Driving_Cycle: 0=Cx0_kein_Driving_Cycle_erkannt, 1=Cx1_Driving_Cycle_erkannt
  compu method CM_MO_StartStopp_Motorstopp: 0=Cx0_Motor_Stop_inaktiv, 1=Cx1_Motor_Stop_aktiv
  compu method CM_VIN_10: identical
  compu method CM_ESP_v_Signal: 65533=CxFFFD_Unterspannung, 65534=CxFFFE_Init, 65535=CxFFFF_Fehler, phys=raw*0.01 for raw 0..65532; unit Unit_KiloMeterPerHour  # Source signal range: [0,65532]
  compu method CM_OBD_Eng_Cool_Temp: phys=raw-40 for raw 0..255; unit Unit_DegreCelsi
  compu method CM_MO_StartStopp_Status: 0=Cx0_System_in_diesem_KL15_Zyklus_nicht_verfuegbar, 1=Cx1_System_aktiv_keine_Freigabe_durch_StartStop_Koordinator, 2=Cx2_System_aktiv_alle_Freigaben_liegen_vor, 3=Cx3_System_aktiv_mindestens_eine_Freigabe_fehlt
  compu method CM_ESP_Vorsteuerung: 0=Cx0_keine_Vorsteuerung_aktiv, 1=Cx1_Vorsteuerung_aktiv
  compu method CM_VIN_11: identical
  compu method CM_OBD_Kaltstart_Denominator: 0=Cx0_Denominator_nicht_hochzaehlen, 1=Cx1_Bedingungen_zum_Inkr_des_Kaltstart_Denom_erf
  compu method CM_MO_StartStopp_Wiederstart: 0=Cx0_Wiederstart_inaktiv, 1=Cx1_Wiederstart_aktiv
  compu method CM_EV_Rekuperationsstufe: 0=Cx0_keine_Anzeige, 1=Cx1_1, 2=Cx2_2, 3=Cx3_3, 4=Cx4_4, 5=Cx5_5
  compu method CM_VIN_12: identical
  compu method CM_OBD_Minimum_Trip: 0=Cx0_kein_Min_Normed_Trip, 1=Cx1_Min_Normed_Trip
  compu method CM_OBD_Normed_Trip: 0=Cx0_kein_Normed_Trip, 1=Cx1_Normed_Trip
  compu method CM_MO_StartVorauss_erfuellt: 0=Cx0_Signal_nicht_bedient, 1=Cx1_StartVorauss_nicht_ueberpruefbar, 2=Cx2_StartVorauss_nicht_erfuellt, 3=Cx3_StartVorauss_erfuellt
  compu method CM_VIN_13: identical
  compu method CM_OBD_QBit_Schlechtweg: 0=Cx0_gueltiger_Wert, 1=Cx1_Ersatz_Init_oder_Fehlerwert
  compu method CM_VIN_14: identical
  compu method CM_MO_Startwunsch: 0=Cx0_kein_Startwunsch, 1=Cx1_Startwunsch
  compu method CM_OBD_Schlechtweg: 0=Cx0_kein_Schlechtweg_erkannt, 1=Cx1_Schlechtweg_erkannt
  compu method CM_OBD_Sperrung_IUMPR: 0=Cx0_IUMPR_Berechnung_freigegeben, 1=Cx1_IUMPR_Berechnung_gesperrt
  compu method CM_VIN_15: identical
  compu method CM_MO_Tankbereitschaft_Status: 0=Cx0_keine_Aktion_Init, 1=Cx1_Tankbereitschaft_wird_hergestellt, 2=Cx2_Tankbereitschaft_ist_hergestellt, 3=Cx3_Tankbereitschaft_kann_nicht_hergestellt_werden, 4=Cx4_Tanksystem_Systemfehler, 5=Cx5_Tankklappe_pruefen_schliessen, 6=Cx6_Tankvorgang_abgebrochen, 7=Cx7_Antrieb_ist_deaktiviert
  compu method CM_OBD_Sperrung_Kaltstart_Denom: 0=Cx0_EVAP_Berechnung_freigegeben, 1=Cx1_EVAP_Berechnung_gesperrt
  compu method CM_MO_Tankklappensteuerung: 0=Cx0_Init_nicht_verbaut, 1=Cx1_Tankklappe_soll_entriegeln, 2=Cx2_Tankklappe_soll_verriegeln, 3=Cx3_keine_Aktion
  compu method CM_VIN_16: identical
  compu method CM_OBD_Warm_Up_Cycle: 0=Cx0_kein_Warm_Up_Cycle_erkannt, 1=Cx1_Warm_Up_Cycle_erkannt
  compu method CM_MO_Timeout_ESP: 0=Cx0_Empfang_iO, 1=Cx1_Timeout
  compu method CM_VIN_17: identical
  compu method CM_OBDProtocol_req: 0=Cx0_not_available, 1=Cx1_OBDclassic, 2=Cx2_OBDonUDS, 3=Cx3_ZEVonUDS, 14=CxE_Init, 15=CxF_Fehler
  compu method CM_VIN_2: identical
  compu method CM_MO_UBE_Hybrid_Reserve: 1023=Cx3FF_Init, phys=raw*5 for raw 0..1022; unit Unit_WattHour  # Source signal range: [0,1022]
  compu method CM_OBDProtocol_RSG: 0=Cx0_not_available, 1=Cx1_OBDclassic, 2=Cx2_OBDonUDS, 3=Cx3_ZEVonUDS, 4=Cx4_NoOBD, 14=CxE_Init, 15=CxF_Fehler
  compu method CM_RSG_Abschaltstufe: 0=Cx0_keine_Einschraenkung, 1=Cx1_Funktionseinschraenkung
  compu method CM_VIN_3: identical
  compu method CM_MO_UBE_Reserve: 1023=Cx3FF_Init, phys=raw*5 for raw 0..1022; unit Unit_WattHour  # Source signal range: [0,1022]
  compu method CM_RSG_Indc_StChk: 0=Cx0_Completed, 1=Cx1_NotCompleted
  compu method CM_VIN_4: identical
  compu method CM_MO_Veto_Launchcontrol: 0=Cx0_kein_Veto_LC_moeglich (kein_Veto__LC_moeglich), 1=Cx1_Veto_LC_nicht_moeglich (Veto__LC_nicht_moeglich)
  compu method CM_RSG_Indc_StFail: 0=Cx0_Passive, 1=Cx1_Active
  compu method CM_RSG_KD_Fehler: 0=Cx0_Kein_KD_Fehler (Kein KD_Fehler), 1=Cx1_KD_Fehler
  compu method CM_VIN_5: identical
  compu method CM_MO_Waehlpos: 0=Cx0_Init_nicht_unterstuetzt, 1=Cx1_reserviert, 2=Cx2_P, 3=Cx3_R, 4=Cx4_N, 5=Cx5_D, 6=Cx6_B, 7=Cx7_Fehler
  compu method CM_VIN_6: identical
  compu method CM_RSG_KompSchutz: 0=Cx0_inaktiv, 1=Cx1_aktiv
  compu method CM_MO_WH_Texte: 0=Cx0_keine_Anzeige, 1=Cx1_ShiftLock_Fussbremse_betaetigen (ShiftLock__Fussbremse_betaetigen), 3=Cx3_Wegrollgefahr_bitte_P_einlegen, 4=Cx4_Parksperre_Warnstufe_I, 5=Cx5_Parksperre_Warnstufe_II, 6=Cx6_P_nur_im_Stillstand_moeglich
  compu method CM_RSG_Nachlauftyp: 0=Cx0_Komm_bei_KL15_EIN, 1=Cx1_Komm_nach_KL15_AUS, 2=Cx2_Komm_bei_KL15_AUS
  compu method CM_VIN_7: identical
  compu method CM_MO_Zylinderabschaltung: 0=Cx0_Vollmotorbetrieb_VMB, 1=Cx1_Uebergang_HMB_in_VMB, 2=Cx2_Uebergang_VMB_in_HMB, 3=Cx3_Halbmotorbetrieb_HMB
  compu method CM_RSG_Transport_Mode: 0=Cx0_keine_Einschraenkung, 1=Cx1_Funktionseinschraenkung
  compu method CM_VIN_8: identical
  compu method CM_RSt_Fahrerhinweise: 0=Cx0_Init, 1=Cx1_Fahreruebernahme_Hinweis_ZAT_Automat_ohne_Gong, 2=Cx2_Fahreruebernahme_Hinweis_ZAT_Automat_mit_Gong, 3=Cx3_Fahreruebernahme_Hinweis_ZAT_Handschalter_ohne_Gong, 4=Cx4_Fahreruebernahme_Hinweis_ZAT_Handschalter_mit_Gong, 5=Cx5_Fahreruebernahme_Hinweis_ZAS_Automat_ohne_Gong, 6=Cx6_Fahreruebernahme_Hinweis_ZAS_Automat_mit_Gong, 7=Cx7_Fahreruebernahme_Hinweis_ZAS_Handschalter_ohne_Gong, 8=Cx8_Fahreruebernahme_Hinweis_ZAS_Handschalter_mit_Gong, 9=Cx9_RemoteStart_aktiv_ohne_Gong, 10=CxA_RemoteStart_aktiv_mit_Gong, 11=CxB_void, 12=CxC_void, 13=CxD_void, 14=CxE_void, 15=CxF_void
  compu method CM_Motor_14_BZ: identical
  compu method CM_VIN_9: identical
  compu method CM_SI_NWDF: 0=Cx0_Ueberwachung_nicht_freigegeben, 1=Cx1_Ueberwachung_freigegeben
  compu method CM_Motor_14_CRC: identical
  compu method CM_SI_NWDF_gueltig: 0=Cx0_NWDF_wird_nicht_unterstuetzt, 1=Cx1_NWDF_wird_unterstuetzt
  compu method CM_ZAS_Kl_15: 0=Cx0_aus, 1=Cx1_ein
  compu method CM_SI_P_Mode: 0=Cx0_inaktiv, 1=Cx1_aktiv
  compu method CM_ZAS_Kl_50_Startanforderung: 0=Cx0_aus, 1=Cx1_KL50_ein_Startwunsch_Fahrer
  compu method CM_Motor_54_BZ: identical
  compu method CM_SI_P_Mode_gueltig: 0=Cx0_dezentraler_Produktionsmode, 1=Cx1_zentraler_Produktionsmode
  compu method CM_ZAS_Kl_Infotainment: 0=Cx0_inaktiv, 1=Cx1_aktiv
  compu method CM_Motor_54_CRC: identical
  compu method CM_SOK_Motor_55_Signatur: identical
  compu method CM_TS_Allrad_Anteil_sek: 510=Cx1FE_Init, 511=Cx1FF_Fehler, phys=raw*0.2 for raw 0..500; unit Unit_PerCent  # Source signal range: [0,500]
  compu method CM_ZAS_Kl_S: 0=Cx0_aus, 1=Cx1_S_Kontakt_ein
  compu method CM_Motor_55_BZ: identical
  compu method CM_TS_Faktor_Radmomente: 0=Cx0_Faktor_1NM, 1=Cx1_Faktor_2NM, 2=Cx2_Faktor_3NM, 3=Cx3_Faktor_4NM
  compu method CM_Motor_55_CRC: identical
  compu method CM_ZAS_Kl_X: 0=Cx0_aus, 1=Cx1_ein
  compu method CM_TS_MomRad_Ist: 8190=Cx1FFE_Init, phys=raw*3-12279 for raw 0..8186; unit Unit_None  # Source signal range: [0,8186]
  compu method CM_Motor_Code_01_BZ: identical
  compu method CM_TS_MomRad_Ist_sek: 8190=Cx1FFE_Init, phys=raw*3-12279 for raw 0..8186; unit Unit_None  # Source signal range: [0,8186]
  compu method CM_Motor_Code_01_CRC: identical
  compu method CM_TS_MomRad_Soll_Summe: 8190=Cx1FFE_Init, phys=raw*3-12279 for raw 0..8186; unit Unit_None  # Source signal range: [0,8186]
  compu method CM_Motor_EV_01_BZ: identical
  compu method CM_TS_MomRad_verfuegb_max: 4094=CxFFE_Init, phys=raw*3 for raw 0..4093; unit Unit_None  # Source signal range: [0,4093]
  compu method CM_TS_MomRad_verfuegb_max_sek: 4094=CxFFE_Init, phys=raw*3 for raw 0..4093; unit Unit_None  # Source signal range: [0,4093]
  compu method CM_Motor_EV_01_CRC: identical
  compu method CM_TS_MomRad_verfuegb_maxReku: 4094=CxFFE_Init, phys=raw*3-12279 for raw 0..4093; unit Unit_None  # Source signal range: [0,4093]
  compu method CM_MSR_Anf: 0=Cx0_keine_Anfoderung (keine Anfoderung), 1=Cx1_MSR_Anforderung (MSR-Anforderung)
  compu method CM_TS_MomRad_verfuegb_maxReku_sek: 4094=CxFFE_Init, phys=raw*3-12279 for raw 0..4093; unit Unit_None  # Source signal range: [0,4093]
  compu method CM_MV_Bordnetz_aktiv: 0=Cx0_inaktiv, 1=Cx1_aktiv
  compu method CM_TS_MomRad_verfuegb_maxReku_Summe: 4094=CxFFE_Init, phys=raw*3-12279 for raw 0..4093  # Source signal range: [0,4093]
  compu method CM_TS_MomRad_Wunsch: 8190=Cx1FFE_Init, phys=raw*3-12279 for raw 0..8186; unit Unit_None  # Source signal range: [0,8186]
  compu method CM_MV_Bordnetz_belastbar: 0=Cx0_nicht_belastbar, 1=Cx1_belastbar
  compu method CM_MV_Bordnetz_Fehler: 0=Cx0_kein_Fehler, 1=Cx1_Fehler
  compu method CM_TS_MomRad_Wunsch_sek: 8190=Cx1FFE_Init, phys=raw*3-12279 for raw 0..8186; unit Unit_None  # Source signal range: [0,8186]
  compu method CM_MVK_01_BZ: identical
  compu method CM_TS_Status_DrzReg: 0=Cx0_Init, 1=Cx1_Verfuegbar, 2=Cx2_Fehler_ohne_DrzReg_Abweichung, 3=Cx3_Fehler_mit_DrzReg_Abweichung
  compu method CM_TS_Status_DrzReg_sek: 0=Cx0_Init, 1=Cx1_Verfuegbar, 2=Cx2_Fehler_ohne_DrzReg_Abweichung, 3=Cx3_Fehler_mit_DrzReg_Abweichung
  compu method CM_MVK_01_CRC: identical
  compu method CM_TS_Status_MomRad_Ist: 0=Cx0_FuSi_hohe_Genauigkeit, 1=Cx1_FuSi_niedrige_Genauigkeit, 2=Cx2_QM_fehlerfrei, 3=Cx3_QM_mit_Fehlern
  compu method CM_MVK_BMS_Sollmodus: 0=Cx0_MV_Off, 1=Cx1_MV_On, 7=Cx7_Init
  compu method CM_TSK_ACC_FoD_Status: 0=Cx0_default, 1=Cx1_nicht_aktiv, 2=Cx2_aktiv, 3=Cx3_nicht_genutzt
  compu method CM_MVK_BOOST_Sollmodus: 0=Cx0_Keine_Freigabe, 1=Cx1_Freigabe, 7=Cx7_Init
  compu method CM_TSK_aktives_System: 0=Cx0_keine_Funktion_aktiv, 1=Cx1_GRA_ACC, 2=Cx2_ARA, 3=Cx3_Speedlimiter, 4=Cx4_IPA, 5=Cx5_PLA, 6=Cx6_PEA_Ausrollassistent, 7=Cx7_EA
  compu method CM_TSK_aktives_System_02: 0=Cx0_keine_Funktion_aktiv, 1=Cx1_GRA_ACC, 2=Cx2_ARA, 3=Cx3_Speedlimiter, 4=Cx4_IPA, 5=Cx5_PLA, 6=Cx6_PEA_Ausrollassistent, 7=Cx7_EA, 8=Cx8_Staupilot, 9=Cx9_RHP
  compu method CM_MVK_DCDC_Sollmodus: 0=Cx0_Standby, 1=Cx1_MV_On, 2=Cx2_Tiefsetzen, 3=Cx3_Hochsetzen, 4=Cx4_Startunterstuetzung_48V, 6=Cx6_Startunterstuetzung_12V, 7=Cx7_Init
  compu method CM_TSK_Anf_Antriebsmoment: 0=Cx0_keine_Anforderung, 1=Cx1_Anforderung_aktiv
  compu method CM_MVK_DCDC_Sollmodus_02: 0=Cx0_Standby, 1=Cx1_MV_On, 2=Cx2_Tiefsetzen, 3=Cx3_Hochsetzen, 4=Cx4_Startunterstuetzung_48V, 6=Cx6_Startunterstuetzung_12V, 7=Cx7_Init, 9=Cx9_MV_On_Notbetrieb, 10=CxA_Tiefsetzen_Notbetrieb, 11=CxB_Pruefpuls_12V, 13=CxD_Reaktivierung_BMS
  compu method CM_TSK_Codierung: 0=Cx0_kein_Fahrgeschwindigkeitsregler, 1=Cx1_GRA, 2=Cx2_GRA_Plus, 3=Cx3_Basis_ACC, 4=Cx4_ACC_Follow_to_Stop, 5=Cx5_ACC_Stop_and_Go, 7=Cx7_Codierung_in_Plausibilisierungsphase
  compu method CM_MVK_eABC_Sollmodus: 0=Cx0_Keine_Freigabe, 1=Cx1_Freigabe, 7=Cx7_Init
  compu method CM_TSK_Einheit_vMax_Fahrerassistenz: 0=Cx0_kmh, 1=Cx1_mph
  compu method CM_MVK_eAWS_Sollmodus: 0=Cx0_Keine_Freigabe, 1=Cx1_Freigabe, 7=Cx7_Init
  compu method CM_TSK_erhoehter_Fahrwiderstand: 0=Cx0_kein_erhoehter_Fahrwiderstand, 1=Cx1_erhoehter_Fahrwiderstand
  compu method CM_MVK_Istmodus_Anf: 0=Cx0_nicht_angefordert, 1=Cx1_angefordert
  compu method CM_TSK_GRA_FoD_Status: 0=Cx0_default, 1=Cx1_nicht_aktiv, 2=Cx2_aktiv, 3=Cx3_nicht_genutzt
  compu method CM_MVK_MO_EmSollzustand: 0=Cx00_MvOff, 1=Cx01_MvStbyReq, 2=Cx02_MvStbyWait, 3=Cx03_MvBattOnReq, 4=Cx04_MvBattOnWait, 10=Cx0A_MvOnIdle, 18=Cx12_MvOnDrvReq, 19=Cx13_MvOnDrvWait, 20=Cx14_MvOnDrv, 28=Cx1C_MvStepUpReq, 29=Cx1D_MvStepUpWait, 30=Cx1E_MvStepUp, 38=Cx26_MvStepDownReq, 39=Cx27_MvStepDownWait, 40=Cx28_MvStepDown, 96=Cx60_MvCpntOffReq, 97=Cx61_MvCpntOffWait, 98=Cx62_MvBattOffReq, 99=Cx63_MvBattOffWait, 109=Cx6D_MvDcDcFailOffReq, 110=Cx6E_MvDcDcFail, 119=Cx77_MvElmFailOffReq, 120=Cx78_MvElmFail, 126=Cx7E_MvFailCpntOffReq, 127=Cx7F_MvFailCpntOffWait, 128=Cx80_MvFailBattOffReq, 129=Cx81_MvFailBattOffWait, 130=Cx82_MvFailBattOff, 138=Cx8A_MvFailUCtlReq, 139=Cx8B_MvFailUCtlWait, 140=Cx8C_MvFailUCtl, 150=Cx96_MvEmgcyOff, 255=CxFF_Init
  compu method CM_TSK_Status_ARA: 0=Cx0_Aus, 1=Cx1_Init_oder_nicht_verbaut, 2=Cx2_aktivierbar, 3=Cx3_aktiv, 5=Cx5_abschaltung_laeuft, 6=Cx6_reversibel_aus, 7=Cx7_Fehler
  compu method CM_MVK_MV_Batteriewarnung: 0=Cx0_Keine_Warnung, 1=Cx1_Warnung_Temperatur_Level1, 2=Cx2_Warnung_Temperatur_Level2
  compu method CM_TSK_Status_EA: 0=Cx0_Aus, 1=Cx1_Init_oder_nicht_verbaut, 3=Cx3_Aktiv, 4=Cx4_Uebertreten, 5=Cx5_Abschaltung_laeuft, 6=Cx6_Reversibel_aus, 7=Cx7_Fehler
  compu method CM_MVK_MV_Netz_Warnungen: 0=Cx0_Keine_Warnung, 1=Cx1_Warntext_MV_Netz_Anf, 2=Cx2_Fehlertext_MV_Netz_Anf, 3=Cx3_Warnung_Kein_Wiederstart_moeglic
  compu method CM_TSK_Status_IPA: 0=Cx0_Aus_Funktionsbereit, 1=Cx1_Init_oder_nicht_verbaut, 2=Cx2_aktivierbar, 3=Cx3_aktiv, 4=Cx4_Fahreruebernahme_angefordert, 5=Cx5_Abschaltung_laueft, 6=Cx6_reversibel_aus, 7=Cx7_Fehler
  compu method CM_MVK_MVPTC_Sollmodus: 0=Cx0_Keine_Freigabe, 1=Cx1_Freigabe, 7=Cx7_Init
  compu method CM_TSK_Status_PLA: 0=Cx0_Aus_Funktionsbereit, 1=Cx1_Init_oder_nicht_verbaut, 2=Cx2_aktivierbar, 3=Cx3_aktiv, 5=Cx5_Abschaltung_laeuft, 6=Cx6_reversibel_aus, 7=Cx7_Fehler
  compu method CM_NM_RSG_CAB_V14: 0=Cx000000_Init, 1=Cx000001_CAB_01_Antrieb, 2=Cx000002_CAB_02_Hybrid_Laden, 4=Cx000004_CAB_03_Fahrwerk, 8=Cx000008_CAB_04_Fahrerassistenz, 16=Cx000010_CAB_05_Komfort, 32=Cx000020_CAB_06_Anzeige, 64=Cx000040_CAB_07_Connect, 128=Cx000080_CAB_08_MIB, 256=Cx000100_CAB_09_Standheizung, 1024=Cx000400_CAB_11_VLAN_Fahrerassistenz, 2048=Cx000800_CAB_12_VLAN_Komfort, 4096=Cx001000_CAB_13_VLAN_Connect, 8192=Cx002000_CAB_14_VLAN_Infotainment, 16384=Cx004000_CAB_15_Laden, 32768=Cx008000_CAB_16_Licht
  compu method CM_TSK_Status_RHP: 0=Cx0_off, 1=Cx1_init, 2=Cx2_standby, 3=Cx3_active, 4=Cx4_driver_override, 5=Cx5_shutdown, 6=Cx6_reversible_failure, 7=Cx7_irreversible_failure
  compu method CM_NM_RSG_Car_Wakeup: 0=Cx0_Inaktiv, 1=Cx1_Car_Wakeup
  compu method CM_TSK_vMax_aktuell: 254=CxFE_kein_Limit_aktiv, 255=CxFF_Init; unit Unit_KiloMeterPerHour  # Source signal range: [0,253]
  compu method CM_TSK_vMax_Fahrerassistenz: 511=Cx1FF_Init_ungueltig_keine_Beschraenkung  # Source signal range: [0,510]
  compu method CM_NM_RSG_CBV_AWB: 0=Cx0_Passiver_WakeUp, 1=Cx1_Aktiver_WakeUp
  compu method CM_UH_Jahr: phys=raw+2000 for raw 0..127; unit Unit_Year
  compu method CM_UH_Minute: identical
  compu method CM_AB_Anzeige_Fussg: 0=Cx0_keine_FSG_Aktion_ausgeloest, 1=Cx1_Motorhaube_offen, 2=Cx2_Systemfehler
  compu method CM_AB_Belegung_VF: 0=Cx0_nicht_verfuegbar, 1=Cx1_Fehler, 2=Cx2_nicht_belegt, 3=Cx3_belegt
  compu method CM_AB_Crash_Int: 0=Cx0_kein_Crash, 1=Cx1_Crash_Intensitaet_1, 2=Cx2_Crash_Intensitaet_2_nur_Stellgliedtest_MLB_B8_ (Crash_Intensitaet_2_(nur_Stellgliedtest_MLB_B8)), 3=Cx3_Crash_Intensitaet_2_nur_D4_C7_Colorado_NF_PAG_Crash_im_MLB_B8_ (Crash_Intensitaet_2_(nur_D4_C7_Colorado_NF_PAG__Crash_im_MLB_B8)), 4=Cx4_Crash_Intensitaet_3_alt_VW_AUDI_Stellgliedtest_MLB_B8_ (Crash_Intensitaet_3_(alt_VW/AUDI__Stellgliedtest_MLB_B8)), 5=Cx5_Crash_Intensitaet_3_alt_PAG_ (Crash_Intensitaet_3_(alt_PAG)), 7=Cx7_Crash_Intensitaet_3
  compu method CM_AB_Deaktiviert: 0=Cx0_aktiv, 1=Cx1_deaktiviert
  compu method CM_AB_Deaktivierung_HV: 0=Cx0_keine_Deaktivierung, 1=Cx1_Deaktivierung_1, 2=Cx2_Deaktivierung_2, 3=Cx3_Deaktivierung_3, 4=Cx4_Deaktivierung_4, 5=Cx5_Deaktivierung_5, 6=Cx6_Deaktivierung_6, 7=Cx7_Fehler
  compu method CM_AB_Diagnose: 0=Cx0_nicht_in_Diagnose, 1=Cx1_in_Diagnose
  compu method CM_AB_eCS_Error: 0=Cx0_keine_Anzeige, 1=Cx1_Anzeige_anfordern
  compu method CM_AB_EDR_Trigger: 0=Cx0_No_Event, 1=Cx1_Start_Event, 2=Cx2_NonDeployment_Event, 3=Cx3_Deployment_Event
  compu method CM_AB_Erh_Auf_VB: 0=Cx0_keine_Anzeige, 1=Cx1_Beifahrerairbag_deaktiviert, 2=Cx2_Beifahrerairbag_aktiviert, 3=Cx3_nicht_definiert
  compu method CM_AB_Front_Crash: 0=Cx0_kein_Front_Crash, 1=Cx1_Front_Crash
  compu method CM_AB_Gurtschloss_FA_ext: 0=Cx0_nicht_verbaut, 1=Cx1_reserviert, 2=Cx2_nicht_gesteckt, 3=Cx3_gesteckt, 4=Cx4_dauerhaft_nicht_gesteckt, 5=Cx5_dauerhaft_gesteckt, 6=Cx6_Init, 7=Cx7_Fehler
  compu method CM_AB_Gurtschloss_FA_ext_aktiv: 0=Cx0_inaktiv, 1=Cx1_aktiv
  compu method CM_AB_Gurtwarn_VB: 0=Cx0_keine_Warnung, 1=Cx1_Gurtwarnung_ausloesen
  compu method CM_AB_Gurtwarn_VF: 0=Cx0_keine_Warnung, 1=Cx1_Gurtwarnung_ausloesen
  compu method CM_AB_Heck_Crash: 0=Cx0_kein_Heck_Crash, 1=Cx1_Heck_Crash
  compu method CM_AB_Lampe: 0=Cx0_Aus, 1=Cx1_Ein
  compu method CM_AB_MKB_Anforderung: 0=Cx0_Multikollisionsbremsung_nicht_angefordert, 1=Cx1_Multikollisionsbremsung_angefordert
  compu method CM_AB_MKB_gueltig: 0=Cx0_Multikollisionsbremsung_nicht_freigeschaltet, 1=Cx1_Multikollisionsbremsung_freigeschaltet
  compu method CM_AB_PAO_Leuchte_Anf: 0=Cx0_Leuchte_ausschalten, 1=Cx1_Leuchte_einschalten
package /DataType/Constraint
  range DC_EOP_Actual_Speed: raw 0..255
  range DC_EOP_Current: raw 0..255
  range DC_EOP_Oil_Temp: raw 0..255
  range DC_EOP_Force_Restart: raw 0..1
  range DC_EOP_Over_Current_Fault: raw 0..1
  range DC_EOP_IQ_Peak: raw 0..255
  range DC_EOP_Over_Load_Fault: raw 0..1
  range DC_EOP_MOS_Temp: raw 0..255
  range DC_EOP_Over_Speed_Fault: raw 0..1
  range DC_EOP_Revs_Fault: raw 0..1
  range DC_EOP_Over_Temp_Derating: raw 0..1
  range DC_EOP_RsErr_Fault: raw 0..1
  range DC_EOP_Voltage: raw 0..255
  range DC_EOP_Self_Check_Fault: raw 0..1
  range DC_EOP_Over_Temp_Fault: raw 0..1
  range DC_EOP_State: raw 0..3
  range DC_EOP_Over_Voltage_Fault: raw 0..1
  range DC_EOP_Stuck_Fault: raw 0..1
  range DC_EOP_PreShut_Fault: raw 0..5
  range DC_EOP_Target_Speed: raw 0..255
  range DC_EOP_Under_Voltage_Fault: raw 0..1
  range DC_EOP_Version: raw 0..255
  range DC_AB_Gurtwarn_VB: raw 0..1
  range DC_AB_Gurtwarn_VF: raw 0..1
  range DC_KST_Warn_P1_ZST_def: raw 0..1
  range DC_AB_Heck_Crash: raw 0..1
  range DC_AB_Lampe: raw 0..1
  range DC_AB_MKB_Anforderung: raw 0..1
  range DC_AB_MKB_gueltig: raw 0..1
  range DC_AB_PAO_Leuchte_Anf: raw 0..1
  range DC_KST_Warn_P2_ZST_def: raw 0..1
  range DC_AB_RGS_Anst: raw 0..15
  range DC_MO_Abstellzeit: raw 0..255
  range DC_AB_Rollover_Crash: raw 0..1
  range DC_MO_Abstellzeit_Status: raw 0..3
  range DC_AB_SB_Crash: raw 0..1
  range DC_MO_Anforderung_HMS: raw 0..7
  range DC_AB_SF_Crash: raw 0..1
  range DC_MO_Ansaugsystem: raw 0..1
  range DC_AB_Stellgliedtest: raw 0..1
  range DC_MO_Anzahl_Zyl: raw 0..15
  range DC_AB_Systemfehler: raw 0..1
  range DC_MO_Anzeige_StSt_gueltig: raw 0..1
  range DC_AB_Texte_AKS: raw 0..3
  range DC_MO_Aussp_Anlass: raw 0..1
  range DC_AB_VB_deaktiviert: raw 0..1
  range DC_MO_BKV_Unterdruckwarnung: raw 0..1
  range DC_AB_Versorgungsspannung: raw 0..1
  range DC_MO_BLS: raw 0..1
  range DC_MO_BMS_NV_Anf_stuetzen: raw 0..1
  range DC_MO_EKlKomLeiRed: raw 0..3
  range DC_MO_Code: raw 0..255
  range DC_MO_eLaunch_verf: raw 0..3
  range DC_MO_DPF_verbaut: raw 0..1
  range DC_MO_EMG_Generator_Leistung: raw 0..2047
  range DC_MO_Drehzahl_VM: raw 0..65532
  range DC_MO_EMG_Max_Leistung: raw 0..2047
  range DC_MO_EMG_Max_Momentengradient: raw 0..127
  range DC_MO_EBoost_verf_praed: raw 0..3
  range DC_AB_Deaktivierung_HV: raw 0..7
  range DC_MO_EMG_Max_Spannung_Lim: raw 0..255
  range DC_MO_Fahrer_bremst: raw 0..1
  range DC_MO_EMG_Max_Strom_Lim: raw 0..2047
  range DC_MO_Fahrzeugabstellzeit: raw 0..255
  range DC_AB_Diagnose: raw 0..1
  range DC_MO_EMG_Min_Leistung: raw 0..2047
  range DC_MO_Fahrzeugabstellzeit_Status: raw 0..3
  range DC_AB_eCS_Error: raw 0..1
  range DC_MO_EMG_Min_Spannung_Lim: raw 0..255
  range DC_MO_Fahrzeugtyp: raw 0..7
  range DC_AB_EDR_Trigger: raw 0..3
  range DC_MO_Faktor_Momente_02: raw 0..3
  range DC_MO_EMG_Min_Strom_Lim: raw 0..2047
  range DC_AB_Erh_Auf_VB: raw 0..3
  range DC_MO_Fehler_Notabschaltung_Klima: raw 0..3
  range DC_AB_Front_Crash: raw 0..1
  range DC_MO_EMG_SollDrehzahl: raw 0..32767
  range DC_AB_Gurtschloss_FA_ext: raw 0..7
  range DC_MO_Fehler_NTKreis: raw 0..1
  range DC_MO_EMG_Sollmodus: raw 0..15
  range DC_AB_Gurtschloss_FA_ext_aktiv: raw 0..1
  range DC_MO_FMAus_aktiv: raw 0..1
  range DC_MO_EMG_SollMoment_02: raw 0..65534
  range DC_MO_Handshake_STH: raw 0..1
  range DC_MO_FMAus_Startvariante: raw 0..3
  range DC_MO_EMG_Sollspannung: raw 0..255
  range DC_MO_Freig_Anlass: raw 0..1
  range DC_MO_Heckspoiler_Anf: raw 0..1
  range DC_MO_Ext_E_Fahrt_aktiv: raw 0..1
  range DC_MO_Freig_Reku: raw 0..3
  range DC_MO_Hubraum: raw 0..127
  range DC_MO_Fahrbereitschaft: raw 0..3
  range DC_MO_Freigabe_Segeln: raw 0..1
  range DC_MO_HYB_Fahrbereitschaft: raw 0..1
  range DC_MO_HYB_VM_aktiv: raw 0..1
  range DC_MO_Kuppl_betaetigt: raw 0..1
  range DC_MO_Freilauf_Info: raw 0..3
  range DC_MO_Hybridfahrzeug: raw 0..3
  range DC_MO_Kuppl_schalter: raw 0..1
  range DC_MO_Freilauf_Status: raw 0..7
  range DC_MO_Interlock: raw 0..1
  range DC_MO_Gangposition: raw 0..15
  range DC_MO_LaunchControl: raw 0..1
  range DC_MO_Kickdown: raw 0..1
  range DC_MO_Getriebe_Code: raw 0..63
  range DC_MO_Leistung: raw 0..511
  range DC_MO_Kl_50: raw 0..1
  range DC_MO_Tankklappensteuerung: raw 0..3
  range DC_MO_Mom_Begr_Fahr_Pred: raw 0..510
  range DC_MO_Kl_75: raw 0..1
  range DC_MO_Timeout_ESP: raw 0..1
  range DC_MO_Motor_laeuft: raw 0..1
  range DC_MO_KLE_FStatus: raw 0..3
  range DC_MO_UBE_Hybrid_Reserve: raw 0..1023
  range DC_MO_Klima_Eingr: raw 0..3
  range DC_MO_MVEM_Energie_Anf: raw 0..1
  range DC_MO_UBE_Reserve: raw 0..1023
  range DC_MO_Klima_Regelmodus: raw 0..3
  range DC_MO_MVEM_MaxLeistung_MVVerbrauch: raw 0..1023
  range DC_MO_Veto_Launchcontrol: raw 0..1
  range DC_MO_Konsistenz_Bremsped: raw 0..1
  range DC_MO_MVEM_MinLeistung_MVVerbrauch: raw 0..1023
  range DC_MO_Waehlpos: raw 0..7
  range DC_MO_MVEM_Verbau_Motor_Verbraucher: raw 0..3
  range DC_MO_WH_Texte: raw 0..7
  range DC_MO_Kraftstoffart: raw 0..15
  range DC_MO_Zylinderabschaltung: raw 0..3
  range DC_MO_NGS_Gangpos: raw 0..7
  range DC_Motor_14_BZ: raw 0..15
  range DC_MO_Krit_Heckobjekt: raw 0..7
  range DC_MO_OBD_Typ: raw 0..3
  range DC_Motor_14_CRC: raw 0..255
  range DC_MO_Positionierung_aktiv: raw 0..1
  range DC_MVK_MV_Batteriewarnung: raw 0..3
  range DC_Motor_54_BZ: raw 0..15
  range DC_MVK_MV_Netz_Warnungen: raw 0..3
  range DC_MO_PTC_Status: raw 0..7
  range DC_Motor_54_CRC: raw 0..255
  range DC_MVK_MVPTC_Sollmodus: raw 0..7
  range DC_MO_QBit_Aussen_Temp: raw 0..1
  range DC_Motor_55_BZ: raw 0..15
  range DC_NM_RSG_CAB_V14: raw 0..16777215
  range DC_MO_QBit_Fahrer_bremst: raw 0..1
  range DC_Motor_55_CRC: raw 0..255
  range DC_NM_RSG_Car_Wakeup: raw 0..1
  range DC_Motor_Code_01_BZ: raw 0..15
  range DC_NM_RSG_CBV_AWB: raw 0..1
  range DC_MO_QBit_Gangposition: raw 0..1
  range DC_Motor_Code_01_CRC: raw 0..255
  range DC_NM_RSG_CBV_CRI: raw 0..1
  range DC_MO_QBit_KL_75: raw 0..1
  range DC_Motor_EV_01_BZ: raw 0..15
  range DC_NM_RSG_NM_aktiv_Afterrun: raw 0..1
  range DC_MO_QBit_Kuppl_betaetigt: raw 0..1
  range DC_Motor_EV_01_CRC: raw 0..255
  range DC_NM_RSG_NM_aktiv_Diagnose: raw 0..1
  range DC_MO_Red_El_Fahrleistung: raw 0..7
  range DC_MSR_Anf: raw 0..1
  range DC_NM_RSG_NM_aktiv_Int_Diagnose: raw 0..1
  range DC_MO_Remotestart_Betrieb: raw 0..1
  range DC_MV_Bordnetz_aktiv: raw 0..1
  range DC_NM_RSG_NM_aktiv_KL15: raw 0..1
  range DC_MO_Remotestart_moeglich: raw 0..1
  range DC_MV_Bordnetz_belastbar: raw 0..1
  range DC_NM_RSG_NM_aktiv_Kuehlung: raw 0..1
  range DC_MV_Bordnetz_Fehler: raw 0..1
  range DC_MO_Servicemodus: raw 0..15
  range DC_NM_RSG_NM_aktiv_NvM_Job: raw 0..1
  range DC_MVK_01_BZ: raw 0..15
  range DC_NM_RSG_NM_aktiv_StallingHelp: raw 0..1
  range DC_MO_Signalquelle_Gangposition: raw 0..1
  range DC_MVK_01_CRC: raw 0..255
  range DC_NM_RSG_NM_aktiv_Tmin: raw 0..1
  range DC_MO_StartStopp_Codiert: raw 0..1
  range DC_MVK_BMS_Sollmodus: raw 0..7
  range DC_NM_RSG_NM_State: raw 0..63
  range DC_MO_StartStopp_Fahrerwunsch: raw 0..3
  range DC_MVK_BOOST_Sollmodus: raw 0..7
  range DC_NM_RSG_UDS_CC: raw 0..1
  range DC_MO_StartStopp_Motorstopp: raw 0..1
  range DC_MVK_DCDC_Sollmodus: raw 0..7
  range DC_NM_RSG_Wakeup: raw 0..255
  range DC_MVK_DCDC_Sollmodus_02: raw 0..15
  range DC_MO_StartStopp_Status: raw 0..3
  range DC_OBD_Abs_Load_Val: raw 0..65535
  range DC_MVK_eABC_Sollmodus: raw 0..7
  range DC_MO_StartStopp_Wiederstart: raw 0..1
  range DC_OBD_Abs_Pedal_Pos: raw 0..255
  range DC_MVK_eAWS_Sollmodus: raw 0..7
  range DC_MO_StartVorauss_erfuellt: raw 0..3
  range DC_OBD_Abs_Throttle_Pos: raw 0..255
  range DC_MVK_Istmodus_Anf: raw 0..1
  range DC_OBD_Aussen_Temp_gef: raw 0..255
  range DC_MO_Startwunsch: raw 0..1
  range DC_MVK_MO_EmSollzustand: raw 0..255
  range DC_OBD_Calc_Load_Val: raw 0..255
  range DC_MO_Tankbereitschaft_Status: raw 0..7
  range DC_OBD_Sperrung_Kaltstart_Denom: raw 0..1
  range DC_OBD_ClearMem_Inhibit: raw 0..1
  range DC_OBD_Warm_Up_Cycle: raw 0..1
  range DC_OBD_Driving_Cycle: raw 0..1
  range DC_TSK_ACC_FoD_Status: raw 0..3
  range DC_OBDProtocol_req: raw 0..15
  range DC_OBD_Eng_Cool_Temp: raw 0..255
  range DC_TSK_aktives_System: raw 0..7
  range DC_OBDProtocol_RSG: raw 0..15
  range DC_TSK_aktives_System_02: raw 0..15
  range DC_OBD_Kaltstart_Denominator: raw 0..1
  range DC_RSG_Abschaltstufe: raw 0..1
  range DC_OBD_Minimum_Trip: raw 0..1
  range DC_TSK_Anf_Antriebsmoment: raw 0..1
  range DC_RSG_Indc_StChk: raw 0..1
  range DC_OBD_Normed_Trip: raw 0..1
  range DC_TSK_Codierung: raw 0..7
  range DC_RSG_Indc_StFail: raw 0..1
  range DC_OBD_QBit_Schlechtweg: raw 0..1
  range DC_TSK_Einheit_vMax_Fahrerassistenz: raw 0..1
  range DC_RSG_KD_Fehler: raw 0..1
  range DC_OBD_Schlechtweg: raw 0..1
  range DC_RSG_KompSchutz: raw 0..1
  range DC_TSK_erhoehter_Fahrwiderstand: raw 0..1
  range DC_OBD_Sperrung_IUMPR: raw 0..1
  range DC_RSG_Nachlauftyp: raw 0..15
  range DC_TSK_GRA_FoD_Status: raw 0..3
  range DC_VIN_3: raw 0..255
  range DC_RSG_Transport_Mode: raw 0..1
  range DC_TSK_Status_ARA: raw 0..7
  range DC_RSt_Fahrerhinweise: raw 0..15
  range DC_VIN_4: raw 0..255
  range DC_TSK_Status_EA: raw 0..7
  range DC_VIN_5: raw 0..255
  range DC_SI_NWDF: raw 0..1
  range DC_TSK_Status_IPA: raw 0..7
  range DC_VIN_6: raw 0..255
  range DC_SI_NWDF_gueltig: raw 0..1
  range DC_VIN_7: raw 0..255
  range DC_SI_P_Mode: raw 0..1
  range DC_TSK_Status_PLA: raw 0..7
  range DC_VIN_8: raw 0..255
  range DC_SI_P_Mode_gueltig: raw 0..1
  range DC_TSK_Status_RHP: raw 0..7
  range DC_VIN_9: raw 0..255
  range DC_SOK_Motor_55_Signatur: raw 0..4294967295
  range DC_TSK_vMax_aktuell: raw 0..255
  range DC_ZAS_Kl_15: raw 0..1
  range DC_TS_Allrad_Anteil_sek: raw 0..511
  range DC_TSK_vMax_Fahrerassistenz: raw 0..511
  range DC_TS_Faktor_Radmomente: raw 0..3
  range DC_ZAS_Kl_50_Startanforderung: raw 0..1
  range DC_UH_Jahr: raw 0..127
  range DC_TS_MomRad_Ist: raw 0..8190
  range DC_ZAS_Kl_Infotainment: raw 0..1
  range DC_UH_Minute: raw 0..59
  range DC_TS_MomRad_Ist_sek: raw 0..8190
  range DC_ZAS_Kl_S: raw 0..1
  range DC_TS_MomRad_Soll_Summe: raw 0..8190
  range DC_ZAS_Kl_X: raw 0..1
  range DC_UH_Monat: raw 0..15
  range DC_TS_MomRad_verfuegb_max: raw 0..4094
  range DC_UH_Sekunde: raw 0..59
  range DC_TS_MomRad_verfuegb_max_sek: raw 0..4094
  range DC_UH_Stunde: raw 0..23
  range DC_TS_MomRad_verfuegb_maxReku: raw 0..4094
  range DC_TS_MomRad_verfuegb_maxReku_sek: raw 0..4094
  range DC_UH_Tag: raw 0..31
  range DC_VIN_01_MUX: raw 0..3
  range DC_TS_MomRad_verfuegb_maxReku_Summe: raw 0..4094
  range DC_TS_MomRad_Wunsch: raw 0..8190
  range DC_VIN_1: raw 0..255
  range DC_TS_MomRad_Wunsch_sek: raw 0..8190
  range DC_VIN_10: raw 0..255
  range DC_TS_Status_DrzReg: raw 0..3
  range DC_VIN_11: raw 0..255
  range DC_TS_Status_DrzReg_sek: raw 0..3
  range DC_TS_Status_MomRad_Ist: raw 0..3
  range DC_VIN_{12..17}: raw 0..255
  range DC_VIN_2: raw 0..255
  range DC_EMG_Min_Moment_Lim: raw 0..4095
  range DC_EMG_OBD_Lampe_Anf: raw 0..1
  range DC_EMG_PerfInd_Temperatur: raw 0..255
  range DC_EMG_PerfInd_Temperatur_PWR: raw 0..255
  range DC_EMG_Temperatur_PWR: raw 0..255
  range DC_ESC_Reku_Freigabe: raw 0..1
  range DC_ESC_v_Signal_Qualifier_High_Low: raw 0..7
  range DC_ESP_21_BZ: raw 0..15
  range DC_ESP_21_CRC: raw 0..255
  range DC_ESP_Anhaltevorgang_ACC_aktiv: raw 0..1
  range DC_ESP_ASP: raw 0..1
  range DC_ESP_AWV3_Brems_aktiv: raw 0..1
  range DC_ESP_Diagnose: raw 0..1
  range DC_ESP_Eingriff: raw 0..1
  range DC_ESP_Haltebestaetigung: raw 0..1
  range DC_ESP_MKB_Abbruch_Geschw: raw 0..1
  range DC_ESP_PLA_Bremseingriff: raw 0..1
  range DC_ESP_QBit_v_Signal: raw 0..1
  range DC_ESP_Systemstatus: raw 0..1
  range DC_ESP_Tastung_passiv: raw 0..1
  range DC_ABS_Bremsung: raw 0..1
  range DC_ESP_v_Signal: raw 0..65535
  range DC_ESP_Vorsteuerung: raw 0..1
  range DC_EV_Rekuperationsstufe: raw 0..7
  range DC_FDR_Allrad_Anteil_max_sek: raw 0..511
  range DC_FDR_Allrad_Anteil_min_sek: raw 0..511
  range DC_FDR_MomRad_Eingriff: raw 0..8191
  range DC_FDR_MomRad_Eingriff_sek: raw 0..8191
  range DC_Airbag_01_BZ: raw 0..15
  range DC_FDR_Status_Eingriff: raw 0..1
  range DC_Airbag_01_CRC: raw 0..255
  range DC_FDR_Status_Eingriff_sek: raw 0..1
  range DC_ASM_Masterzeit_02: raw 0..255
  range DC_FDR_Zwangszusch_ESP: raw 0..1
  range DC_ASR_Anf: raw 0..1
  range DC_FoD_DTC_TSK_ACC: raw 0..1
  range DC_ASR_Schalteingriff: raw 0..3
  range DC_FoD_DTC_TSK_GRA: raw 0..1
  range DC_ASR_Tastung_passiv: raw 0..1
  range DC_BCM_Ausparken_Betrieb: raw 0..1
  range DC_BCM_Remotestart_Betrieb: raw 0..1
  range DC_BCM_Remotestart_KL15_Anf: raw 0..1
  range DC_BCM_Remotestart_MO_Start: raw 0..1
  range DC_BR_Eingriffsmoment: raw 0..1023
  range DC_CE_FlgLnchCtlPreCnd: raw 0..1
  range DC_DGN_Verlernzaehler: raw 0..255
  range DC_EBV_Eingriff: raw 0..1
  range DC_EDS_Eingriff: raw 0..1
  range DC_EMG_Diagnose_Anf: raw 0..3
  range DC_EMG_Fehler_Drehzahlreduktion: raw 0..1
  range DC_EMG_Fehler_Leistungsred: raw 0..1
  range DC_EMG_Generator_Moment: raw 0..4095
  range DC_EMG_HYB_05_BZ: raw 0..15
  range DC_EMG_HYB_05_CRC: raw 0..255
  range DC_EMG_IstDrehzahl: raw 0..32767
  range DC_EMG_Istmodus: raw 0..15
  range DC_EMG_IstMoment: raw 0..4095
  range DC_EMG_IstSpannung: raw 0..4095
  range DC_EMG_IstStrom: raw 0..2047
  range DC_EMG_Max_Moment: raw 0..4095
  range DC_EMG_Max_Moment_Lim: raw 0..4095
  range DC_EMG_Max_Moment_Sockel: raw 0..255
  range DC_EMG_maxDrehzahl_Freilauf: raw 0..32767
  range DC_EMG_Min_Moment: raw 0..4095
  range DC_MO_eDriveZone_Texte: raw 0..15
  range DC_ISA_Regelung_aktiv: raw 0..1
  range DC_ISA_Status: raw 0..7
  range DC_ISA_Tempolimitwarnung: raw 0..1
  range DC_KBI_Kilometerstand: raw 0..1048575
  range DC_Klemmen_Status_01_BZ: raw 0..15
  range DC_Klemmen_Status_01_CRC: raw 0..255
  range DC_KN_RSG_BusKnockOut: raw 0..3
  range DC_KN_RSG_BusKnockOutTimer: raw 0..255
  range DC_KN_RSG_DiagPfad: raw 0..1
  range DC_KN_RSG_ECUKnockOut: raw 0..3
  range DC_KN_RSG_ECUKnockOutTimer: raw 0..63
  range DC_KST_Fahrerhinweis_1: raw 0..1
  range DC_KST_Fahrerhinweis_2: raw 0..1
  range DC_KST_Fahrerhinweis_{4..6}: raw 0..1
  range DC_AB_Anzeige_Fussg: raw 0..3
  range DC_AB_Belegung_VF: raw 0..3
  range DC_AB_Crash_Int: raw 0..7
  range DC_AB_Deaktiviert: raw 0..1
