/* Modified for VEOS! -> modul */
/******************************************************************************
* ASAP2 file: PrmM.a2l
* Code generation for model "PrmM".
* Model version : 1.22
* Simulink Coder version : 9.0 (R2018b) 24-May-2018
* C source code generated on : Tue Jun 23 23:29:11 2026
* Target selection: autosar.tlc
* Embedded hardware selection: Infineon->TriCore
* Code generation objective: MISRA C:2012 guidelines
* Validation result: Not run
* (add additional file header information here)
******************************************************************************/ ASAP2_VERSION 1 31
/* Version 1.31 */
/begin PROJECT ProjectName "Project Comment Goes Here"
/begin HEADER "Header Comments go here" /end HEADER
/begin MODULE ModuleName "Module Comment Goes Here"
/begin MOD_PAR "MOD PAR Comment Goes Here" /end MOD_PAR
/begin MOD_COMMON "Mod Common Comment Here" BYTE_ORDER MSB_LAST /end MOD_COMMON
/begin RECORD_LAYOUT Scalar_BOOLEAN FNC_VALUES 1 UBYTE COLUMN_DIR DIRECT /end RECORD_LAYOUT
/begin RECORD_LAYOUT Scalar_UBYTE FNC_VALUES 1 UBYTE COLUMN_DIR DIRECT /end RECORD_LAYOUT
/begin RECORD_LAYOUT Scalar_BYTE FNC_VALUES 1 SBYTE COLUMN_DIR DIRECT /end RECORD_LAYOUT
/begin RECORD_LAYOUT Scalar_UWORD FNC_VALUES 1 UWORD COLUMN_DIR DIRECT /end RECORD_LAYOUT
/begin RECORD_LAYOUT Scalar_SWORD FNC_VALUES 1 SWORD COLUMN_DIR DIRECT /end RECORD_LAYOUT
/begin RECORD_LAYOUT Scalar_ULONG FNC_VALUES 1 ULONG COLUMN_DIR DIRECT /end RECORD_LAYOUT
/begin RECORD_LAYOUT Scalar_LONG FNC_VALUES 1 SLONG COLUMN_DIR DIRECT /end RECORD_LAYOUT
/begin RECORD_LAYOUT Scalar_FLOAT32_IEEE FNC_VALUES 1 FLOAT32_IEEE COLUMN_DIR DIRECT /end RECORD_LAYOUT
/begin RECORD_LAYOUT Scalar_FLOAT64_IEEE FNC_VALUES 1 FLOAT64_IEEE COLUMN_DIR DIRECT /end RECORD_LAYOUT
/begin RECORD_LAYOUT Lookup1D_BOOLEAN FNC_VALUES 1 UBYTE COLUMN_DIR DIRECT /end RECORD_LAYOUT
/begin RECORD_LAYOUT Lookup1D_X_BOOLEAN AXIS_PTS_X 1 UBYTE INDEX_INCR DIRECT /end RECORD_LAYOUT
/begin RECORD_LAYOUT Lookup1D_BYTE FNC_VALUES 1 SBYTE COLUMN_DIR DIRECT /end RECORD_LAYOUT
/begin RECORD_LAYOUT Lookup1D_X_BYTE AXIS_PTS_X 1 SBYTE INDEX_INCR DIRECT /end RECORD_LAYOUT
/begin RECORD_LAYOUT Lookup1D_UBYTE FNC_VALUES 1 UBYTE COLUMN_DIR DIRECT /end RECORD_LAYOUT
/begin RECORD_LAYOUT Lookup1D_X_UBYTE AXIS_PTS_X 1 UBYTE INDEX_INCR DIRECT /end RECORD_LAYOUT
/begin RECORD_LAYOUT Lookup1D_UWORD FNC_VALUES 1 UWORD COLUMN_DIR DIRECT /end RECORD_LAYOUT
/begin RECORD_LAYOUT Lookup1D_X_UWORD AXIS_PTS_X 1 UWORD INDEX_INCR DIRECT /end RECORD_LAYOUT
/begin RECORD_LAYOUT Lookup1D_WORD FNC_VALUES 1 SWORD COLUMN_DIR DIRECT /end RECORD_LAYOUT
/begin RECORD_LAYOUT Lookup1D_X_WORD AXIS_PTS_X 1 SWORD INDEX_INCR DIRECT /end RECORD_LAYOUT
/begin RECORD_LAYOUT Lookup1D_ULONG FNC_VALUES 1 ULONG COLUMN_DIR DIRECT /end RECORD_LAYOUT
/begin RECORD_LAYOUT Lookup1D_X_ULONG AXIS_PTS_X 1 ULONG INDEX_INCR DIRECT /end RECORD_LAYOUT
/begin RECORD_LAYOUT Lookup1D_SLONG FNC_VALUES 1 SLONG COLUMN_DIR DIRECT /end RECORD_LAYOUT
/begin RECORD_LAYOUT Lookup1D_X_LONG AXIS_PTS_X 1 SLONG INDEX_INCR DIRECT /end RECORD_LAYOUT
/begin RECORD_LAYOUT Lookup1D_FLOAT32_IEEE FNC_VALUES 1 FLOAT32_IEEE COLUMN_DIR DIRECT /end RECORD_LAYOUT
/begin RECORD_LAYOUT Lookup1D_X_FLOAT32_IEEE AXIS_PTS_X 1 FLOAT32_IEEE INDEX_INCR DIRECT /end RECORD_LAYOUT
/begin RECORD_LAYOUT Lookup1D_FLOAT64_IEEE FNC_VALUES 1 FLOAT64_IEEE COLUMN_DIR DIRECT /end RECORD_LAYOUT
/begin RECORD_LAYOUT Lookup1D_X_FLOAT64_IEEE AXIS_PTS_X 1 FLOAT64_IEEE INDEX_INCR DIRECT /end RECORD_LAYOUT
/begin RECORD_LAYOUT Lookup2D_BOOLEAN FNC_VALUES 1 UBYTE COLUMN_DIR DIRECT /end RECORD_LAYOUT
/begin RECORD_LAYOUT Lookup2D_X_BOOLEAN AXIS_PTS_X 1 UBYTE INDEX_INCR DIRECT /end RECORD_LAYOUT
/begin RECORD_LAYOUT Lookup2D_UBYTE FNC_VALUES 1 UBYTE COLUMN_DIR DIRECT /end RECORD_LAYOUT
/begin RECORD_LAYOUT Lookup2D_X_UBYTE AXIS_PTS_X 1 UBYTE INDEX_INCR DIRECT /end RECORD_LAYOUT
/begin RECORD_LAYOUT Lookup2D_BYTE FNC_VALUES 1 SBYTE COLUMN_DIR DIRECT /end RECORD_LAYOUT
/begin RECORD_LAYOUT Lookup2D_X_BYTE AXIS_PTS_X 1 SBYTE INDEX_INCR DIRECT /end RECORD_LAYOUT
/begin RECORD_LAYOUT Lookup2D_UWORD FNC_VALUES 1 UWORD COLUMN_DIR DIRECT /end RECORD_LAYOUT
/begin RECORD_LAYOUT Lookup2D_X_UWORD AXIS_PTS_X 1 UWORD INDEX_INCR DIRECT /end RECORD_LAYOUT
/begin RECORD_LAYOUT Lookup2D_WORD FNC_VALUES 1 SWORD COLUMN_DIR DIRECT /end RECORD_LAYOUT
/begin RECORD_LAYOUT Lookup2D_X_WORD AXIS_PTS_X 1 SWORD INDEX_INCR DIRECT /end RECORD_LAYOUT
/begin RECORD_LAYOUT Lookup2D_ULONG FNC_VALUES 1 ULONG COLUMN_DIR DIRECT /end RECORD_LAYOUT
/begin RECORD_LAYOUT Lookup2D_X_ULONG AXIS_PTS_X 1 ULONG INDEX_INCR DIRECT /end RECORD_LAYOUT
/begin RECORD_LAYOUT Lookup2D_LONG FNC_VALUES 1 SLONG COLUMN_DIR DIRECT /end RECORD_LAYOUT
/begin RECORD_LAYOUT Lookup2D_X_LONG AXIS_PTS_X 1 SLONG INDEX_INCR DIRECT /end RECORD_LAYOUT
/begin RECORD_LAYOUT Lookup2D_FLOAT32_IEEE FNC_VALUES 1 FLOAT32_IEEE COLUMN_DIR DIRECT /end RECORD_LAYOUT
/begin RECORD_LAYOUT Lookup2D_X_FLOAT32_IEEE AXIS_PTS_X 1 FLOAT32_IEEE INDEX_INCR DIRECT /end RECORD_LAYOUT
/begin RECORD_LAYOUT Lookup2D_FLOAT64_IEEE FNC_VALUES 1 FLOAT64_IEEE COLUMN_DIR DIRECT /end RECORD_LAYOUT
/begin RECORD_LAYOUT Lookup2D_X_FLOAT64_IEEE AXIS_PTS_X 1 FLOAT64_IEEE INDEX_INCR DIRECT /end RECORD_LAYOUT
/begin CHARACTERISTIC CS_PrmM_mMaxTqGrdtInt_XDF32 "Maximum internal torque request gradient. Nm per second.
      " VALUE 0x0000 /* @ECU_Address@CS_PrmM_mMaxTqGrdtInt_XDF32@ */ Scalar_FLOAT32_IEEE 0 PrmM_CM_single_N_m_s 1000.0 2000.0 /end CHARACTERISTIC
/begin CHARACTERISTIC CS_PrmM_nHSpdBd_XDF32 "Above this speed lower bound of  torque request is set to minimum electromagnetical limit. " VALUE 0x0000 /* @ECU_Address@CS_PrmM_nHSpdBd_XDF32@ */ Scalar_FLOAT32_IEEE 0 PrmM_CM_single_rpm -3.4E+38 3.4E+38 /end CHARACTERISTIC
/begin CHARACTERISTIC CS_PrmM_nLwrSpdBd_XDF32 "Below this speed drag torque is set as torque request" VALUE 0x0000 /* @ECU_Address@CS_PrmM_nLwrSpdBd_XDF32@ */ Scalar_FLOAT32_IEEE 0 PrmM_CM_single_rpm -3.4E+38 3.4E+38 /end CHARACTERISTIC
/begin CHARACTERISTIC CS_PrmM_nSpdReqInt_XDF32 "Internally specified speed target for speed mode" VALUE 0x0000 /* @ECU_Address@CS_PrmM_nSpdReqInt_XDF32@ */ Scalar_FLOAT32_IEEE 0 PrmM_CM_single_rpm -3.4E+38 3.4E+38 /end CHARACTERISTIC
/begin CHARACTERISTIC CS_PrmM_nZeroThd_XDF32 "Thd to round min/max Ext Tq Lim to zero" VALUE 0x0000 /* @ECU_Address@CS_PrmM_nZeroThd_XDF32@ */ Scalar_FLOAT32_IEEE 0 PrmM_CM_single_N_m 0.0 1.0 /end CHARACTERISTIC
/begin CHARACTERISTIC CS_PrmM_uDcMaxBattLess_XDF32 "Internal value to restrict maximum voltage limit for Batteryless mode." VALUE 0x0000 /* @ECU_Address@CS_PrmM_uDcMaxBattLess_XDF32@ */ Scalar_FLOAT32_IEEE 0 PrmM_CM_single_V 24.0 56.0 /end CHARACTERISTIC
/begin CHARACTERISTIC CS_PrmM_uDcMaxOtherM_XDF32 "Internal value to restrict maximum voltage limit for speed, torque or communicationless mode." VALUE 0x0000 /* @ECU_Address@CS_PrmM_uDcMaxOtherM_XDF32@ */ Scalar_FLOAT32_IEEE 0 PrmM_CM_single_V 24.0 56.0 /end CHARACTERISTIC
/begin CHARACTERISTIC CS_PrmM_uDcMaxVoltMode_XDF32 "Internal value to restrict maximum voltage limit for voltage mode." VALUE 0x0000 /* @ECU_Address@CS_PrmM_uDcMaxVoltMode_XDF32@ */ Scalar_FLOAT32_IEEE 0 PrmM_CM_single_V 24.0 56.0 /end CHARACTERISTIC
/begin CHARACTERISTIC CS_PrmM_uDcMinBattLess_XDF32 "Internal value to restrict minimum voltage limit fo Batteryless mode." VALUE 0x0000 /* @ECU_Address@CS_PrmM_uDcMinBattLess_XDF32@ */ Scalar_FLOAT32_IEEE 0 PrmM_CM_single_V 24.0 56.0 /end CHARACTERISTIC
/begin CHARACTERISTIC CS_PrmM_uDcMinOtherM_XDF32 "Internal value to restrict minimum voltage limit for speed, torque or communicationless mode." VALUE 0x0000 /* @ECU_Address@CS_PrmM_uDcMinOtherM_XDF32@ */ Scalar_FLOAT32_IEEE 0 PrmM_CM_single_V 24.0 56.0 /end CHARACTERISTIC
/begin CHARACTERISTIC CS_PrmM_uDcMinVoltMode_XDF32 "Internal value to restrict minimum voltage limit for voltage mode." VALUE 0x0000 /* @ECU_Address@CS_PrmM_uDcMinVoltMode_XDF32@ */ Scalar_FLOAT32_IEEE 0 PrmM_CM_single_V 24.0 56.0 /end CHARACTERISTIC
/begin CHARACTERISTIC CS_PrmM_uVoltReqComless_XDF32 "Internally specified voltage target in communicationless Limphome Mode" VALUE 0x0000 /* @ECU_Address@CS_PrmM_uVoltReqComless_XDF32@ */ Scalar_FLOAT32_IEEE 0 PrmM_CM_single_V -3.4E+38 3.4E+38 /end CHARACTERISTIC
/begin CHARACTERISTIC CS_PrmM_fSpdReqSelect_XDB "Speed request method selector. False: Internal Value  True: Value from CAN" VALUE 0x0000 /* @ECU_Address@CS_PrmM_fSpdReqSelect_XDB@ */ Scalar_BOOLEAN 0 PrmM_CM_boolean 0 1 /end CHARACTERISTIC
/begin CHARACTERISTIC CS_PrmM_fTqGrdSelect_XDB "Gradient method selector. True: Internal Value  False: Value from CAN" VALUE 0x0000 /* @ECU_Address@CS_PrmM_fTqGrdSelect_XDB@ */ Scalar_BOOLEAN 0 PrmM_CM_boolean 0 1 /end CHARACTERISTIC
/begin MEASUREMENT CS_PrmM_iReqMaxBattI_xdf32 "Maximun battery current limit" FLOAT32_IEEE PrmM_CM_single_A 0 0 -1200.0 1200.0 ECU_ADDRESS 0x0000 /* @ECU_Address@CS_PrmM_iReqMaxBattI_xdf32@ */ /end MEASUREMENT
/begin MEASUREMENT CS_PrmM_iReqMinBattI_xdf32 "Minimun battery current limit" FLOAT32_IEEE PrmM_CM_single_A 0 0 -1200.0 1200.0 ECU_ADDRESS 0x0000 /* @ECU_Address@CS_PrmM_iReqMinBattI_xdf32@ */ /end MEASUREMENT
/begin MEASUREMENT CS_PrmM_mTqminmerge_xdf32 "" FLOAT32_IEEE PrmM_CM_single 0 0 -3.4E+38 3.4E+38 ECU_ADDRESS 0x0000 /* @ECU_Address@CS_PrmM_mTqminmerge_xdf32@ */ /end MEASUREMENT
/begin MEASUREMENT CS_PrmM_mReqTq_xdf32 "requested torque" FLOAT32_IEEE PrmM_CM_single_N_m 0 0 -75.0 75.0 ECU_ADDRESS 0x0000 /* @ECU_Address@CS_PrmM_mReqTq_xdf32@ */ /end MEASUREMENT
/begin MEASUREMENT CS_PrmM_uReqU_xdf32 "requested DC voltage" FLOAT32_IEEE PrmM_CM_single_V 0 0 0.0 54.0 ECU_ADDRESS 0x0000 /* @ECU_Address@CS_PrmM_uReqU_xdf32@ */ /end MEASUREMENT
/begin MEASUREMENT CS_PrmM_nReqSpd_xdf32 "requested mechanical speed" FLOAT32_IEEE PrmM_CM_single_rpm 0 0 -10000.0 54000.0 ECU_ADDRESS 0x0000 /* @ECU_Address@CS_PrmM_nReqSpd_xdf32@ */ /end MEASUREMENT
/begin MEASUREMENT CS_PrmM_mTqLimMax_xdf32 "Maximum torque limit" FLOAT32_IEEE PrmM_CM_single_N_m 0 0 -75.0 75.0 ECU_ADDRESS 0x0000 /* @ECU_Address@CS_PrmM_mTqLimMax_xdf32@ */ /end MEASUREMENT
/begin MEASUREMENT CS_PrmM_mTqLimMin_xdf32 "Minimun torque limit" FLOAT32_IEEE PrmM_CM_single_N_m 0 0 -75.0 75.0 ECU_ADDRESS 0x0000 /* @ECU_Address@CS_PrmM_mTqLimMin_xdf32@ */ /end MEASUREMENT
/begin MEASUREMENT CS_PrmM_uReqMaxBattU_xdf32 "Maximum battery voltage limit" FLOAT32_IEEE PrmM_CM_single_V 0 0 0.0 2500.0 ECU_ADDRESS 0x0000 /* @ECU_Address@CS_PrmM_uReqMaxBattU_xdf32@ */ /end MEASUREMENT
/begin MEASUREMENT CS_PrmM_uReqMinBattU_xdf32 "Minimun battery voltage limit" FLOAT32_IEEE PrmM_CM_single_V 0 0 0.0 2500.0 ECU_ADDRESS 0x0000 /* @ECU_Address@CS_PrmM_uReqMinBattU_xdf32@ */ /end MEASUREMENT
/begin MEASUREMENT CS_PrmM_yMaxTqGrdt_xdf32 "Maximmun gradient limit" FLOAT32_IEEE PrmM_CM_single_N_m_s 0 0 -3.4E+38 3.4E+38 ECU_ADDRESS 0x0000 /* @ECU_Address@CS_PrmM_yMaxTqGrdt_xdf32@ */ /end MEASUREMENT
/begin COMPU_METHOD PrmM_CM_single_N_m_s "Q = V" RAT_FUNC "%8.6" "N*m/s" COEFFS 0 1 0 0 0 1 /end COMPU_METHOD
/begin COMPU_METHOD PrmM_CM_single_rpm "Q = V" RAT_FUNC "%8.6" "rpm" COEFFS 0 1 0 0 0 1 /end COMPU_METHOD
/begin COMPU_METHOD PrmM_CM_single_N_m "Q = V" RAT_FUNC "%8.6" "N*m" COEFFS 0 1 0 0 0 1 /end COMPU_METHOD
/begin COMPU_METHOD PrmM_CM_single_V "Q = V" RAT_FUNC "%8.6" "V" COEFFS 0 1 0 0 0 1 /end COMPU_METHOD
/begin COMPU_METHOD PrmM_CM_boolean "Q = V" RAT_FUNC "%1.0" "" COEFFS 0 1 0 0 0 1 /end COMPU_METHOD
/begin COMPU_METHOD PrmM_CM_single_A "Q = V" RAT_FUNC "%8.6" "A" COEFFS 0 1 0 0 0 1 /end COMPU_METHOD
/begin COMPU_METHOD PrmM_CM_single "Q = V" RAT_FUNC "%8.6" "" COEFFS 0 1 0 0 0 1 /end COMPU_METHOD
/begin GROUP PrmM "PrmM" /* Root */ ROOT /begin SUB_GROUP PrmM_Root_PrmM_Proc_100ms_sys PrmM_Root_PrmM_Proc_1ms_sys /end SUB_GROUP /end GROUP
/begin GROUP PrmM_Root_PrmM_Proc_100ms_sys "PrmM/PrmM_Proc_100ms_sys" /begin SUB_GROUP PrmM_S2_ParameterManager100ms /end SUB_GROUP /end GROUP
/begin GROUP PrmM_Root_PrmM_Proc_1ms_sys "PrmM/PrmM_Proc_1ms_sys" /begin SUB_GROUP PrmM_S3_ParameterManager1ms /end SUB_GROUP /end GROUP
/begin GROUP PrmM_S2_ParameterManager100ms "PrmM/PrmM_Proc_100ms_sys/ParameterManager100ms" /begin SUB_GROUP PrmM_S4_ElectricalLimits /end SUB_GROUP /end GROUP
/begin GROUP PrmM_S3_ParameterManager1ms "PrmM/PrmM_Proc_1ms_sys/ParameterManager1ms"
 /begin SUB_GROUP PrmM_S18_CS_PrmM_iReqMaxBattI_xdf32 PrmM_S18_CS_PrmM_iReqMinBattI_xdf32 PrmM_S18_CS_PrmM_mReqTq_xdf32 PrmM_S18_CS_PrmM_nReqSpd_xdf32 PrmM_S18_CS_PrmM_uReqMaxBattU_xdf32 PrmM_S18_CS_PrmM_uReqMinBattU_xdf32 PrmM_S18_CS_PrmM_uReqU_xdf32 PrmM_S18_CustExtDes PrmM_S18_CustTqLim /end SUB_GROUP
/end GROUP
/begin GROUP PrmM_S4_ElectricalLimits "PrmM/PrmM_Proc_100ms_sys/ParameterManager100ms/ElectricalLimits"
 /begin SUB_GROUP PrmM_S5_BatterylessOperation PrmM_S5_Other PrmM_S5_VoltageMode /end SUB_GROUP
/end GROUP
/begin GROUP PrmM_S18_CS_PrmM_iReqMaxBattI_xdf32 "PrmM/PrmM_Proc_1ms_sys/ParameterManager1ms/CS_PrmM_iReqMaxBattI_xdf32" /begin REF_MEASUREMENT CS_PrmM_iReqMaxBattI_xdf32 /end REF_MEASUREMENT /end GROUP
/begin GROUP PrmM_S18_CS_PrmM_iReqMinBattI_xdf32 "PrmM/PrmM_Proc_1ms_sys/ParameterManager1ms/CS_PrmM_iReqMinBattI_xdf32" /begin REF_MEASUREMENT CS_PrmM_iReqMinBattI_xdf32 /end REF_MEASUREMENT /end GROUP
/begin GROUP PrmM_S18_CS_PrmM_mReqTq_xdf32 "PrmM/PrmM_Proc_1ms_sys/ParameterManager1ms/CS_PrmM_mReqTq_xdf32" /begin REF_MEASUREMENT CS_PrmM_mReqTq_xdf32 /end REF_MEASUREMENT /end GROUP
/begin GROUP PrmM_S18_CS_PrmM_nReqSpd_xdf32 "PrmM/PrmM_Proc_1ms_sys/ParameterManager1ms/CS_PrmM_nReqSpd_xdf32" /begin REF_MEASUREMENT CS_PrmM_nReqSpd_xdf32 /end REF_MEASUREMENT /end GROUP
/begin GROUP PrmM_S18_CS_PrmM_uReqMaxBattU_xdf32 "PrmM/PrmM_Proc_1ms_sys/ParameterManager1ms/CS_PrmM_uReqMaxBattU_xdf32" /begin REF_MEASUREMENT CS_PrmM_uReqMaxBattU_xdf32 /end REF_MEASUREMENT /end GROUP
/begin GROUP PrmM_S18_CS_PrmM_uReqMinBattU_xdf32 "PrmM/PrmM_Proc_1ms_sys/ParameterManager1ms/CS_PrmM_uReqMinBattU_xdf32" /begin REF_MEASUREMENT CS_PrmM_uReqMinBattU_xdf32 /end REF_MEASUREMENT /end GROUP
/begin GROUP PrmM_S18_CS_PrmM_uReqU_xdf32 "PrmM/PrmM_Proc_1ms_sys/ParameterManager1ms/CS_PrmM_uReqU_xdf32" /begin REF_MEASUREMENT CS_PrmM_uReqU_xdf32 /end REF_MEASUREMENT /end GROUP
/begin GROUP PrmM_S18_CustExtDes "PrmM/PrmM_Proc_1ms_sys/ParameterManager1ms/CustExtDes"
 /begin SUB_GROUP PrmM_S27_CS_PrmM_nLwrSpdBd_XDF32 PrmM_S27_SpdDesDetermin PrmM_S27_VoltDesDetermin /end SUB_GROUP
/end GROUP
/begin GROUP PrmM_S18_CustTqLim "PrmM/PrmM_Proc_1ms_sys/ParameterManager1ms/CustTqLim"
 /begin SUB_GROUP PrmM_S28_CS_PrmM_mTqLimMax_xdf32 PrmM_S28_CS_PrmM_mTqLimMin_xdf32 PrmM_S28_CS_PrmM_yMaxTqGrdt_xdf32 PrmM_S28_CalcGradientLimit PrmM_S28_TorqueLimitation /end SUB_GROUP
/end GROUP
/begin GROUP PrmM_S5_BatterylessOperation "PrmM/PrmM_Proc_100ms_sys/ParameterManager100ms/ElectricalLimits/BatterylessOperation"
 /begin SUB_GROUP PrmM_S7_CS_PrmM_uDcMaxBattLess_XDF32 PrmM_S7_CS_PrmM_uDcMinBattLess_XDF32 /end SUB_GROUP
/end GROUP
/begin GROUP PrmM_S5_Other "PrmM/PrmM_Proc_100ms_sys/ParameterManager100ms/ElectricalLimits/Other"
 /begin SUB_GROUP PrmM_S10_CS_PrmM_uDcMaxOtherM_XDF32 PrmM_S10_CS_PrmM_uDcMinOtherM_XDF32 /end SUB_GROUP
/end GROUP
/begin GROUP PrmM_S5_VoltageMode "PrmM/PrmM_Proc_100ms_sys/ParameterManager100ms/ElectricalLimits/VoltageMode"
 /begin SUB_GROUP PrmM_S11_CS_PrmM_uDcMaxVoltMode_XDF32 PrmM_S11_CS_PrmM_uDcMinVoltMode_XDF32 /end SUB_GROUP
/end GROUP
/begin GROUP PrmM_S27_CS_PrmM_nLwrSpdBd_XDF32 "PrmM/PrmM_Proc_1ms_sys/ParameterManager1ms/CustExtDes/CS_PrmM_nLwrSpdBd_XDF32" /begin REF_CHARACTERISTIC CS_PrmM_nLwrSpdBd_XDF32 /end REF_CHARACTERISTIC /end GROUP
/begin GROUP PrmM_S27_SpdDesDetermin "PrmM/PrmM_Proc_1ms_sys/ParameterManager1ms/CustExtDes/SpdDesDetermin"
 /begin SUB_GROUP PrmM_S46_CS_PrmM_fSpdReqSelect_XDB PrmM_S46_CS_PrmM_nSpdReqInt_XDF32 /end SUB_GROUP
/end GROUP
/begin GROUP PrmM_S27_VoltDesDetermin "PrmM/PrmM_Proc_1ms_sys/ParameterManager1ms/CustExtDes/VoltDesDetermin" /begin SUB_GROUP PrmM_S48_CS_PrmM_uVoltReqComless_XDF32 /end SUB_GROUP /end GROUP
/begin GROUP PrmM_S28_CS_PrmM_mTqLimMax_xdf32 "PrmM/PrmM_Proc_1ms_sys/ParameterManager1ms/CustTqLim/CS_PrmM_mTqLimMax_xdf32" /begin REF_MEASUREMENT CS_PrmM_mTqLimMax_xdf32 /end REF_MEASUREMENT /end GROUP
/begin GROUP PrmM_S28_CS_PrmM_mTqLimMin_xdf32 "PrmM/PrmM_Proc_1ms_sys/ParameterManager1ms/CustTqLim/CS_PrmM_mTqLimMin_xdf32" /begin REF_MEASUREMENT CS_PrmM_mTqLimMin_xdf32 /end REF_MEASUREMENT /end GROUP
/begin GROUP PrmM_S28_CS_PrmM_yMaxTqGrdt_xdf32 "PrmM/PrmM_Proc_1ms_sys/ParameterManager1ms/CustTqLim/CS_PrmM_yMaxTqGrdt_xdf32" /begin REF_MEASUREMENT CS_PrmM_yMaxTqGrdt_xdf32 /end REF_MEASUREMENT /end GROUP
/begin GROUP PrmM_S28_CalcGradientLimit "PrmM/PrmM_Proc_1ms_sys/ParameterManager1ms/CustTqLim/CalcGradientLimit"
 /begin SUB_GROUP PrmM_S56_CS_PrmM_fTqGrdSelect_XDB PrmM_S56_CS_PrmM_mMaxTqGrdtInt_XDF32 /end SUB_GROUP
/end GROUP
/begin GROUP PrmM_S28_TorqueLimitation "PrmM/PrmM_Proc_1ms_sys/ParameterManager1ms/CustTqLim/TorqueLimitation"
 /begin SUB_GROUP PrmM_S57_CS_PrmM_mTqminmerge_xdf32 PrmM_S57_CS_PrmM_nHSpdBd_XDF32 PrmM_S57_CS_PrmM_nLwrSpdBd_XDF32 PrmM_S57_CS_PrmM_nZeroThd_XDF32 /end SUB_GROUP
/end GROUP
/begin GROUP PrmM_S7_CS_PrmM_uDcMaxBattLess_XDF32 "PrmM/PrmM_Proc_100ms_sys/ParameterManager100ms/ElectricalLimits/BatterylessOperation/CS_PrmM_uDcMaxBattLess_XDF32" /begin REF_CHARACTERISTIC CS_PrmM_uDcMaxBattLess_XDF32 /end REF_CHARACTERISTIC /end GROUP
/begin GROUP PrmM_S7_CS_PrmM_uDcMinBattLess_XDF32 "PrmM/PrmM_Proc_100ms_sys/ParameterManager100ms/ElectricalLimits/BatterylessOperation/CS_PrmM_uDcMinBattLess_XDF32" /begin REF_CHARACTERISTIC CS_PrmM_uDcMinBattLess_XDF32 /end REF_CHARACTERISTIC /end GROUP
/begin GROUP PrmM_S10_CS_PrmM_uDcMaxOtherM_XDF32 "PrmM/PrmM_Proc_100ms_sys/ParameterManager100ms/ElectricalLimits/Other/CS_PrmM_uDcMaxOtherM_XDF32" /begin REF_CHARACTERISTIC CS_PrmM_uDcMaxOtherM_XDF32 /end REF_CHARACTERISTIC /end GROUP
/begin GROUP PrmM_S10_CS_PrmM_uDcMinOtherM_XDF32 "PrmM/PrmM_Proc_100ms_sys/ParameterManager100ms/ElectricalLimits/Other/CS_PrmM_uDcMinOtherM_XDF32" /begin REF_CHARACTERISTIC CS_PrmM_uDcMinOtherM_XDF32 /end REF_CHARACTERISTIC /end GROUP
/begin GROUP PrmM_S11_CS_PrmM_uDcMaxVoltMode_XDF32 "PrmM/PrmM_Proc_100ms_sys/ParameterManager100ms/ElectricalLimits/VoltageMode/CS_PrmM_uDcMaxVoltMode_XDF32" /begin REF_CHARACTERISTIC CS_PrmM_uDcMaxVoltMode_XDF32 /end REF_CHARACTERISTIC /end GROUP
/begin GROUP PrmM_S11_CS_PrmM_uDcMinVoltMode_XDF32 "PrmM/PrmM_Proc_100ms_sys/ParameterManager100ms/ElectricalLimits/VoltageMode/CS_PrmM_uDcMinVoltMode_XDF32" /begin REF_CHARACTERISTIC CS_PrmM_uDcMinVoltMode_XDF32 /end REF_CHARACTERISTIC /end GROUP
/begin GROUP PrmM_S46_CS_PrmM_fSpdReqSelect_XDB "PrmM/PrmM_Proc_1ms_sys/ParameterManager1ms/CustExtDes/SpdDesDetermin/CS_PrmM_fSpdReqSelect_XDB" /begin REF_CHARACTERISTIC CS_PrmM_fSpdReqSelect_XDB /end REF_CHARACTERISTIC /end GROUP
/begin GROUP PrmM_S46_CS_PrmM_nSpdReqInt_XDF32 "PrmM/PrmM_Proc_1ms_sys/ParameterManager1ms/CustExtDes/SpdDesDetermin/CS_PrmM_nSpdReqInt_XDF32" /begin REF_CHARACTERISTIC CS_PrmM_nSpdReqInt_XDF32 /end REF_CHARACTERISTIC /end GROUP
/begin GROUP PrmM_S48_CS_PrmM_uVoltReqComless_XDF32 "PrmM/PrmM_Proc_1ms_sys/ParameterManager1ms/CustExtDes/VoltDesDetermin/CS_PrmM_uVoltReqComless_XDF32" /begin REF_CHARACTERISTIC CS_PrmM_uVoltReqComless_XDF32 /end REF_CHARACTERISTIC /end GROUP
/begin GROUP PrmM_S56_CS_PrmM_fTqGrdSelect_XDB "PrmM/PrmM_Proc_1ms_sys/ParameterManager1ms/CustTqLim/CalcGradientLimit/CS_PrmM_fTqGrdSelect_XDB" /begin REF_CHARACTERISTIC CS_PrmM_fTqGrdSelect_XDB /end REF_CHARACTERISTIC /end GROUP
/begin GROUP PrmM_S56_CS_PrmM_mMaxTqGrdtInt_XDF32 "PrmM/PrmM_Proc_1ms_sys/ParameterManager1ms/CustTqLim/CalcGradientLimit/CS_PrmM_mMaxTqGrdtInt_XDF32" /begin REF_CHARACTERISTIC CS_PrmM_mMaxTqGrdtInt_XDF32 /end REF_CHARACTERISTIC /end GROUP
/begin GROUP PrmM_S57_CS_PrmM_mTqminmerge_xdf32 "PrmM/PrmM_Proc_1ms_sys/ParameterManager1ms/CustTqLim/TorqueLimitation/CS_PrmM_mTqminmerge_xdf32" /begin REF_MEASUREMENT CS_PrmM_mTqminmerge_xdf32 /end REF_MEASUREMENT /end GROUP
/begin GROUP PrmM_S57_CS_PrmM_nHSpdBd_XDF32 "PrmM/PrmM_Proc_1ms_sys/ParameterManager1ms/CustTqLim/TorqueLimitation/CS_PrmM_nHSpdBd_XDF32" /begin REF_CHARACTERISTIC CS_PrmM_nHSpdBd_XDF32 /end REF_CHARACTERISTIC /end GROUP
/begin GROUP PrmM_S57_CS_PrmM_nLwrSpdBd_XDF32 "PrmM/PrmM_Proc_1ms_sys/ParameterManager1ms/CustTqLim/TorqueLimitation/CS_PrmM_nLwrSpdBd_XDF32" /begin REF_CHARACTERISTIC CS_PrmM_nLwrSpdBd_XDF32 /end REF_CHARACTERISTIC /end GROUP
/begin GROUP PrmM_S57_CS_PrmM_nZeroThd_XDF32 "PrmM/PrmM_Proc_1ms_sys/ParameterManager1ms/CustTqLim/TorqueLimitation/CS_PrmM_nZeroThd_XDF32" /begin REF_CHARACTERISTIC CS_PrmM_nZeroThd_XDF32 /end REF_CHARACTERISTIC /end GROUP
/end MODULE
/end PROJECT
/* (add any file trailer comments here) */
/* EOF PrmM.a2l */
