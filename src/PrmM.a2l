/******************************************************************************
* ASAP2 file: PrmM.a2l
* Code generation for model "PrmM".
* Model version : 15.14
* Simulink Coder version : 25.2 (R2025b) 28-Jul-2025
* C source code generated on : Tue Nov 10 23:20:35 2026
* Target selection: autosar.tlc
* Embedded hardware selection: Infineon->TriCore
* Code generation objectives: Unspecified
* Validation result: Not run
* (add additional file header information here)
******************************************************************************/ ASAP2_VERSION 1 31
/* Version 1.31 */
/begin PROJECT ProjectName "Project Comment Goes Here"
/begin HEADER "Header Comments go here" /end HEADER
/begin MODULE ModuleName "Module Comment Goes Here"
/begin MOD_PAR "MOD PAR Comment Goes Here" /end MOD_PAR
/begin MOD_COMMON "Mod Common Comment Here" BYTE_ORDER MSB_LAST ALIGNMENT_BYTE 1 ALIGNMENT_WORD 2 ALIGNMENT_LONG 4 ALIGNMENT_FLOAT32_IEEE 4 ALIGNMENT_FLOAT64_IEEE 4 /end MOD_COMMON
/begin CHARACTERISTIC CS_PrmM_fTqGrdSelect_XDB "Gradient method selector. True: Internal Value  False: Value from CAN" VALUE 0x0000 /* @ECU_Address@CS_PrmM_fTqGrdSelect_XDB@ */ Record_BOOLEAN 0 PrmM_CM_boolean 0 1 /end CHARACTERISTIC
/begin CHARACTERISTIC CS_PrmM_mMaxTqGrdtInt_XDF32 "Maximum internal torque request gradient. Nm per second.\r\n" VALUE 0x0000 /* @ECU_Address@CS_PrmM_mMaxTqGrdtInt_XDF32@ */ Record_FLOAT32_IEEE 0 PrmM_CM_single_N_into_m_per_s 1000.000000 2000.000000 /end CHARACTERISTIC
/begin CHARACTERISTIC CS_PrmM_nHSpdBd_XDF32 "Above this speed lower bound of  torque request is set to minimum electromagnetical limit. " VALUE 0x0000 /* @ECU_Address@CS_PrmM_nHSpdBd_XDF32@ */ Record_FLOAT32_IEEE 0 PrmM_CM_single_rpm -3.4E+38 3.4E+38 /end CHARACTERISTIC
/begin CHARACTERISTIC CS_PrmM_nLwrSpdBd_XDF32 "Below this speed drag torque is set as torque request" VALUE 0x0000 /* @ECU_Address@CS_PrmM_nLwrSpdBd_XDF32@ */ Record_FLOAT32_IEEE 0 PrmM_CM_single_rpm -3.4E+38 3.4E+38 /end CHARACTERISTIC
/begin CHARACTERISTIC CS_PrmM_uDcMaxBattLess_XDF32 "Internal value to restrict maximum voltage limit for Batteryless mode." VALUE 0x0000 /* @ECU_Address@CS_PrmM_uDcMaxBattLess_XDF32@ */ Record_FLOAT32_IEEE 0 PrmM_CM_single_V 24.000000 56.000000 /end CHARACTERISTIC
/begin CHARACTERISTIC CS_PrmM_uDcMaxOtherM_XDF32 "Internal value to restrict maximum voltage limit for speed, torque or communicationless mode." VALUE 0x0000 /* @ECU_Address@CS_PrmM_uDcMaxOtherM_XDF32@ */ Record_FLOAT32_IEEE 0 PrmM_CM_single_V 24.000000 56.000000 /end CHARACTERISTIC
/begin CHARACTERISTIC CS_PrmM_uDcMaxVoltMode_XDF32 "Internal value to restrict maximum voltage limit for voltage mode." VALUE 0x0000 /* @ECU_Address@CS_PrmM_uDcMaxVoltMode_XDF32@ */ Record_FLOAT32_IEEE 0 PrmM_CM_single_V 24.000000 56.000000 /end CHARACTERISTIC
/begin CHARACTERISTIC CS_PrmM_uDcMinBattLess_XDF32 "Internal value to restrict minimum voltage limit fo Batteryless mode." VALUE 0x0000 /* @ECU_Address@CS_PrmM_uDcMinBattLess_XDF32@ */ Record_FLOAT32_IEEE 0 PrmM_CM_single_V 24.000000 56.000000 /end CHARACTERISTIC
/begin CHARACTERISTIC CS_PrmM_uDcMinOtherM_XDF32 "Internal value to restrict minimum voltage limit for speed, torque or communicationless mode." VALUE 0x0000 /* @ECU_Address@CS_PrmM_uDcMinOtherM_XDF32@ */ Record_FLOAT32_IEEE 0 PrmM_CM_single_V 24.000000 56.000000 /end CHARACTERISTIC
/begin CHARACTERISTIC CS_PrmM_uDcMinVoltMode_XDF32 "Internal value to restrict minimum voltage limit for voltage mode." VALUE 0x0000 /* @ECU_Address@CS_PrmM_uDcMinVoltMode_XDF32@ */ Record_FLOAT32_IEEE 0 PrmM_CM_single_V 24.000000 56.000000 /end CHARACTERISTIC
/begin MEASUREMENT CS_PrmM_iReqMaxBattI_xdf32 "Maximun battery current limit" FLOAT32_IEEE PrmM_CM_single_A 0 0 -1200.000000 1200.000000 ECU_ADDRESS 0x0000 /* @ECU_Address@CS_PrmM_iReqMaxBattI_xdf32@ */
 /begin IF_DATA XCP
  /begin DAQ_EVENT VARIABLE /begin DEFAULT_EVENT_LIST EVENT 0x0000 /end DEFAULT_EVENT_LIST /end DAQ_EVENT
 /end IF_DATA
/end MEASUREMENT
/begin MEASUREMENT CS_PrmM_iReqMinBattI_xdf32 "Minimun battery current limit" FLOAT32_IEEE PrmM_CM_single_A 0 0 -1200.000000 1200.000000 ECU_ADDRESS 0x0000 /* @ECU_Address@CS_PrmM_iReqMinBattI_xdf32@ */
 /begin IF_DATA XCP
  /begin DAQ_EVENT VARIABLE /begin DEFAULT_EVENT_LIST EVENT 0x0000 /end DEFAULT_EVENT_LIST /end DAQ_EVENT
 /end IF_DATA
/end MEASUREMENT
/begin MEASUREMENT CS_PrmM_mReqTq_xdf32 "requested torque" FLOAT32_IEEE PrmM_CM_single_N_into_m 0 0 -75.000000 75.000000 ECU_ADDRESS 0x0000 /* @ECU_Address@CS_PrmM_mReqTq_xdf32@ */
 /begin IF_DATA XCP
  /begin DAQ_EVENT VARIABLE /begin DEFAULT_EVENT_LIST EVENT 0x0000 /end DEFAULT_EVENT_LIST /end DAQ_EVENT
 /end IF_DATA
/end MEASUREMENT
/begin MEASUREMENT CS_PrmM_mTqLimMax_xdf32 "Maximum torque limit" FLOAT32_IEEE PrmM_CM_single_N_into_m 0 0 -75.000000 75.000000 ECU_ADDRESS 0x0000 /* @ECU_Address@CS_PrmM_mTqLimMax_xdf32@ */
 /begin IF_DATA XCP
  /begin DAQ_EVENT VARIABLE /begin DEFAULT_EVENT_LIST EVENT 0x0000 /end DEFAULT_EVENT_LIST /end DAQ_EVENT
 /end IF_DATA
/end MEASUREMENT
/begin MEASUREMENT CS_PrmM_mTqLimMin_xdf32 "Minimun torque limit" FLOAT32_IEEE PrmM_CM_single_N_into_m 0 0 -75.000000 75.000000 ECU_ADDRESS 0x0000 /* @ECU_Address@CS_PrmM_mTqLimMin_xdf32@ */
 /begin IF_DATA XCP
  /begin DAQ_EVENT VARIABLE /begin DEFAULT_EVENT_LIST EVENT 0x0000 /end DEFAULT_EVENT_LIST /end DAQ_EVENT
 /end IF_DATA
/end MEASUREMENT
/begin MEASUREMENT CS_PrmM_mTqminmerge_xdf32 "" FLOAT32_IEEE PrmM_CM_single_N_into_m 0 0 -3.4E+38 3.4E+38 ECU_ADDRESS 0x0000 /* @ECU_Address@CS_PrmM_mTqminmerge_xdf32@ */
 /begin IF_DATA XCP
  /begin DAQ_EVENT VARIABLE /begin DEFAULT_EVENT_LIST EVENT 0x0000 /end DEFAULT_EVENT_LIST /end DAQ_EVENT
 /end IF_DATA
/end MEASUREMENT
/begin MEASUREMENT CS_PrmM_nReqSpd_xdf32 "requested mechanical speed" FLOAT32_IEEE PrmM_CM_single_rpm 0 0 -10000.000000 54000.000000 ECU_ADDRESS 0x0000 /* @ECU_Address@CS_PrmM_nReqSpd_xdf32@ */
 /begin IF_DATA XCP
  /begin DAQ_EVENT VARIABLE /begin DEFAULT_EVENT_LIST EVENT 0x0000 /end DEFAULT_EVENT_LIST /end DAQ_EVENT
 /end IF_DATA
/end MEASUREMENT
/begin MEASUREMENT CS_PrmM_uReqMaxBattU_xdf32 "Maximum battery voltage limit" FLOAT32_IEEE PrmM_CM_single_V 0 0 0.000000 2500.000000 ECU_ADDRESS 0x0000 /* @ECU_Address@CS_PrmM_uReqMaxBattU_xdf32@ */
 /begin IF_DATA XCP
  /begin DAQ_EVENT VARIABLE /begin DEFAULT_EVENT_LIST EVENT 0x0000 /end DEFAULT_EVENT_LIST /end DAQ_EVENT
 /end IF_DATA
/end MEASUREMENT
/begin MEASUREMENT CS_PrmM_uReqMinBattU_xdf32 "Minimun battery voltage limit" FLOAT32_IEEE PrmM_CM_single_V 0 0 0.000000 2500.000000 ECU_ADDRESS 0x0000 /* @ECU_Address@CS_PrmM_uReqMinBattU_xdf32@ */
 /begin IF_DATA XCP
  /begin DAQ_EVENT VARIABLE /begin DEFAULT_EVENT_LIST EVENT 0x0000 /end DEFAULT_EVENT_LIST /end DAQ_EVENT
 /end IF_DATA
/end MEASUREMENT
/begin MEASUREMENT CS_PrmM_uReqU_xdf32 "requested DC voltage" FLOAT32_IEEE PrmM_CM_single_V 0 0 0.000000 54.000000 ECU_ADDRESS 0x0000 /* @ECU_Address@CS_PrmM_uReqU_xdf32@ */
 /begin IF_DATA XCP
  /begin DAQ_EVENT VARIABLE /begin DEFAULT_EVENT_LIST EVENT 0x0000 /end DEFAULT_EVENT_LIST /end DAQ_EVENT
 /end IF_DATA
/end MEASUREMENT
/begin MEASUREMENT CS_PrmM_yMaxTqGrdt_xdf32 "Maximmun gradient limit" FLOAT32_IEEE PrmM_CM_single_N_into_m_per_s 0 0 -3.4E+38 3.4E+38 ECU_ADDRESS 0x0000 /* @ECU_Address@CS_PrmM_yMaxTqGrdt_xdf32@ */
 /begin IF_DATA XCP
  /begin DAQ_EVENT VARIABLE /begin DEFAULT_EVENT_LIST EVENT 0x0000 /end DEFAULT_EVENT_LIST /end DAQ_EVENT
 /end IF_DATA
/end MEASUREMENT
/begin COMPU_METHOD PrmM_CM_boolean "Q = V" RAT_FUNC "%1.0" "" COEFFS 0 1 0 0 0 1 /end COMPU_METHOD
/begin COMPU_METHOD PrmM_CM_single_A "Q = V" RAT_FUNC "%8.6" "A" COEFFS 0 1 0 0 0 1 /end COMPU_METHOD
/begin COMPU_METHOD PrmM_CM_single_N_into_m "Q = V" RAT_FUNC "%8.6" "N*m" COEFFS 0 1 0 0 0 1 /end COMPU_METHOD
/begin COMPU_METHOD PrmM_CM_single_N_into_m_per_s "Q = V" RAT_FUNC "%8.6" "N*m/s" COEFFS 0 1 0 0 0 1 /end COMPU_METHOD
/begin COMPU_METHOD PrmM_CM_single_V "Q = V" RAT_FUNC "%8.6" "V" COEFFS 0 1 0 0 0 1 /end COMPU_METHOD
/begin COMPU_METHOD PrmM_CM_single_rpm "Q = V" RAT_FUNC "%8.6" "rpm" COEFFS 0 1 0 0 0 1 /end COMPU_METHOD
/begin RECORD_LAYOUT Record_BOOLEAN FNC_VALUES 1 UBYTE COLUMN_DIR DIRECT /end RECORD_LAYOUT
/begin RECORD_LAYOUT Record_FLOAT32_IEEE FNC_VALUES 1 FLOAT32_IEEE COLUMN_DIR DIRECT /end RECORD_LAYOUT
/begin GROUP PrmM "PrmM" /* Root */ ROOT /begin SUB_GROUP PrmM.PrmM_Proc_100ms_sys PrmM.PrmM_Proc_1ms_sys /end SUB_GROUP /end GROUP
/begin GROUP PrmM.PrmM_Proc_100ms_sys "PrmM/PrmM_Proc_100ms_sys" /begin SUB_GROUP PrmM.PrmM_Proc_100ms_sys.ParameterManager100ms /end SUB_GROUP /end GROUP
/begin GROUP PrmM.PrmM_Proc_100ms_sys.ParameterManager100ms "PrmM/PrmM_Proc_100ms_sys/ParameterManager100ms"
 /begin SUB_GROUP PrmM.PrmM_Proc_100ms_sys.ParameterManager100ms.ElectricalLimits /end SUB_GROUP
/end GROUP
/begin GROUP PrmM.PrmM_Proc_100ms_sys.ParameterManager100ms.ElectricalLimits "PrmM/PrmM_Proc_100ms_sys/ParameterManager100ms/ElectricalLimits"
 /begin SUB_GROUP PrmM.PrmM_Proc_100ms_sys.ParameterManager100ms.ElectricalLimits.BatterylessOperation PrmM.PrmM_Proc_100ms_sys.ParameterManager100ms.ElectricalLimits.Other PrmM.PrmM_Proc_100ms_sys.ParameterManager100ms.ElectricalLimits.VoltageMode /end SUB_GROUP
/end GROUP
/begin GROUP PrmM.PrmM_Proc_100ms_sys.ParameterManager100ms.ElectricalLimits.BatterylessOperation "PrmM/PrmM_Proc_100ms_sys/ParameterManager100ms/ElectricalLimits/BatterylessOperation"
 /begin SUB_GROUP PrmM.PrmM_Proc_100ms_sys.ParameterManager100ms.ElectricalLimits.BatterylessOperation.CS_PrmM_uDcMaxBattLess_XDF32 PrmM.PrmM_Proc_100ms_sys.ParameterManager100ms.ElectricalLimits.BatterylessOperation.CS_PrmM_uDcMinBattLess_XDF32 /end SUB_GROUP
/end GROUP
/begin GROUP PrmM.PrmM_Proc_100ms_sys.ParameterManager100ms.ElectricalLimits.BatterylessOperation.CS_PrmM_uDcMaxBattLess_XDF32 "PrmM/PrmM_Proc_100ms_sys/ParameterManager100ms/ElectricalLimits/BatterylessOperation/CS_PrmM_uDcMaxBattLess_XDF32" /begin REF_CHARACTERISTIC CS_PrmM_uDcMaxBattLess_XDF32 /end REF_CHARACTERISTIC /end GROUP
/begin GROUP PrmM.PrmM_Proc_100ms_sys.ParameterManager100ms.ElectricalLimits.BatterylessOperation.CS_PrmM_uDcMinBattLess_XDF32 "PrmM/PrmM_Proc_100ms_sys/ParameterManager100ms/ElectricalLimits/BatterylessOperation/CS_PrmM_uDcMinBattLess_XDF32" /begin REF_CHARACTERISTIC CS_PrmM_uDcMinBattLess_XDF32 /end REF_CHARACTERISTIC /end GROUP
/begin GROUP PrmM.PrmM_Proc_100ms_sys.ParameterManager100ms.ElectricalLimits.Other "PrmM/PrmM_Proc_100ms_sys/ParameterManager100ms/ElectricalLimits/Other"
 /begin SUB_GROUP PrmM.PrmM_Proc_100ms_sys.ParameterManager100ms.ElectricalLimits.Other.CS_PrmM_uDcMaxOtherM_XDF32 PrmM.PrmM_Proc_100ms_sys.ParameterManager100ms.ElectricalLimits.Other.CS_PrmM_uDcMinOtherM_XDF32 /end SUB_GROUP
/end GROUP
/begin GROUP PrmM.PrmM_Proc_100ms_sys.ParameterManager100ms.ElectricalLimits.Other.CS_PrmM_uDcMaxOtherM_XDF32 "PrmM/PrmM_Proc_100ms_sys/ParameterManager100ms/ElectricalLimits/Other/CS_PrmM_uDcMaxOtherM_XDF32" /begin REF_CHARACTERISTIC CS_PrmM_uDcMaxOtherM_XDF32 /end REF_CHARACTERISTIC /end GROUP
/begin GROUP PrmM.PrmM_Proc_100ms_sys.ParameterManager100ms.ElectricalLimits.Other.CS_PrmM_uDcMinOtherM_XDF32 "PrmM/PrmM_Proc_100ms_sys/ParameterManager100ms/ElectricalLimits/Other/CS_PrmM_uDcMinOtherM_XDF32" /begin REF_CHARACTERISTIC CS_PrmM_uDcMinOtherM_XDF32 /end REF_CHARACTERISTIC /end GROUP
/begin GROUP PrmM.PrmM_Proc_100ms_sys.ParameterManager100ms.ElectricalLimits.VoltageMode "PrmM/PrmM_Proc_100ms_sys/ParameterManager100ms/ElectricalLimits/VoltageMode"
 /begin SUB_GROUP PrmM.PrmM_Proc_100ms_sys.ParameterManager100ms.ElectricalLimits.VoltageMode.CS_PrmM_uDcMaxVoltMode_XDF32 PrmM.PrmM_Proc_100ms_sys.ParameterManager100ms.ElectricalLimits.VoltageMode.CS_PrmM_uDcMinVoltMode_XDF32 /end SUB_GROUP
/end GROUP
/begin GROUP PrmM.PrmM_Proc_100ms_sys.ParameterManager100ms.ElectricalLimits.VoltageMode.CS_PrmM_uDcMaxVoltMode_XDF32 "PrmM/PrmM_Proc_100ms_sys/ParameterManager100ms/ElectricalLimits/VoltageMode/CS_PrmM_uDcMaxVoltMode_XDF32" /begin REF_CHARACTERISTIC CS_PrmM_uDcMaxVoltMode_XDF32 /end REF_CHARACTERISTIC /end GROUP
/begin GROUP PrmM.PrmM_Proc_100ms_sys.ParameterManager100ms.ElectricalLimits.VoltageMode.CS_PrmM_uDcMinVoltMode_XDF32 "PrmM/PrmM_Proc_100ms_sys/ParameterManager100ms/ElectricalLimits/VoltageMode/CS_PrmM_uDcMinVoltMode_XDF32" /begin REF_CHARACTERISTIC CS_PrmM_uDcMinVoltMode_XDF32 /end REF_CHARACTERISTIC /end GROUP
/begin GROUP PrmM.PrmM_Proc_1ms_sys "PrmM/PrmM_Proc_1ms_sys" /begin SUB_GROUP PrmM.PrmM_Proc_1ms_sys.ParameterManager1ms /end SUB_GROUP /end GROUP
/begin GROUP PrmM.PrmM_Proc_1ms_sys.ParameterManager1ms "PrmM/PrmM_Proc_1ms_sys/ParameterManager1ms"
 /begin SUB_GROUP PrmM.PrmM_Proc_1ms_sys.ParameterManager1ms.CS_PrmM_iReqMaxBattI_xdf32 PrmM.PrmM_Proc_1ms_sys.ParameterManager1ms.CS_PrmM_iReqMinBattI_xdf32 PrmM.PrmM_Proc_1ms_sys.ParameterManager1ms.CS_PrmM_mReqTq_xdf32 PrmM.PrmM_Proc_1ms_sys.ParameterManager1ms.CS_PrmM_nReqSpd_xdf32 PrmM.PrmM_Proc_1ms_sys.ParameterManager1ms.CS_PrmM_uReqMaxBattU_xdf32 PrmM.PrmM_Proc_1ms_sys.ParameterManager1ms.CS_PrmM_uReqMinBattU_xdf32 PrmM.PrmM_Proc_1ms_sys.ParameterManager1ms.CS_PrmM_uReqU_xdf32 PrmM.PrmM_Proc_1ms_sys.ParameterManager1ms.CustTqLim /end SUB_GROUP
/end GROUP
/begin GROUP PrmM.PrmM_Proc_1ms_sys.ParameterManager1ms.CS_PrmM_iReqMaxBattI_xdf32 "PrmM/PrmM_Proc_1ms_sys/ParameterManager1ms/CS_PrmM_iReqMaxBattI_xdf32" /begin REF_MEASUREMENT CS_PrmM_iReqMaxBattI_xdf32 /end REF_MEASUREMENT /end GROUP
/begin GROUP PrmM.PrmM_Proc_1ms_sys.ParameterManager1ms.CS_PrmM_iReqMinBattI_xdf32 "PrmM/PrmM_Proc_1ms_sys/ParameterManager1ms/CS_PrmM_iReqMinBattI_xdf32" /begin REF_MEASUREMENT CS_PrmM_iReqMinBattI_xdf32 /end REF_MEASUREMENT /end GROUP
/begin GROUP PrmM.PrmM_Proc_1ms_sys.ParameterManager1ms.CS_PrmM_mReqTq_xdf32 "PrmM/PrmM_Proc_1ms_sys/ParameterManager1ms/CS_PrmM_mReqTq_xdf32" /begin REF_MEASUREMENT CS_PrmM_mReqTq_xdf32 /end REF_MEASUREMENT /end GROUP
/begin GROUP PrmM.PrmM_Proc_1ms_sys.ParameterManager1ms.CS_PrmM_nReqSpd_xdf32 "PrmM/PrmM_Proc_1ms_sys/ParameterManager1ms/CS_PrmM_nReqSpd_xdf32" /begin REF_MEASUREMENT CS_PrmM_nReqSpd_xdf32 /end REF_MEASUREMENT /end GROUP
/begin GROUP PrmM.PrmM_Proc_1ms_sys.ParameterManager1ms.CS_PrmM_uReqMaxBattU_xdf32 "PrmM/PrmM_Proc_1ms_sys/ParameterManager1ms/CS_PrmM_uReqMaxBattU_xdf32" /begin REF_MEASUREMENT CS_PrmM_uReqMaxBattU_xdf32 /end REF_MEASUREMENT /end GROUP
/begin GROUP PrmM.PrmM_Proc_1ms_sys.ParameterManager1ms.CS_PrmM_uReqMinBattU_xdf32 "PrmM/PrmM_Proc_1ms_sys/ParameterManager1ms/CS_PrmM_uReqMinBattU_xdf32" /begin REF_MEASUREMENT CS_PrmM_uReqMinBattU_xdf32 /end REF_MEASUREMENT /end GROUP
/begin GROUP PrmM.PrmM_Proc_1ms_sys.ParameterManager1ms.CS_PrmM_uReqU_xdf32 "PrmM/PrmM_Proc_1ms_sys/ParameterManager1ms/CS_PrmM_uReqU_xdf32" /begin REF_MEASUREMENT CS_PrmM_uReqU_xdf32 /end REF_MEASUREMENT /end GROUP
/begin GROUP PrmM.PrmM_Proc_1ms_sys.ParameterManager1ms.CustTqLim "PrmM/PrmM_Proc_1ms_sys/ParameterManager1ms/CustTqLim"
 /begin SUB_GROUP PrmM.PrmM_Proc_1ms_sys.ParameterManager1ms.CustTqLim.CS_PrmM_mTqLimMax_xdf32 PrmM.PrmM_Proc_1ms_sys.ParameterManager1ms.CustTqLim.CS_PrmM_mTqLimMin_xdf32 PrmM.PrmM_Proc_1ms_sys.ParameterManager1ms.CustTqLim.CS_PrmM_yMaxTqGrdt_xdf32 PrmM.PrmM_Proc_1ms_sys.ParameterManager1ms.CustTqLim.CalcGradientLimit PrmM.PrmM_Proc_1ms_sys.ParameterManager1ms.CustTqLim.TorqueLimitation /end SUB_GROUP
/end GROUP
/begin GROUP PrmM.PrmM_Proc_1ms_sys.ParameterManager1ms.CustTqLim.CS_PrmM_mTqLimMax_xdf32 "PrmM/PrmM_Proc_1ms_sys/ParameterManager1ms/CustTqLim/CS_PrmM_mTqLimMax_xdf32" /begin REF_MEASUREMENT CS_PrmM_mTqLimMax_xdf32 /end REF_MEASUREMENT /end GROUP
/begin GROUP PrmM.PrmM_Proc_1ms_sys.ParameterManager1ms.CustTqLim.CS_PrmM_mTqLimMin_xdf32 "PrmM/PrmM_Proc_1ms_sys/ParameterManager1ms/CustTqLim/CS_PrmM_mTqLimMin_xdf32" /begin REF_MEASUREMENT CS_PrmM_mTqLimMin_xdf32 /end REF_MEASUREMENT /end GROUP
/begin GROUP PrmM.PrmM_Proc_1ms_sys.ParameterManager1ms.CustTqLim.CS_PrmM_yMaxTqGrdt_xdf32 "PrmM/PrmM_Proc_1ms_sys/ParameterManager1ms/CustTqLim/CS_PrmM_yMaxTqGrdt_xdf32" /begin REF_MEASUREMENT CS_PrmM_yMaxTqGrdt_xdf32 /end REF_MEASUREMENT /end GROUP
/begin GROUP PrmM.PrmM_Proc_1ms_sys.ParameterManager1ms.CustTqLim.CalcGradientLimit "PrmM/PrmM_Proc_1ms_sys/ParameterManager1ms/CustTqLim/CalcGradientLimit"
 /begin SUB_GROUP PrmM.PrmM_Proc_1ms_sys.ParameterManager1ms.CustTqLim.CalcGradientLimit.CS_PrmM_fTqGrdSelect_XDB PrmM.PrmM_Proc_1ms_sys.ParameterManager1ms.CustTqLim.CalcGradientLimit.CS_PrmM_mMaxTqGrdtInt_XDF32 /end SUB_GROUP
/end GROUP
/begin GROUP PrmM.PrmM_Proc_1ms_sys.ParameterManager1ms.CustTqLim.CalcGradientLimit.CS_PrmM_fTqGrdSelect_XDB "PrmM/PrmM_Proc_1ms_sys/ParameterManager1ms/CustTqLim/CalcGradientLimit/CS_PrmM_fTqGrdSelect_XDB" /begin REF_CHARACTERISTIC CS_PrmM_fTqGrdSelect_XDB /end REF_CHARACTERISTIC /end GROUP
/begin GROUP PrmM.PrmM_Proc_1ms_sys.ParameterManager1ms.CustTqLim.CalcGradientLimit.CS_PrmM_mMaxTqGrdtInt_XDF32 "PrmM/PrmM_Proc_1ms_sys/ParameterManager1ms/CustTqLim/CalcGradientLimit/CS_PrmM_mMaxTqGrdtInt_XDF32" /begin REF_CHARACTERISTIC CS_PrmM_mMaxTqGrdtInt_XDF32 /end REF_CHARACTERISTIC /end GROUP
/begin GROUP PrmM.PrmM_Proc_1ms_sys.ParameterManager1ms.CustTqLim.TorqueLimitation "PrmM/PrmM_Proc_1ms_sys/ParameterManager1ms/CustTqLim/TorqueLimitation"
 /begin SUB_GROUP PrmM.PrmM_Proc_1ms_sys.ParameterManager1ms.CustTqLim.TorqueLimitation.CS_PrmM_mTqminmerge_xdf32 PrmM.PrmM_Proc_1ms_sys.ParameterManager1ms.CustTqLim.TorqueLimitation.CS_PrmM_nHSpdBd_XDF32 PrmM.PrmM_Proc_1ms_sys.ParameterManager1ms.CustTqLim.TorqueLimitation.CS_PrmM_nLwrSpdBd_XDF32 /end SUB_GROUP
/end GROUP
/begin GROUP PrmM.PrmM_Proc_1ms_sys.ParameterManager1ms.CustTqLim.TorqueLimitation.CS_PrmM_mTqminmerge_xdf32 "PrmM/PrmM_Proc_1ms_sys/ParameterManager1ms/CustTqLim/TorqueLimitation/CS_PrmM_mTqminmerge_xdf32" /begin REF_MEASUREMENT CS_PrmM_mTqminmerge_xdf32 /end REF_MEASUREMENT /end GROUP
/begin GROUP PrmM.PrmM_Proc_1ms_sys.ParameterManager1ms.CustTqLim.TorqueLimitation.CS_PrmM_nHSpdBd_XDF32 "PrmM/PrmM_Proc_1ms_sys/ParameterManager1ms/CustTqLim/TorqueLimitation/CS_PrmM_nHSpdBd_XDF32" /begin REF_CHARACTERISTIC CS_PrmM_nHSpdBd_XDF32 /end REF_CHARACTERISTIC /end GROUP
/begin GROUP PrmM.PrmM_Proc_1ms_sys.ParameterManager1ms.CustTqLim.TorqueLimitation.CS_PrmM_nLwrSpdBd_XDF32 "PrmM/PrmM_Proc_1ms_sys/ParameterManager1ms/CustTqLim/TorqueLimitation/CS_PrmM_nLwrSpdBd_XDF32" /begin REF_CHARACTERISTIC CS_PrmM_nLwrSpdBd_XDF32 /end REF_CHARACTERISTIC /end GROUP
/end MODULE
/end PROJECT
/* (add any file trailer comments here) */
/* EOF PrmM.a2l*/
